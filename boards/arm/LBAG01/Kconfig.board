## boards/arm/LBAG01/Kconfig.board
```kconfig
# LBAG01 board configuration

# Copyright (c) 2019 Laird Connectivity
# SPDX-License-Identifier: Apache-2.0

config BOARD_LBAG01
	bool "LBAG01"
	depends on SOC_NRF52840_QIAA
```

## boards/arm/LBAG01/Kconfig.defconfig
```kconfig
# LBAG01 board configuration

# Copyright (c) 2019 Laird Connectivity
# SPDX-License-Identifier: Apache-2.0

if BOARD_LBAG01

config BOARD
	default "LBAG01"

config I2C_0
	default y
	depends on I2C

config BMI160
	default y
	depends on I2C

if USB

config USB_NRFX
	default y

config USB_DEVICE_STACK
	default y

endif # USB

config IEEE802154_NRF5
	default y
	depends on IEEE802154

config BT_CTLR
	default BT

endif # BOARD_LBAG01
```

## boards/arm/LBLGT01/Kconfig.board
```kconfig
# LBLGT01 board configuration

# Copyright (c) 2019 Laird Connectivity
# SPDX-License-Identifier: Apache-2.0

config BOARD_LBLGT01
	bool "LBLGT01"
	depends on SOC_NRF52840_QIAA
```

## boards/arm/WBLGT01/Kconfig.board
```kconfig
# WBLGT01 board configuration

# Copyright (c) 2019 Laird Connectivity
# SPDX-License-Identifier: Apache-2.0

config BOARD_WBLGT01
	bool "WBLGT01"
	depends on SOC_NRF52840_QIAA
```

## boards/arm/WBLGT01/Kconfig.defconfig
```kconfig
# WBLGT01 board configuration

# Copyright (c) 2019 Laird Connectivity
# SPDX-License-Identifier: Apache-2.0

if BOARD_WBLGT01

config BOARD
	default "WBLGT01"

config I2C_0
	default y
	depends on I2C

config BMI160
	default y
	depends on I2C

if SPI

config SPI_0
	default y

config SPI_1
	default y

endif # SPI

if USB

config USB_NRFX
	default y

config USB_DEVICE_STACK
	default y

endif # USB

config IEEE802154_NRF5
	default y
	depends on IEEE802154

config BT_CTLR
	default BT

endif # BOARD_WBLGT01
```

## boards/arm/WBLGT02/Kconfig.board
```kconfig
# WBLGT02 board configuration

# Copyright (c) 2019 Laird Connectivity
# SPDX-License-Identifier: Apache-2.0

config BOARD_WBLGT02
	bool "WBLGT02"
	depends on SOC_NRF52840_QIAA
```

## boards/arm/bl654_dvk_lora/Kconfig.board
```kconfig
# BL654 DVK LORA board configuration

# Copyright (c) 2019 Laird Connectivity
# SPDX-License-Identifier: Apache-2.0

config BOARD_BL654_DVK_LORA
	bool "BL654 DVK LORA"
	depends on SOC_NRF52840_QIAA
```

## boards/arm/bl654_dvk_lora/Kconfig.defconfig
```kconfig
# BL654 DVK LORA board configuration

# Copyright (c) 2019 Laird Connectivity
# SPDX-License-Identifier: Apache-2.0

if BOARD_BL654_DVK_LORA

config BOARD
	default "bl654_dvk_lora"

if USB

config USB_NRFX
	default y

config USB_DEVICE_STACK
	default y

endif # USB

config BT_CTLR
	default BT

endif # BOARD_BL654_DVK_LORA
```

## drivers/lora/Kconfig.lr1110
```kconfig
#
# Copyright (c) 2019 Manivannan Sadhasivam
#
# SPDX-License-Identifier: Apache-2.0
#

DT_COMPAT_SEMTECH_LR1110 := semtech,lr1110

config LORA_LR1110
	bool "Semtech LR1110 driver"
	select HAS_SEMTECH_RADIO_DRIVERS
	select HAS_SEMTECH_LR1110 if $(dt_compat_enabled,$(DT_COMPAT_SEMTECH_LR1110))
	depends on SPI
	help
	  Enable LoRa driver for Semtech LR1110.
```

## drivers/sensor/s11/Kconfig
```kconfig
# Senseair Sunrise HVAC (s11) sensor configuration options

# Copyright (c) 2022 Wiifor
# SPDX-License-Identifier: Apache-2.0

config S11
	bool "Senseair Sunrise HVAC (s11) Sensor"
	depends on I2C
	help
	  Enable driver for Senseair Sunrise HVAC (s11) sensors.
```

## dts/bindings/lora/semtech,lr1110.yaml
```yaml
# Copyright (c) 2021 Wiifor
# SPDX-License-Identifier: Apache-2.0

description: Semtech LR1110 LoRa Modem

compatible: "semtech,lr1110"

include: spi-device.yaml

properties:
    reset-gpios:
      type: phandle-array
      required: true
      description: |
        GPIO connected to the modem's NRESET signal.

        This signal is open-drain, active-low as interpreted by the
        modem.

    busy-gpios:
      type: phandle-array
      required: true
      description: |
        GPIO connected to the modem's BUSY signal.

    tx-enable-gpios:
      type: phandle-array
      required: false
      description: |
        Antenna switch TX enable GPIO. If set, the driver tracks the
        state of the radio and controls the RF switch.

    rx-enable-gpios:
      type: phandle-array
      required: false
      description: |
        Antenna switch RX enable GPIO. If set, the driver tracks the
        state of the radio and controls the RF switch.

    dio9-gpios:
      type: phandle-array
      required: true
      description: |
        GPIO connected to DIO9. This GPIO will be used as a generic
        IRQ line from the chip.

    rf-switch-enable:
      type: int
      required: true
      description: |
        Enable rf switch. This value is is a 5-bits bitmap (e.g. 01001 is a
        valid value) where each bit is a state of a GPIO (1 for high, 0 for
        low).

        See constants in dt-bindings/lora/lr1110.h.

    rf-switch-tx:
      type: int
      required: true
      description: |
        Rf switch tx configuration. This value is is a 5-bits bitmap (e.g. 01001
        is a valid value) where each bit is a state of a GPIO (1 for high, 0 for
        low).

        See constants in dt-bindings/lora/lr1110.h.

    rf-switch-rx:
      type: int
      required: true
      description: |
        Rf switch rx configuration. This value is is a 5-bits bitmap (e.g. 01001
        is a valid value) where each bit is a state of a GPIO (1 for high, 0 for
        low).

        See constants in dt-bindings/lora/lr1110.h.

    tcxo-voltage:
      type: int
      required: false
      description: |
        TCXO supply voltage controlled by DIO3 if present.

        See constants in dt-bindings/lora/lr1110.h.

    tcxo-power-startup-delay-ms:
      type: int
      required: false
      description: |
        Startup delay to let the TCXO stabilize after TCXO power on.
```

## dts/bindings/sensor/senseair,s11.yaml
```yaml
# Copyright (c) 2022 Wiifor SAS
#
# SPDX-License-Identifier: Apache-2.0

description: |
    The Senseair Sunrise HVAC (s11) is an integrated environmental
    sensor that measures air quality

compatible: "senseair,s11"

include: i2c-device.yaml
```
