## CMakeLists.txt
```
# Copyright (c) 2018-2020 O.S.Systems
#
# SPDX-License-Identifier: Apache-2.0

cmake_minimum_required(VERSION 3.13.1)

# This application has its own Kconfig options.
set(KCONFIG_ROOT ${CMAKE_CURRENT_SOURCE_DIR}/Kconfig)

find_package(Zephyr REQUIRED HINTS $ENV{ZEPHYR_BASE})
project(updatehub)

target_sources(app PRIVATE src/main.c)

if(CONFIG_UPDATEHUB_DTLS)
    set(gen_dir ${ZEPHYR_BINARY_DIR}/include/generated/)

    foreach(inc_file
            servercert.der
            privkey.der
            )
        generate_inc_file_for_target(
            ${ZEPHYR_CURRENT_LIBRARY}
            src/certificates/${inc_file}
            ${gen_dir}/${inc_file}.inc
            )
    endforeach()
endif()
```

## Kconfig
```
#  Copyright (c) 2018-2020 O.S.Systems
#  SPDX-License-Identifier: Apache-2.0

mainmenu "Sample app Configuration"

config UPDATEHUB_SAMPLE_MANUAL
	bool "UpdateHub manual mode"
	help
	  Manual mode requires the user to call the server probe and then, if
	  there is an available update, also requires the user to decide if
	  it is appropriate to update now or later.

if !UPDATEHUB_SAMPLE_MANUAL
config UPDATEHUB_SAMPLE_POLLING
	bool "UpdateHub polling mode"
	default y
	help
	  Polling mode runs automatically on a predefined period, probing the
	  server for updates and installing them without requiring user
	  intervention.
endif #!UPDATEHUB_SAMPLE_MANUAL

if WIFI
config UPDATEHUB_SAMPLE_WIFI_SSID
	string "WIFI SSID - Network name"
	default "my_network"
config UPDATEHUB_SAMPLE_WIFI_PSK
	string "WIFI PSK - Network password key"
	default "secret_passwd"
endif

source "Kconfig.zephyr"
```

## sample.yaml
```
sample:
  description: UpdateHub enterprise-grade Firmware Over-the-Air (FOTA)
  name: UpdateHub
common:
  harness: net
  tags: net wifi updatehub
  depends_on: netif
  build_only: true
  platform_allow: frdm_k64f
tests:
  sample.net.updatehub:
    extra_configs:
      - CONFIG_UPDATEHUB_PRODUCT_UID="e4d37cfe6ec48a2d069cc0bbb8b078677e9a0d8df3a027c4d8ea131130c4265f"
      - CONFIG_UPDATEHUB_POLL_INTERVAL=1
      - CONFIG_UPDATEHUB_CE=y
      - CONFIG_UPDATEHUB_SERVER="10.5.3.67"
  sample.net.updatehub.dtls:
    extra_args: OVERLAY_CONFIG="overlay-dtls.conf"
    extra_configs:
      - CONFIG_UPDATEHUB_PRODUCT_UID="e4d37cfe6ec48a2d069cc0bbb8b078677e9a0d8df3a027c4d8ea131130c4265f"
      - CONFIG_UPDATEHUB_POLL_INTERVAL=1
      - CONFIG_UPDATEHUB_CE=y
      - CONFIG_UPDATEHUB_SERVER="10.5.3.67"
```

## prj.conf
```kconfig
# Copyright (c) 2018-2020 O.S.Systems
# SPDX -License-Identifier: Apache-2.0

# Turn on the updatehub
CONFIG_UPDATEHUB=y
CONFIG_COAP_INIT_ACK_TIMEOUT_MS=10000

# Heap mem pool size
CONFIG_HEAP_MEM_POOL_SIZE=8192
CONFIG_SYSTEM_WORKQUEUE_STACK_SIZE=8192

# Network events
CONFIG_NET_CONNECTION_MANAGER=y
CONFIG_NET_CONFIG_SETTINGS=y

CONFIG_NET_IPV6=n

CONFIG_NET_IPV4=y
CONFIG_NET_DHCPV4=y

# Enable Shell
CONFIG_SHELL=y
CONFIG_SHELL_STACK_SIZE=8192
CONFIG_UPDATEHUB_SHELL=y
CONFIG_NET_SHELL=y

# Debug helpers
CONFIG_LOG=y
CONFIG_LOG_STRDUP_BUF_COUNT=20
#CONFIG_UPDATEHUB_LOG_LEVEL_DBG=y
```

## overlay-802154.conf
```kconfig
# Copyright (c) 2020 O.S.Systems
# SPDX -License-Identifier: Apache-2.0

# Disable default configs
CONFIG_BT=n

CONFIG_NET_L2_ETHERNET=n

CONFIG_NET_IPV4=n
CONFIG_NET_DHCPV4=n
CONFIG_NET_TCP=n

# Enable IEEE 802.15.4
CONFIG_NET_L2_IEEE802154=y
CONFIG_NET_L2_IEEE802154_SHELL=y

CONFIG_NET_CONFIG_IEEE802154_PAN_ID=0xcafe
CONFIG_NET_CONFIG_IEEE802154_CHANNEL=26

CONFIG_NET_IPV6=y
CONFIG_NET_IPV6_FRAGMENT=y
CONFIG_NET_6LO_CONTEXT=y
CONFIG_NET_MAX_6LO_CONTEXTS=10

CONFIG_NET_IF_UNICAST_IPV6_ADDR_COUNT=3
CONFIG_NET_IF_MCAST_IPV6_ADDR_COUNT=4
CONFIG_NET_MAX_CONTEXTS=10

CONFIG_NET_UDP=y

# Add DNS Server
CONFIG_DNS_SERVER_IP_ADDRESSES=y
CONFIG_DNS_SERVER1="2001:db8::1"

# UpdateHub
CONFIG_UPDATEHUB_SERVER="2001:db8::1"
CONFIG_UPDATEHUB_COAP_BLOCK_SIZE_EXP=2
```

## overlay-dtls.conf
```kconfig
#
# Copyright (c) 2019 O.S.Systems
#
# SPDX-License-Identifier: Apache-2.0
#

CONFIG_UPDATEHUB_DTLS=y
#Minimal TLS configuration
CONFIG_MAIN_STACK_SIZE=3000
CONFIG_NET_BUF_RX_COUNT=50
CONFIG_MBEDTLS_HEAP_SIZE=60000
# End tls configs
```

## overlay-ipsp.conf
```kconfig
# Copyright (c) 2020 O.S.Systems
# SPDX -License-Identifier: Apache-2.0

# Disable default configs
CONFIG_NET_L2_IEEE802154=n

CONFIG_NET_IPV4=n
CONFIG_NET_DHCPV4=n
CONFIG_NET_TCP=n

# Enable Bluetooth LE IPSP
CONFIG_BT=y
CONFIG_BT_SMP=y
CONFIG_BT_PERIPHERAL=y
CONFIG_BT_CENTRAL=y
CONFIG_BT_L2CAP_DYNAMIC_CHANNEL=y
CONFIG_BT_DEVICE_NAME="UpdateHub - IPSP"

CONFIG_NET_CONFIG_BT_NODE=y
CONFIG_NET_CONFIG_AUTO_INIT=y

CONFIG_NET_L2_BT=y
CONFIG_NET_L2_BT_SHELL=y

CONFIG_NET_IPV6=y
CONFIG_NET_IPV6_FRAGMENT=y
CONFIG_NET_6LO_CONTEXT=y
CONFIG_NET_MAX_6LO_CONTEXTS=10

CONFIG_NET_IF_UNICAST_IPV6_ADDR_COUNT=3
CONFIG_NET_IF_MCAST_IPV6_ADDR_COUNT=2
CONFIG_NET_MAX_CONTEXTS=10

CONFIG_NET_UDP=y

# Add DNS Server
CONFIG_DNS_SERVER_IP_ADDRESSES=y
CONFIG_DNS_SERVER1="2001:de8::1"

# UpdateHub
CONFIG_UPDATEHUB_SERVER="2001:de8::1"
CONFIG_UPDATEHUB_COAP_BLOCK_SIZE_EXP=2
```

## overlay-modem.conf
```kconfig
# Copyright (c) 2020 O.S.Systems
# SPDX-License-Identifier: Apache-2.0

# Disable default configs
CONFIG_NET_L2_ETHERNET=n

CONFIG_NET_DHCPV4=n

CONFIG_NET_CONFIG_SETTINGS=n

# UART support
CONFIG_SERIAL=y

# GSM modem support
CONFIG_MODEM=y
CONFIG_MODEM_SHELL=y
CONFIG_MODEM_GSM_PPP=y
CONFIG_MODEM_GSM_UART_NAME="arduino_serial"
CONFIG_MODEM_GSM_APN="<Your Access Point Network>"

# PPP networking support
CONFIG_NET_NATIVE=y
CONFIG_NET_PPP=y
CONFIG_NET_L2_PPP=y
CONFIG_NET_L2_PPP_TIMEOUT=10000

CONFIG_DNS_SERVER_IP_ADDRESSES=y
CONFIG_DNS_SERVER1="8.8.8.8"
```

## overlay-ot.conf
```kconfig
# Copyright (c) 2020 O.S.Systems
# SPDX -License-Identifier: Apache-2.0

# Disable default configs
CONFIG_BT=n

CONFIG_NET_L2_ETHERNET=n
CONFIG_NET_L2_IEEE802154=n

CONFIG_NET_IPV4=n
CONFIG_NET_DHCPV4=n
CONFIG_NET_TCP=n

# Enable OpenThread network
CONFIG_NET_L2_OPENTHREAD=y

CONFIG_OPENTHREAD_DEBUG=y
CONFIG_OPENTHREAD_L2_DEBUG=y
CONFIG_OPENTHREAD_L2_LOG_LEVEL_INF=y

# Enable OpenThread shell
CONFIG_SHELL=y
CONFIG_OPENTHREAD_SHELL=y

# This follows https://openthread.io/guides/border-router guides
# It uses the default values from otbr-web page
CONFIG_OPENTHREAD_PANID=4660
CONFIG_OPENTHREAD_CHANNEL=15
CONFIG_OPENTHREAD_NETWORK_NAME="OpenThreadDemo"
CONFIG_OPENTHREAD_XPANID="0x1111111122222222"
CONFIG_OPENTHREAD_JOINER=y
CONFIG_OPENTHREAD_JOINER_AUTOSTART=y
CONFIG_OPENTHREAD_JOINER_PSKD="J01NU5"
CONFIG_OPENTHREAD_SLAAC=y

CONFIG_NET_IPV6_NBR_CACHE=n
CONFIG_NET_IPV6_MLD=n

# mbedTLS tweaks
CONFIG_MBEDTLS_SSL_MAX_CONTENT_LEN=768

# UpdateHub
CONFIG_MAIN_STACK_SIZE=8192
CONFIG_UPDATEHUB_COAP_BLOCK_SIZE_EXP=2

# Only tested with 6to4
#
#######################
CONFIG_DNS_SERVER_IP_ADDRESSES=y
# Add google IPv4 DNS Server
# https://www.ultratools.com/tools/ipv4toipv6Result?address=8.8.8.8
# Mapped Address: 0:0:0:0:0:ffff:808:808
# Extract value                 >808:808<
# Add prefix        64:ff9b::
CONFIG_DNS_SERVER1="64:ff9b::808:808"
# Repeat the above step with your server IPv4 address translated to IPv6
CONFIG_UPDATEHUB_SERVER="<your server ip address>"
```

## overlay-wifi.conf
```kconfig
# Copyright (c) 2020 O.S.Systems
# SPDX -License-Identifier: Apache-2.0

# Disable default configs
CONFIG_NET_L2_ETHERNET=n

CONFIG_NET_DHCPV4=n

CONFIG_NET_CONFIG_SETTINGS=n

# Enable WIFI
CONFIG_WIFI=y
CONFIG_UPDATEHUB_SAMPLE_WIFI_SSID="<SSID>"
CONFIG_UPDATEHUB_SAMPLE_WIFI_PSK="<PASSWD>"

CONFIG_NET_PKT_RX_COUNT=8
CONFIG_NET_PKT_TX_COUNT=8
CONFIG_NET_BUF_RX_COUNT=20
CONFIG_NET_BUF_TX_COUNT=20

# Add DNS Server
CONFIG_DNS_SERVER_IP_ADDRESSES=y
CONFIG_DNS_SERVER1="8.8.8.8"
```

## arduino.overlay
```dts
/*
 * Copyright (c) 2020 O.S.Systems
 *
 * SPDX-License-Identifier: Apache-2.0
 */

&arduino_serial {
	status = "okay";
	label = "arduino_serial";

	current-speed = <115200>;
};
```

## src/main.c
```c
/*
 * Copyright (c) 2018-2020 O.S.Systems
 *
 * SPDX-License-Identifier: Apache-2.0
 */

#include <zephyr.h>
#include <updatehub.h>
#include <net/net_mgmt.h>
#include <net/net_event.h>
#include <net/net_conn_mgr.h>
#include <net/wifi_mgmt.h>
#include <dfu/mcuboot.h>

#if defined(CONFIG_UPDATEHUB_DTLS)
#include <net/tls_credentials.h>
#include "c_certificates.h"
#endif

#include <logging/log.h>
LOG_MODULE_REGISTER(main);

#define EVENT_MASK (NET_EVENT_L4_CONNECTED | \
		    NET_EVENT_L4_DISCONNECTED)

static struct net_mgmt_event_callback mgmt_cb;

void start_updatehub(void)
{
#if defined(CONFIG_UPDATEHUB_SAMPLE_POLLING)
	LOG_INF("Starting UpdateHub polling mode");
	updatehub_autohandler();
#endif

#if defined(CONFIG_UPDATEHUB_SAMPLE_MANUAL)
	LOG_INF("Starting UpdateHub manual mode");

	switch (updatehub_probe()) {
	case UPDATEHUB_HAS_UPDATE:
		switch (updatehub_update()) {
		case UPDATEHUB_OK:
			ret = 0;
			sys_reboot(SYS_REBOOT_WARM);
			break;

		default:
			LOG_ERR("Error installing update.");
			break;
		}

	case UPDATEHUB_NO_UPDATE:
		LOG_INF("No update found");
		ret = 0;
		break;

	default:
		LOG_ERR("Invalid response");
		break;
	}
#endif
}

static void event_handler(struct net_mgmt_event_callback *cb,
			  uint32_t mgmt_event, struct net_if *iface)
{
	if ((mgmt_event & EVENT_MASK) != mgmt_event) {
		return;
	}

	if (mgmt_event == NET_EVENT_L4_CONNECTED) {
		LOG_INF("Network connected");
		start_updatehub();
		return;
	}

	if (mgmt_event == NET_EVENT_L4_DISCONNECTED) {
		LOG_INF("Network disconnected");
		return;
	}
}

void main(void)
{
	int ret;

	LOG_INF("UpdateHub sample app started");

#if defined(CONFIG_UPDATEHUB_DTLS)
	if (tls_credential_add(CA_CERTIFICATE_TAG,
			       TLS_CREDENTIAL_SERVER_CERTIFICATE,
			       server_certificate,
			       sizeof(server_certificate)) < 0) {
		LOG_ERR("Failed to register server certificate");
		return;
	}

	if (tls_credential_add(CA_CERTIFICATE_TAG,
			       TLS_CREDENTIAL_PRIVATE_KEY,
			       private_key,
			       sizeof(private_key)) < 0) {
		LOG_ERR("Failed to register private key");
		return;
	}
#endif

	/* The image of application needed be confirmed */
	LOG_INF("Confirming the boot image");
	ret = boot_write_img_confirmed();
	if (ret < 0) {
		LOG_ERR("Error to confirm the image");
	}

#if defined(CONFIG_WIFI)
	int nr_tries = 10;
	struct net_if *iface = net_if_get_default();
	static struct wifi_connect_req_params cnx_params = {
		.ssid = CONFIG_UPDATEHUB_SAMPLE_WIFI_SSID,
		.ssid_length = 0,
		.psk = CONFIG_UPDATEHUB_SAMPLE_WIFI_PSK,
		.psk_length = 0,
		.channel = 0,
		.security = WIFI_SECURITY_TYPE_PSK,
	};

	cnx_params.ssid_length = strlen(CONFIG_UPDATEHUB_SAMPLE_WIFI_SSID);
	cnx_params.psk_length = strlen(CONFIG_UPDATEHUB_SAMPLE_WIFI_PSK);

	/* Let's wait few seconds to allow wifi device be on-line */
	while (nr_tries-- > 0) {
		ret = net_mgmt(NET_REQUEST_WIFI_CONNECT, iface, &cnx_params,
			       sizeof(struct wifi_connect_req_params));
		if (ret == 0) {
			break;
		}

		LOG_INF("Connect request failed %d. Waiting iface be up...", ret);
		k_msleep(500);
	}

#elif defined(CONFIG_MODEM_GSM_PPP)
	const struct device *uart_dev =
		device_get_binding(CONFIG_MODEM_GSM_UART_NAME);

	LOG_INF("APN '%s' UART '%s' device %p", CONFIG_MODEM_GSM_APN,
		CONFIG_MODEM_GSM_UART_NAME, uart_dev);
#endif

	net_mgmt_init_event_callback(&mgmt_cb, event_handler, EVENT_MASK);
	net_mgmt_add_event_callback(&mgmt_cb);
	net_conn_mgr_resend_status();
}
```

## src/c_certificates.h
```c
/*
 * Copyright (c) 2019 O.S.Systems
 *
 * SPDX-License-Identifier: Apache-2.0
 */

#ifndef __CERTIFICATE_H__
#define __CERTIFICATE_H__

#if defined(CONFIG_UPDATEHUB_DTLS)
#define CA_CERTIFICATE_TAG 1

static const unsigned char server_certificate[] = {
    #include "servercert.der.inc"
};


static const unsigned char private_key[] = {
    #include "privkey.der.inc"
};

#endif
#endif /* __CERTIFICATE_H__ */
```
