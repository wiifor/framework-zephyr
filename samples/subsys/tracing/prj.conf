## CMakeLists.txt
```
# SPDX-License-Identifier: Apache-2.0

cmake_minimum_required(VERSION 3.13.1)

if(BOARD MATCHES "qemu_.*")
  list(APPEND QEMU_EXTRA_FLAGS -serial file:channel0_0)
endif()

find_package(Zephyr REQUIRED HINTS $ENV{ZEPHYR_BASE})
project(tracing_tests)

target_sources(app PRIVATE src/main.c)
```

## sample.yaml
```
common:
    tags: tracing debug
    harness: console
    harness_config:
      type: multi_line
      regex:
        - "thread_a: Hello World from (.*)!"
        - "thread_b: Hello World from (.*)!"
tests:
  tracing.format.sysview:
    platform_allow: nrf52840dk_nrf52840 mimxrt1050_evk mimxrt1064_evk
    extra_args: CONF_FILE="prj_sysview.conf"
  tracing.osawareness.openocd:
    extra_configs:
      - CONFIG_MP_NUM_CPUS=1
      - CONFIG_DEBUG_THREAD_INFO=y
      - CONFIG_SMP=n
    arch_exclude: posix xtensa
    platform_exclude: qemu_x86_64
  tracing.transport.uart:
    platform_allow: qemu_x86 qemu_x86_64
    extra_args: CONF_FILE="prj_uart.conf"
  tracing.transport.usb:
    platform_allow: sam_e70_xplained
    depends_on: usb_device
    extra_args: CONF_FILE="prj_usb.conf"
  tracing.transport.ctf:
    platform_allow: qemu_x86 qemu_x86_64
    extra_args: CONF_FILE="prj_uart_ctf.conf"
  tracing.transport.ctf:
    platform_allow: sam_e70_xplained
    depends_on: usb_device
    extra_args: CONF_FILE="prj_usb_ctf.conf"
  tracing.transport.native_posix:
    platform_allow: native_posix
    extra_args: CONF_FILE="prj_native_posix.conf"
  tracing.transport.posix.ctf:
    platform_allow: native_posix
    extra_args: CONF_FILE="prj_native_posix_ctf.conf"
```

## prj.conf
```kconfig
# enable to use thread names
```

## prj_native_posix.conf
```kconfig
CONFIG_TRACING=y
CONFIG_TRACING_TEST=y
CONFIG_TRACING_SYNC=y
CONFIG_TRACING_BACKEND_POSIX=y
CONFIG_TRACING_PACKET_MAX_SIZE=64
```

## prj_native_posix_ctf.conf
```kconfig
CONFIG_TRACING=y
CONFIG_TRACING_CTF=y
CONFIG_TRACING_SYNC=y
CONFIG_TRACING_BACKEND_POSIX=y
CONFIG_TRACING_PACKET_MAX_SIZE=64
```

## prj_sysview.conf
```kconfig
CONFIG_TRACING=y
CONFIG_SEGGER_SYSTEMVIEW=y
CONFIG_IDLE_STACK_SIZE=2048
```

## prj_uart.conf
```kconfig
CONFIG_IDLE_STACK_SIZE=4096
CONFIG_TRACING=y
CONFIG_TRACING_TEST=y
CONFIG_TRACING_BACKEND_UART=y
CONFIG_TRACING_BUFFER_SIZE=4096

CONFIG_TRACING_BACKEND_UART_NAME="UART_1"
```

## prj_uart_ctf.conf
```kconfig
CONFIG_TRACING=y
CONFIG_TRACING_CTF=y
CONFIG_TRACING_BACKEND_UART=y
CONFIG_TRACING_BUFFER_SIZE=4096
CONFIG_TRACING_BACKEND_UART_NAME="UART_1"
```

## prj_usb.conf
```kconfig
CONFIG_GPIO=y
CONFIG_USB=y
CONFIG_USB_DEVICE_STACK=y
CONFIG_USB_DEVICE_VID=0x2FE9

CONFIG_TRACING=y
CONFIG_TRACING_TEST=y
CONFIG_TRACING_BACKEND_USB=y
CONFIG_TRACING_BUFFER_SIZE=4096
CONFIG_TRACING_HANDLE_HOST_CMD=y
```

## src/main.c
```c
/*
 * Copyright (c) 2019 Intel Corporation
 * Copyright (c) 2012-2014 Wind River Systems, Inc.
 *
 * SPDX-License-Identifier: Apache-2.0
 */

#include <zephyr.h>
#include <sys/printk.h>
#include <logging/log.h>
#include <usb/usb_device.h>

/*
 * The hello world demo has two threads that utilize semaphores and sleeping
 * to take turns printing a greeting message at a controlled rate. The demo
 * shows both the static and dynamic approaches for spawning a thread; a real
 * world application would likely use the static approach for both threads.
 */


/* size of stack area used by each thread */
#define STACKSIZE (1024 + CONFIG_TEST_EXTRA_STACKSIZE)

/* scheduling priority used by each thread */
#define PRIORITY 7

/* delay between greetings (in ms) */
#define SLEEPTIME 500


/*
 * @param my_name      thread identification string
 * @param my_sem       thread's own semaphore
 * @param other_sem    other thread's semaphore
 */
void helloLoop(const char *my_name,
	       struct k_sem *my_sem, struct k_sem *other_sem)
{
	const char *tname;

	while (1) {
		/* take my semaphore */
		k_sem_take(my_sem, K_FOREVER);

		/* say "hello" */
		tname = k_thread_name_get(k_current_get());
		if (tname == NULL) {
			printk("%s: Hello World from %s!\n",
				my_name, CONFIG_BOARD);
		} else {
			printk("%s: Hello World from %s!\n",
				tname, CONFIG_BOARD);
		}

		/* wait a while, then let other thread have a turn */
		k_msleep(SLEEPTIME);
		k_sem_give(other_sem);
	}
}

/* define semaphores */

K_SEM_DEFINE(threadA_sem, 1, 1);	/* starts off "available" */
K_SEM_DEFINE(threadB_sem, 0, 1);	/* starts off "not available" */


/* threadB is a dynamic thread that is spawned by threadA */

void threadB(void *dummy1, void *dummy2, void *dummy3)
{
	ARG_UNUSED(dummy1);
	ARG_UNUSED(dummy2);
	ARG_UNUSED(dummy3);

	/* invoke routine to ping-pong hello messages with threadA */
	helloLoop(__func__, &threadB_sem, &threadA_sem);
}

K_THREAD_STACK_DEFINE(threadB_stack_area, STACKSIZE);
static struct k_thread threadB_data;

/* threadA is a static thread that is spawned automatically */

void threadA(void *dummy1, void *dummy2, void *dummy3)
{
	ARG_UNUSED(dummy1);
	ARG_UNUSED(dummy2);
	ARG_UNUSED(dummy3);

#if (defined(CONFIG_USB) && defined(CONFIG_USB_DEVICE_STACK))
	int ret;

	ret = usb_enable(NULL);
	if (ret) {
		printk("usb backend enable failed");
		return;
	}
#endif /* CONFIG_USB */

	/* spawn threadB */
	k_tid_t tid = k_thread_create(&threadB_data, threadB_stack_area,
			STACKSIZE, threadB, NULL, NULL, NULL,
			PRIORITY, 0, K_NO_WAIT);

	k_thread_name_set(tid, "thread_b");

	/* invoke routine to ping-pong hello messages with threadB */
	helloLoop(__func__, &threadA_sem, &threadB_sem);
}

K_THREAD_DEFINE(thread_a, STACKSIZE, threadA, NULL, NULL, NULL,
		PRIORITY, 0, 0);
```
