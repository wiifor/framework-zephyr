## CMakeLists.txt
```
# SPDX-License-Identifier: Apache-2.0

cmake_minimum_required(VERSION 3.13.1)
find_package(Zephyr REQUIRED HINTS $ENV{ZEPHYR_BASE})
project(dfu)

FILE(GLOB app_sources src/*.c)
target_sources(app PRIVATE ${app_sources})
```

## Kconfig
```
# Copyright (c) 2019 Nordic Semiconductor ASA
# SPDX-License-Identifier: Apache-2.0

config USB_DEVICE_PID
	default USB_PID_DFU_SAMPLE

source "Kconfig.zephyr"
```

## sample.yaml
```
sample:
  name: USB DFU sample
tests:
  sample.usb.dfu:
    build_only: True
    platform_exclude: native_posix native_posix_64 mimxrt1010_evk
      mimxrt1050_evk_qspi mimxrt1020_evk mimxrt1015_evk mimxrt1060_evk
      mimxrt1050_evk mimxrt1060_evk_hyperflash nucleo_f207zg
    depends_on: usb_device
    filter: dt_compat_enabled_with_label("fixed-partitions", "slot0_partition") and
            dt_compat_enabled_with_label("fixed-partitions", "slot1_partition") and
            dt_chosen_enabled("zephyr,flash-controller") and
            CONFIG_FLASH_HAS_DRIVER_ENABLED
    tags: usb
    integration_platforms:
        - nrf52840dk_nrf52840
        - frdm_k64f
```

## prj.conf
```kconfig
CONFIG_STDOUT_CONSOLE=y
CONFIG_GPIO=y
CONFIG_USB=y
CONFIG_USB_DEVICE_STACK=y
CONFIG_USB_DEVICE_PRODUCT="Zephyr DFU sample"
CONFIG_USB_DFU_CLASS=y
CONFIG_FLASH=y
CONFIG_IMG_MANAGER=y
CONFIG_FLASH_PAGE_LAYOUT=y
CONFIG_LOG=y
CONFIG_USB_DRIVER_LOG_LEVEL_ERR=y
CONFIG_USB_DEVICE_LOG_LEVEL_ERR=y
CONFIG_BOOTLOADER_MCUBOOT=y
```

## src/main.c
```c
/*
 * Copyright (c) 2016 Intel Corporation
 * Copyright (c) 2017 Phytec Messtechnik GmbH
 *
 * SPDX-License-Identifier: Apache-2.0
 */

/* Sample app for USB DFU class driver. */

#include <zephyr.h>
#include <logging/log.h>
#include <usb/usb_device.h>
LOG_MODULE_REGISTER(main);

void main(void)
{
	int ret;

	ret = usb_enable(NULL);
	if (ret != 0) {
		LOG_ERR("Failed to enable USB");
		return;
	}

	LOG_INF("This device supports USB DFU class.\n");
}
```
