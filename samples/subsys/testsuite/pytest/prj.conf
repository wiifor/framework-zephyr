## CMakeLists.txt
```
# SPDX-License-Identifier: Apache-2.0

cmake_minimum_required(VERSION 3.13.1)
find_package(Zephyr REQUIRED HINTS $ENV{ZEPHYR_BASE})
project(pytest_sample)

target_sources(app PRIVATE src/main.c)
```

## prj.conf
```kconfig
CONFIG_ZTEST=y
CONFIG_IDLE_STACK_SIZE=4096
```

## src/main.c
```c
/*
 * Copyright (c) 2020 Intel Corporation
 *
 * SPDX-License-Identifier: Apache-2.0
 */
#include <ztest.h>
void test_pytest(void)
{
	TC_PRINT("Hello world\n");
}

void test_main(void)
{
	ztest_test_suite(test_pytest,
			 ztest_unit_test(test_pytest)
			 );

	ztest_run_test_suite(test_pytest);
}
```
