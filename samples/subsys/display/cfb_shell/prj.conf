## sample.yaml
```
common:
  harness: display
  tags: display
sample:
  description: Character framebuffer shell test
  name: cfb shell sample
tests:
  sample.display.cfb_shell.ssd1306:
    platform_allow: frdm_k64f
    extra_args: SHIELD=ssd1306_128x32
    tags: shield
  sample.display.cfb_shell.ssd16xx:
    platform_allow: reel_board
```

## prj.conf
```kconfig
CONFIG_BOOT_BANNER=n
CONFIG_HEAP_MEM_POOL_SIZE=16384
CONFIG_DISPLAY=y
CONFIG_CHARACTER_FRAMEBUFFER=y
CONFIG_SHELL=y
CONFIG_CHARACTER_FRAMEBUFFER_SHELL=y
```

## src/main.c
```c
/*
 * Copyright (c) 2018 Diego Sueiro
 *
 * SPDX-License-Identifier: Apache-2.0
 */

#include <logging/log.h>

LOG_MODULE_REGISTER(app);
```
