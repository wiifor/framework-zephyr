## CMakeLists.txt
```
# SPDX-License-Identifier: Apache-2.0

cmake_minimum_required(VERSION 3.13.1)
find_package(Zephyr REQUIRED HINTS $ENV{ZEPHYR_BASE})
project(getline)

target_sources(app PRIVATE src/main.c)
```

## sample.yaml
```
sample:
  name: getline Sample
tests:
  sample.console.getline:
    integration_platforms:
      - mps2_an385
    filter: CONFIG_UART_CONSOLE and CONFIG_SERIAL_SUPPORT_INTERRUPT
    tags: console
    harness: keyboard
```

## prj.conf
```kconfig
CONFIG_CONSOLE_SUBSYS=y
CONFIG_CONSOLE_GETLINE=y
```

## src/main.c
```c
/*
 * Copyright (c) 2017 Linaro Limited
 *
 * SPDX-License-Identifier: Apache-2.0
 */

#include <string.h>
#include <zephyr.h>
#include <sys/printk.h>
#include <console/console.h>

void main(void)
{
	console_getline_init();

	printk("Enter a line\n");

	while (1) {
		char *s = console_getline();

		printk("line: %s\n", s);
		printk("last char was: 0x%x\n", s[strlen(s) - 1]);
	}
}
```
