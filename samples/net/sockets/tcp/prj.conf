## CMakeLists.txt
```
# SPDX-License-Identifier: Apache-2.0

cmake_minimum_required(VERSION 3.13.1)

find_package(Zephyr REQUIRED HINTS $ENV{ZEPHYR_BASE})
project(tcp)

target_include_directories(app PRIVATE ${ZEPHYR_BASE}/subsys/net/ip)

target_sources(app PRIVATE src/main.c)
```

## sample.yaml
```
sample:
  description: A sample for running TTCN-3 based sanity check for TCP2
  name: tcp
```

## prj.conf
```kconfig
CONFIG_NEWLIB_LIBC=y

CONFIG_NETWORKING=y

CONFIG_NET_SOCKETS=y
CONFIG_NET_SOCKETS_POSIX_NAMES=y

CONFIG_NET_IPV4=y
CONFIG_NET_IPV6=y

CONFIG_NET_CONFIG_SETTINGS=y

CONFIG_NET_CONFIG_MY_IPV4_ADDR="192.0.2.1"
CONFIG_NET_CONFIG_PEER_IPV4_ADDR="192.0.2.2"

CONFIG_NET_CONFIG_MY_IPV6_ADDR="2001:db8::1"
CONFIG_NET_CONFIG_PEER_IPV6_ADDR="2001:db8::2"

CONFIG_NET_TCP=y

CONFIG_HEAP_MEM_POOL_SIZE=8192

CONFIG_JSON_LIBRARY=y

CONFIG_NET_TEST_PROTOCOL=y

CONFIG_THREAD_NAME=y
```

## overlay-debug.conf
```kconfig
CONFIG_NO_OPTIMIZATIONS=y
CONFIG_DEBUG=y

CONFIG_ASSERT=y
CONFIG_STACK_SENTINEL=y

CONFIG_STACK_CANARIES=y
```

## overlay-log-extra.conf
```kconfig
#CONFIG_NET_IF_LOG_LEVEL_DBG=y
#CONFIG_NET_L2_ETHERNET_LOG_LEVEL_DBG=y

#CONFIG_SLIP_LOG_LEVEL_DBG=y

CONFIG_ETHERNET_LOG_LEVEL_DBG=y
```

## overlay-log-extra2.conf
```kconfig
#CONFIG_NET_IF_LOG_LEVEL_DBG=y
#CONFIG_NET_L2_ETHERNET_LOG_LEVEL_DBG=y

CONFIG_SLIP_LOG_LEVEL_DBG=y

CONFIG_ETH_E1000_VERBOSE_DEBUG=y
```

## overlay-log-pkt.conf
```kconfig
CONFIG_NET_PKT_LOG_LEVEL_DBG=y

CONFIG_NET_BUF_LOG=y
CONFIG_NET_BUF_LOG_LEVEL_DBG=y
```

## overlay-log.conf
```kconfig
CONFIG_LOG=y
CONFIG_LOG_MODE_IMMEDIATE=y
CONFIG_LOG_BACKEND_SHOW_COLOR=n

CONFIG_NET_LOG=y

#CONFIG_NET_IF_LOG_LEVEL_DBG=y
#CONFIG_NET_L2_ETHERNET_LOG_LEVEL_DBG=y

CONFIG_NET_SOCKETS_LOG_LEVEL_DBG=y
CONFIG_NET_CONN_LOG_LEVEL_DBG=y
CONFIG_NET_CONTEXT_LOG_LEVEL_DBG=y

CONFIG_NET_TCP_LOG_LEVEL_DBG=y
```

## overlay-max-stacks.conf
```kconfig
CONFIG_NET_MGMT_EVENT_STACK_SIZE=65535
CONFIG_PRIVILEGED_STACK_SIZE=65535
CONFIG_NET_TX_STACK_SIZE=130944
CONFIG_NET_RX_STACK_SIZE=130944
CONFIG_SYSTEM_WORKQUEUE_STACK_SIZE=65535
CONFIG_MAIN_STACK_SIZE=65535
CONFIG_IDLE_STACK_SIZE=65535
CONFIG_ISR_STACK_SIZE=65535
CONFIG_LOG_PROCESS_THREAD_STACK_SIZE=65535
```

## src/main.c
```c
/*
 * Copyright (c) 2020 Intel Corporation
 *
 * SPDX-License-Identifier: Apache-2.0
 */

/* TCP Sample for TTCN-3 based Sanity Check */

#include <stdio.h>
#include <stdlib.h>
#include <errno.h>

#include <net/socket.h>

#include <data/json.h>
#include <tp.h>

#define UDP_PORT 4242

#define perror(fmt, args...)						\
do {									\
	printf("Error: " fmt "(): %s\n" ## args, strerror(errno));	\
	exit(errno);							\
} while (0)								\

/*
 * This application is used together with the TTCN-3 based sanity check
 * to validate the functionality of the experimental TCP (TCP2).
 *
 * samples/net/sockets/tcp/README.rst
 *
 * Eventually UDP based test protocol might be terminated in the user space
 * (see udp() below), but at the moment it's just a dummy loop
 * to keep the sample running in order to execute TTCN-3 TCP2 sanity check.
 */
void main(void)
{
	while (true) {
		k_sleep(K_SECONDS(1));
	}
}

void udp(void)
{
	int fd = socket(AF_INET, SOCK_DGRAM, 0);

	if (fd < 0) {
		perror("socket");
	}

	{
		struct sockaddr_in sin;

		sin.sin_family = AF_INET;
		sin.sin_addr.s_addr = htonl(INADDR_ANY);
		sin.sin_port = htons(UDP_PORT);

		if (bind(fd, (struct sockaddr *)&sin, sizeof(sin)) < 0) {
			perror("bind");
		}

		printf("Listening on UDP port %d\n", UDP_PORT);
	}

	{
#ifndef BUF_SIZE
#define BUF_SIZE 4096
#endif
		char *buf = malloc(BUF_SIZE);

		if (buf == NULL) {
			perror("malloc");
		}

		for (;;) {
			ssize_t len = recv(fd, buf, BUF_SIZE, 0);

			if (len < 0) {
				perror("recv");
			}

			printf("Received %ld bytes\n", (long)len);
		}
	}
}
```
