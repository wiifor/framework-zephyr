## CMakeLists.txt
```
# Copyright (c) 2020 Alexander Kozhinov <AlexanderKozhinov@yandex.com>
#
# SPDX-License-Identifier: Apache-2.0

cmake_minimum_required(VERSION 3.13.1)

set(common_dir ${CMAKE_CURRENT_SOURCE_DIR}/../common)
set(common_src_dir ${common_dir}/src)
set(common_include_dir ${common_dir}/include)

set(inc_dir ${CMAKE_CURRENT_SOURCE_DIR}/include)
set(src_dir ${CMAKE_CURRENT_SOURCE_DIR}/src)

include_directories(
	${inc_dir}
	${common_include_dir}
)

option(CIVETWEB_ENABLE_WEBSOCKETS "Enable websockets connections" ON)

find_package(Zephyr REQUIRED HINTS $ENV{ZEPHYR_BASE})
project(civetweb_websocket_server)

target_sources(app PRIVATE
		${src_dir}/main.c
		${common_src_dir}/libc_extensions.c
		${src_dir}/http_server_handlers.c
		${src_dir}/websocket_server_handlers.c)

set(gen_dir ${ZEPHYR_BINARY_DIR}/include/generated/)
set(web_page_dir web_page)

file(MAKE_DIRECTORY ${gen_dir}/${web_page_dir})

# List of files that are used to generate .h file that can be included
# into .c file.
foreach(inc_file
	${web_page_dir}/index.html
	${web_page_dir}/index.css
	${web_page_dir}/ws.js)

	# Generate normal and gzipped versions of each file:
	generate_inc_file_for_target(app
		${inc_file}
		${gen_dir}/${inc_file}.inc)

	generate_inc_file_for_target(app
		${inc_file}
		${gen_dir}/${inc_file}.gz.inc
		--gzip)

endforeach()

include(${ZEPHYR_BASE}/samples/net/common/common.cmake)
```

## sample.yaml
```
sample:
  description: Civetweb WebSocket Server sample
  name: websocket_server
tests:
  sample.net.civetweb.websocket_server:
    platform_allow: nucleo_h745zi_q_m7
```

## prj.conf
```kconfig
# General config
CONFIG_CIVETWEB=y

# pthreads
CONFIG_POSIX_API=y
CONFIG_PTHREAD_IPC=y
CONFIG_POSIX_MQUEUE=y

# networking
CONFIG_NETWORKING=y
CONFIG_NET_IPV4=y
# CONFIG_NET_IPV6 is not set
CONFIG_NET_TCP=y
CONFIG_NET_SOCKETS=y

CONFIG_DNS_RESOLVER=y

CONFIG_NET_CONFIG_SETTINGS=y
CONFIG_NET_CONFIG_MY_IPV4_ADDR="192.0.2.1"
CONFIG_NET_CONFIG_MY_IPV4_NETMASK="255.255.255.0"
CONFIG_NET_CONFIG_MY_IPV4_GW="192.0.2.2"
CONFIG_NET_CONFIG_PEER_IPV4_ADDR="192.0.2.2"

# memory settings:
CONFIG_MINIMAL_LIBC_MALLOC_ARENA_SIZE=16384
CONFIG_NET_TX_STACK_SIZE=2048
CONFIG_NET_RX_STACK_SIZE=2048

CONFIG_ISR_STACK_SIZE=2048
CONFIG_MAIN_STACK_SIZE=2048
CONFIG_IDLE_STACK_SIZE=1024

# logging:
CONFIG_LOG=y
# CONFIG_NET_LOG=y
# CONFIG_LOG_STRDUP_MAX_STRING=256

# Do not include mbedtls via this option as civetweb does not
# work properly with mbedtls.
CONFIG_NET_TCP_ISN_RFC6528=n
```

## src/main.c
```c
/*
 * Copyright (c) 2020 Alexander Kozhinov <AlexanderKozhinov@yandex.com>
 *
 * SPDX-License-Identifier: Apache-2.0
 */

#include <logging/log.h>
LOG_MODULE_REGISTER(main, LOG_LEVEL_DBG);

#include <zephyr.h>
#include <posix/pthread.h>

#include "civetweb.h"

#include "http_server_handlers.h"
#include "websocket_server_handlers.h"

#define HTTP_PORT	8080
#define HTTPS_PORT	4443

#define CIVETWEB_MAIN_THREAD_STACK_SIZE		CONFIG_MAIN_STACK_SIZE

/* Use smallest possible value of 1024 (see the line 18619 of civetweb.c) */
#define MAX_REQUEST_SIZE_BYTES			1024

K_THREAD_STACK_DEFINE(civetweb_stack, CIVETWEB_MAIN_THREAD_STACK_SIZE);

void *main_pthread(void *arg)
{
	static const char * const options[] = {
		"listening_ports", STRINGIFY(HTTP_PORT),
		"num_threads", "1",
		"max_request_size", STRINGIFY(MAX_REQUEST_SIZE_BYTES),
		NULL
	};

	struct mg_callbacks callbacks;
	struct mg_context *ctx;

	(void)arg;

	memset(&callbacks, 0, sizeof(callbacks));
	ctx = mg_start(&callbacks, NULL, (const char **)options);

	if (ctx == NULL) {
		LOG_ERR("Unable to start the server\n");
		return 0;
	}

	init_http_server_handlers(ctx);
	init_websocket_server_handlers(ctx);

	return 0;
}

void main(void)
{
	pthread_attr_t civetweb_attr;
	pthread_t civetweb_thread;

	(void)pthread_attr_init(&civetweb_attr);
	(void)pthread_attr_setstack(&civetweb_attr, &civetweb_stack,
				    CIVETWEB_MAIN_THREAD_STACK_SIZE);

	(void)pthread_create(&civetweb_thread, &civetweb_attr,
				&main_pthread, 0);

	LOG_INF("WebSocket Server was started!");
}
```

## include/http_server_handlers.h
```c
/*
 * Copyright (c) 2020 Alexander Kozhinov Mail: <AlexanderKozhinov@yandex.com>
 *
 * SPDX-License-Identifier: Apache-2.0
 */

#ifndef __HTTP_SERVER_HANDLERS__
#define __HTTP_SERVER_HANDLERS__

#include "civetweb.h"

void init_http_server_handlers(struct mg_context *ctx);

#endif  /* __HTTP_SERVER_HANDLERS__ */
```

## include/websocket_server_handlers.h
```c
/*
 * Copyright (c) 2020 Alexander Kozhinov <AlexanderKozhinov@yandex.com>
 *
 * SPDX-License-Identifier: Apache-2.0
 */

#ifndef __WEBSOCKET_SERVER_HANDLERS__
#define __WEBSOCKET_SERVER_HANDLERS__

#include "civetweb.h"

void init_websocket_server_handlers(struct mg_context *ctx);

#endif  /* __WEBSOCKET_SERVER_HANDLERS__ */
```

## src/http_server_handlers.c
```c
/*
 * Copyright (c) 2020 Alexander Kozhinov <AlexanderKozhinov@yandex.com>
 *
 * SPDX-License-Identifier: Apache-2.0
 */

#include <logging/log.h>
LOG_MODULE_REGISTER(http_server_handlers, LOG_LEVEL_DBG);

#include "http_server_handlers.h"

#define TX_CHUNK_SIZE_BYTES	CONFIG_NET_TX_STACK_SIZE

#define URL_MAIN		"/$"
#define URL_INDEX_CSS		"/index.css"
#define URL_INDEX_HTML		"/index.html"
#define URL_FAVICON_ICO		"/favicon.ico"
#define URL_WS_JS		"/ws.js"

#define HTTP_TEXT_HTML		"text/html"
#define HTTP_TEXT_CSS		"text/css"
#define HTTP_TEXT_JS		"text/javascript"
#define HTTP_EOFL		"\r\n"  /* http end of line */

#define HTTP_CONTEND_ENCODING	"Content-Encoding: "
#define HTTP_ENCODING_GZ	"gzip"

#define __code_decl	/* static */
#define __data_decl	static

__code_decl void this_register_handlers(struct mg_context *ctx);

__code_decl int this_send_buffer_chunked(struct mg_connection *conn,
					 const char *mime_type,
					 const char *buff,
					 const size_t buff_len);

__code_decl int this_redirect_2_index_html(struct mg_connection *conn,
					   void *cbdata);
__code_decl int this_index_html_handler(struct mg_connection *conn,
					void *cbdata);
__code_decl int this_index_css_handler(struct mg_connection *conn,
					void *cbdata);
__code_decl int this_ws_js_handler(struct mg_connection *conn,
				   void *cbdata);
__code_decl int this_favicon_ico_handler(struct mg_connection *conn,
					 void *cbdata);

__code_decl void this_set_return_value(int *ret_val);

void init_http_server_handlers(struct mg_context *ctx)
{
	this_register_handlers(ctx);
}

__code_decl void this_register_handlers(struct mg_context *ctx)
{
	mg_set_request_handler(ctx, URL_MAIN,
				this_redirect_2_index_html, NULL);
	mg_set_request_handler(ctx, URL_INDEX_HTML,
				this_index_html_handler, NULL);
	mg_set_request_handler(ctx, URL_INDEX_CSS,
				this_index_css_handler, NULL);
	mg_set_request_handler(ctx, URL_WS_JS,
				this_ws_js_handler, NULL);
	mg_set_request_handler(ctx, URL_FAVICON_ICO,
				this_favicon_ico_handler, NULL);
}

__code_decl int this_send_buffer_chunked(struct mg_connection *conn,
					 const char *mime_type,
					 const char *buff,
					 const size_t buff_len)
{
	int ret = 0;

	ret = mg_send_http_ok(conn, mime_type, -1);
	if (ret < 0) {
		goto error_this_send_buffer_chunked;
	}

	long left_bytes = buff_len;
	char *itr = (char *)buff;  /* buffer iterator */

	LOG_DBG("Transferring:");
	LOG_DBG("itr: 0x%08X ret: %d left_bytes: %ld chunk_size: %zd B",
		(unsigned int)itr, ret, left_bytes, TX_CHUNK_SIZE_BYTES);

	while (left_bytes > TX_CHUNK_SIZE_BYTES) {
		ret = mg_send_chunk(conn, itr, TX_CHUNK_SIZE_BYTES);
		itr += TX_CHUNK_SIZE_BYTES;
		left_bytes -= TX_CHUNK_SIZE_BYTES;

		LOG_DBG("itr: 0x%08X ret: %d left_bytes: %ld",
			(unsigned int)itr, ret, left_bytes);

		if (ret < 0) {
			goto error_this_send_buffer_chunked;
		}
	}

	if (left_bytes > 0) {
		ret = mg_send_chunk(conn, itr, left_bytes);
		itr += left_bytes;
		left_bytes = 0;

		LOG_DBG("itr: 0x%08X ret: %d left_bytes: %ld",
			(unsigned int)itr, ret, left_bytes);

		if (ret < 0) {
			goto error_this_send_buffer_chunked;
		}
	}

	/* Must be sent at the end of the chuked sequence */
	ret = mg_send_chunk(conn, "", 0);

error_this_send_buffer_chunked:
	if (ret < 0) {
		LOG_ERR("aborted! ret: %d", ret);
	}

	return ret;
}

__code_decl int this_redirect_2_index_html(struct mg_connection *conn,
					   void *cbdata)
{
	int ret = 0;

	ret = mg_send_http_redirect(conn, URL_INDEX_HTML, 303);
	return 202;
}

__code_decl int this_index_html_handler(struct mg_connection *conn,
					void *cbdata)
{
	__data_decl const char index_html[] = {
#include "web_page/index.html.gz.inc"
	};

	int ret = 0;

	ret = this_send_buffer_chunked(conn, HTTP_TEXT_HTML
					     HTTP_EOFL
					     HTTP_CONTEND_ENCODING
					     HTTP_ENCODING_GZ,
					     index_html, sizeof(index_html));
	this_set_return_value(&ret);
	return ret;
}

__code_decl int this_index_css_handler(struct mg_connection *conn, void *cbdata)
{
	__data_decl const char index_css[] = {
#include "web_page/index.css.gz.inc"
	};

	int ret = 0;

	ret = this_send_buffer_chunked(conn, HTTP_TEXT_CSS
					     HTTP_EOFL
					     HTTP_CONTEND_ENCODING
					     HTTP_ENCODING_GZ,
					     index_css, sizeof(index_css));
	this_set_return_value(&ret);
	return ret;
}

__code_decl int this_ws_js_handler(struct mg_connection *conn, void *cbdata)
{
	__data_decl const char ws_js[] = {
#include "web_page/ws.js.gz.inc"
	};

	int ret = 0;

	ret = this_send_buffer_chunked(conn, HTTP_TEXT_JS
					     HTTP_EOFL
					     HTTP_CONTEND_ENCODING
					     HTTP_ENCODING_GZ,
					     ws_js, sizeof(ws_js));
	this_set_return_value(&ret);
	return ret;
}

__code_decl int this_favicon_ico_handler(struct mg_connection *conn,
					 void *cbdata)
{
	int ret = 404;
	return ret;  /* should fail */
}

__code_decl void this_set_return_value(int *ret_val)
{
	if (*ret_val < 0) {
		*ret_val = 404;  /* 404 - HTTP FAIL or 0 - handler fail */
	} else {
		*ret_val = 200;  /* 200 - HTTP OK*/
	}
}
```

## src/websocket_server_handlers.c
```c
/*
 * Copyright (c) 2020 Alexander Kozhinov <AlexanderKozhinov@yandex.com>
 *
 * SPDX-License-Identifier: Apache-2.0
 */

#include <logging/log.h>
LOG_MODULE_REGISTER(websocket_server_handlers, LOG_LEVEL_DBG);

#include "websocket_server_handlers.h"

#define BOARD_REPLY_PREFIX		CONFIG_BOARD" says: "
#define BOARD_REPLY_PREFIX_LEN		sizeof(BOARD_REPLY_PREFIX)

#define BOARD_REPLY_SUFFIX		" too!"
#define BOARD_REPLY_SUFFIX_LEN		sizeof(BOARD_REPLY_SUFFIX)

#define BOARD_REPLY_TOAL_LEN		(BOARD_REPLY_PREFIX_LEN +\
					 BOARD_REPLY_SUFFIX_LEN)

#define FIN_SHIFT		7u
#define RSV1_SHIFT		6u
#define RSV2_SHIFT		5u
#define RSV3_SHIFT		4u
#define OPCODE_SHIFT		0u

#define BOOL_MASK		0x1  /* boolean value mask */
#define HALF_BYTE_MASK		0xF  /* half byte value mask */

#define WS_URL			"/ws"  /* WebSocket server main url */

#define __code_decl	/* static */
#define __data_decl	static

/* Websocket server handlers: */
__code_decl int this_connect_handler(const struct mg_connection *conn,
				     void *cbdata);
__code_decl void this_ready_handler(struct mg_connection *conn, void *cbdata);
__code_decl int this_data_handler(struct mg_connection *conn, int bits,
				  char *data, size_t data_len, void *cbdata);
__code_decl void this_close_handler(const struct mg_connection *conn,
				    void *cbdata);

void init_websocket_server_handlers(struct mg_context *ctx)
{
	mg_set_websocket_handler(ctx, WS_URL,
				this_connect_handler,
				this_ready_handler,
				this_data_handler,
				this_close_handler,
				NULL);
}

__code_decl int this_connect_handler(const struct mg_connection *conn,
				     void *cbdata)
{
	int ret_val = 0;
	return ret_val;
}

__code_decl void this_ready_handler(struct mg_connection *conn, void *cbdata)
{
}

__code_decl int this_data_handler(struct mg_connection *conn, int bits,
				  char *data, size_t data_len, void *cbdata)
{
	int ret_state = 1;

	/* Encode bits as by https://tools.ietf.org/html/rfc6455#section-5.2: */
	const bool FIN = (bits >> FIN_SHIFT) & BOOL_MASK;
	const bool RSV1 = (bits >> RSV1_SHIFT) & BOOL_MASK;
	const bool RSV2 = (bits >> RSV2_SHIFT) & BOOL_MASK;
	const bool RSV3 = (bits >> RSV2_SHIFT) & BOOL_MASK;

	uint8_t OPCODE = (bits >> OPCODE_SHIFT) & HALF_BYTE_MASK;

	(void)FIN;
	(void)RSV1;
	(void)RSV2;
	(void)RSV3;

	LOG_DBG("got bits: %d", bits);
	LOG_DBG("\t\twith OPCODE: %d", OPCODE);

	/* TODO: Protect resp_data with semaphore */
	const size_t resp_data_len = BOARD_REPLY_TOAL_LEN + data_len;

	if (resp_data_len > CONFIG_MAIN_STACK_SIZE) {
		/* Close connection due to no memory */
		OPCODE = MG_WEBSOCKET_OPCODE_CONNECTION_CLOSE;
	}

	char resp_data[resp_data_len];

	/* Process depending of opcode: */
	switch (OPCODE) {
	case MG_WEBSOCKET_OPCODE_CONTINUATION:
		break;
	case MG_WEBSOCKET_OPCODE_TEXT:
		memcpy(resp_data,
			BOARD_REPLY_PREFIX, BOARD_REPLY_PREFIX_LEN);
		memcpy(resp_data + BOARD_REPLY_PREFIX_LEN,
			data, data_len);
		memcpy(resp_data + BOARD_REPLY_PREFIX_LEN + data_len,
			BOARD_REPLY_SUFFIX, BOARD_REPLY_SUFFIX_LEN);

		ret_state = mg_websocket_write(conn, OPCODE, resp_data,
						resp_data_len);
		break;
	case MG_WEBSOCKET_OPCODE_BINARY:
		ret_state = 0;
		mg_websocket_write(conn,
			MG_WEBSOCKET_OPCODE_CONNECTION_CLOSE, NULL, 0);

		LOG_ERR("Binary data not supported currently: "
			"close connection");
		break;
	case MG_WEBSOCKET_OPCODE_CONNECTION_CLOSE:
		ret_state = 0;
		mg_websocket_write(conn, OPCODE, NULL, 0);
		break;
	case MG_WEBSOCKET_OPCODE_PING:
		break;
	case MG_WEBSOCKET_OPCODE_PONG:
		break;
	default:
		ret_state = 0;
		mg_websocket_write(conn,
			MG_WEBSOCKET_OPCODE_CONNECTION_CLOSE, NULL, 0);

		LOG_ERR("Unknown OPCODE: close connection");
		break;
	}

	if (ret_state < 0) {
		/* TODO: Maybe need we close WS connection here?! */
		LOG_ERR("Unknown ERROR: ret_state = %d", ret_state);
	} else if (ret_state == 0) {
		LOG_DBG("Close WS sonnection: ret_state = %d", ret_state);
	}

	return ret_state;
}

__code_decl void this_close_handler(const struct mg_connection *conn,
				    void *cbdata)
{
}
```
