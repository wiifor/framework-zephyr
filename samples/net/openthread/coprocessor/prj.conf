## CMakeLists.txt
```
# SPDX-License-Identifier: Apache-2.0

cmake_minimum_required(VERSION 3.13.1)

find_package(Zephyr REQUIRED HINTS $ENV{ZEPHYR_BASE})
project(ncp)

target_sources( app
    PRIVATE
        src/main.c
)

include(${ZEPHYR_BASE}/samples/net/common/common.cmake)

set(gen_dir ${ZEPHYR_BINARY_DIR}/include/generated/)
```

## Kconfig
```
# Config options for OpenThread Border Router sample app

# Copyright (c) 2020 Tridonic GmbH & Co KG
# SPDX-License-Identifier: Apache-2.0

mainmenu "OpenThread NCP"

menu "Application configuration"

config NET_SAMPLE_APPLICATION_VERSION
	string "Version number for the application"
	default "v0.0.0"

endmenu

source "Kconfig.zephyr"
```

## sample.yaml
```
common:
  harness: net
  tags: net
  depends_on: netif
  min_flash: 140
sample:
  description: Runs the OpenThread stack as NCP BR
  name: OpenThread Network Co-Processor
tests:
  sample.net.openthread.coprocessor:
    build_only: true
    platform_allow: nrf52840dk_nrf52840 nrf52833dk_nrf52833
    tags: ci_build
  sample.net.openthread.coprocessor.usb:
    build_only: true
    platform_allow: nrf52840dk_nrf52840 nrf52833dk_nrf52833
    tags: ci_build
    extra_args: OVERLAY_CONFIG=overlay-usb-nrf-br.conf
  samples.openthread.coprocessor.rcp:
    build_only: true
    platform_allow: nrf52840dk_nrf52840 nrf52833dk_nrf52833
    tags: ci_build
    extra_args: OVERLAY_CONFIG=overlay-rcp.conf
```

## prj.conf
```kconfig
CONFIG_NETWORKING=y
CONFIG_NET_L2_OPENTHREAD=y

# Disable certain parts of Zephyr IPv6 stack
CONFIG_NET_IPV6_NBR_CACHE=n
CONFIG_NET_IPV6_MLD=n

# Logging
CONFIG_LOG=y
CONFIG_LOG_MAX_LEVEL=1
CONFIG_LOG_MODE_MINIMAL=n
CONFIG_LOG_BACKEND_SPINEL=y
CONFIG_LOG_BACKEND_RTT=y
CONFIG_LOG_BACKEND_UART=n
CONFIG_BOOT_BANNER=n

# Kernel options
CONFIG_MAIN_STACK_SIZE=2048
CONFIG_INIT_STACKS=y

# Increase logging thread stack size due to Spinel backend needs
CONFIG_LOG_PROCESS_THREAD_STACK_SIZE=2048

# Set OpenThread NCP architecture
CONFIG_OPENTHREAD_COPROCESSOR=y
CONFIG_OPENTHREAD_COPROCESSOR_NCP=y

# Add features required for NCP
CONFIG_OPENTHREAD_DIAG=y
CONFIG_OPENTHREAD_DHCP6_SERVER=y
CONFIG_OPENTHREAD_COMMISSIONER=y
CONFIG_OPENTHREAD_BORDER_AGENT=y
CONFIG_OPENTHREAD_BORDER_ROUTER=y
CONFIG_OPENTHREAD_UDP_FORWARD=y
CONFIG_OPENTHREAD_ENABLE_SERVICE=y

# Move console to other UART to not interfere with NCP
CONFIG_UART_CONSOLE_ON_DEV_NAME="UART_1"
```

## overlay-rcp.conf
```kconfig
# This overlay switches from NCP to RCP, use in combination with prj.conf

CONFIG_OPENTHREAD_COPROCESSOR_NCP=n
CONFIG_OPENTHREAD_COPROCESSOR_RCP=y

CONFIG_NET_PKT_RX_COUNT=8
CONFIG_NET_PKT_TX_COUNT=8
```

## overlay-tri-n4m-br.conf
```kconfig
# TRI n4m BR
# Use UART_0 for Shell/Console
CONFIG_UART_SHELL_ON_DEV_NAME="UART_0"
CONFIG_UART_CONSOLE_ON_DEV_NAME="UART_0"
CONFIG_SHELL_PROMPT_UART="ncp-uart:~$ "

# Use UART_1 for Co-Processor
#CONFIG_OPENTHREAD_COPROCESSOR_SPINEL_ON_UART_DEV_NAME="UART_1"

# Use USB-CDC-ACM for NCP
CONFIG_OPENTHREAD_COPROCESSOR_SPINEL_ON_UART_ACM=y
CONFIG_OPENTHREAD_COPROCESSOR_SPINEL_ON_UART_DEV_NAME="CDC_ACM_0"

CONFIG_STDOUT_CONSOLE=y
CONFIG_GPIO=y
CONFIG_USB=y
CONFIG_USB_DEVICE_STACK=y
CONFIG_USB_DEVICE_PRODUCT="OpenThread Co-Processor K64"
CONFIG_LOG=y
CONFIG_USB_DRIVER_LOG_LEVEL_ERR=y
CONFIG_USB_CDC_ACM=y
CONFIG_USB_DEVICE_LOG_LEVEL_ERR=y
CONFIG_SERIAL=y
CONFIG_UART_INTERRUPT_DRIVEN=y
CONFIG_UART_LINE_CTRL=y
CONFIG_USB_REQUEST_BUFFER_SIZE=2048

# disable ethernet on K64
CONFIG_NET_L2_ETHERNET=n
CONFIG_ETH_MCUX=n

CONFIG_IEEE802154_RF2XX=y
CONFIG_NET_CONFIG_IEEE802154_DEV_NAME="RF2XX_0"
CONFIG_ISR_STACK_SIZE=4096
```

## overlay-usb-nrf-br.conf
```kconfig
# Nordic NCP USB CDC-ACM

# Use UART_0 for Shell/Console
CONFIG_UART_SHELL_ON_DEV_NAME="UART_0"
CONFIG_UART_CONSOLE_ON_DEV_NAME="UART_0"
CONFIG_SHELL_PROMPT_UART="ncp-uart:~$ "

# Use USB-CDC-ACM for Co-Processor
CONFIG_OPENTHREAD_COPROCESSOR_SPINEL_ON_UART_ACM=y
CONFIG_OPENTHREAD_COPROCESSOR_SPINEL_ON_UART_DEV_NAME="CDC_ACM_0"
CONFIG_USB=y
CONFIG_USB_DEVICE_STACK=y
CONFIG_USB_DEVICE_PRODUCT="OpenThread CoProcessor NRF"
CONFIG_USB_CDC_ACM=y
CONFIG_UART_LINE_CTRL=y
CONFIG_USB_REQUEST_BUFFER_SIZE=2048

CONFIG_ISR_STACK_SIZE=4096
```

## src/main.c
```c
/* main.c - OpenThread NCP */

/*
 * Copyright (c) 2020 Tridonic GmbH & Co KG
 *
 * SPDX-License-Identifier: Apache-2.0
 */

#include <logging/log.h>
LOG_MODULE_REGISTER(ot_br, LOG_LEVEL_DBG);

#define APP_BANNER "***** OpenThread NCP on Zephyr %s *****"

void main(void)
{
	LOG_INF(APP_BANNER, CONFIG_NET_SAMPLE_APPLICATION_VERSION);
}
```
