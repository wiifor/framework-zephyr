## CMakeLists.txt
```
# SPDX-License-Identifier: Apache-2.0

cmake_minimum_required(VERSION 3.13.1)

find_package(Zephyr HINTS $ENV{ZEPHYR_BASE})
project(dsa)

target_sources(app PRIVATE src/main.c src/dsa_lldp.c)
```

## sample.yaml
```
common:
  harness: net
  tags: net dsa
sample:
  description: Test DSA functionality
  name: DSA sample app
tests:
  sample.net.dsa:
    build_only: true
    platform_allow: ip_k66f
    depends_on: netif
    tags: tests
```

## prj.conf
```kconfig
CONFIG_NETWORKING=y
CONFIG_NET_LOG=y
CONFIG_NET_IPV6=y
CONFIG_NET_IPV4=y
CONFIG_NET_DHCPV4=n
CONFIG_NET_UDP=y
CONFIG_NET_TCP=y
CONFIG_NET_STATISTICS=y
CONFIG_NET_STATISTICS_USER_API=y

CONFIG_TEST_RANDOM_GENERATOR=y

CONFIG_NET_PKT_RX_COUNT=64
CONFIG_NET_PKT_TX_COUNT=64
CONFIG_NET_BUF_RX_COUNT=64
CONFIG_NET_BUF_TX_COUNT=64
CONFIG_NET_IF_UNICAST_IPV6_ADDR_COUNT=5
CONFIG_NET_IF_MCAST_IPV6_ADDR_COUNT=5
CONFIG_NET_IF_UNICAST_IPV4_ADDR_COUNT=1
CONFIG_NET_MAX_CONTEXTS=4

CONFIG_INIT_STACKS=y
CONFIG_PRINTK=y
CONFIG_NET_SHELL=y

# DSA support
CONFIG_NET_DSA=y
CONFIG_DSA_KSZ8794_TAIL_TAGGING=y

# Ethernet is needed for LLDP
CONFIG_NET_L2_ETHERNET=y

CONFIG_NET_CONFIG_NEED_IPV6=y
CONFIG_NET_CONFIG_NEED_IPV4=y
CONFIG_NET_CONFIG_SETTINGS=y

# Logging
CONFIG_LOG=y
CONFIG_NET_DSA_LOG_LEVEL_INF=y

# Support for lan1..3 as RAW_SOCKETS
CONFIG_NET_SOCKETS=y
CONFIG_NET_SOCKETS_PACKET=y
CONFIG_NET_SOCKETS_POSIX_NAMES=y

# How many traffic classes to enable
CONFIG_NET_TC_TX_COUNT=6
CONFIG_NET_TC_RX_COUNT=4
CONFIG_NET_CONFIG_INIT_TIMEOUT=10

CONFIG_NEWLIB_LIBC=y

CONFIG_NET_IF_MAX_IPV4_COUNT=4
CONFIG_NET_IF_MAX_IPV6_COUNT=4
CONFIG_NET_CONFIG_MY_IPV4_ADDR="192.168.0.2"
CONFIG_NET_CONFIG_MY_IPV4_GW="192.168.0.1"
CONFIG_NET_CONFIG_MY_IPV6_ADDR="2001:db8::1"

CONFIG_ETH_MCUX_PROMISCUOUS_MODE=y

# Add RTT SHELL support -> Instead of LOG_BACKEND_RTT
# Shell can be used to test the DSA operation with e.g.
# 'net ping -I3 192.168.0.1'
CONFIG_SHELL=y
CONFIG_SHELL_BACKEND_RTT=y
CONFIG_SHELL_BACKEND_SERIAL=n
CONFIG_LOG_BACKEND_RTT=n
```

## boards/ip_k66f.overlay
```dts
/*
 * Copyright (c) 2020 DENX Software Engineering GmbH
 *
 * SPDX-License-Identifier: Apache-2.0
 */

&enet {
	local-mac-address = [00 00 12 13 00 10];
};

&lan3 {
	local-mac-address = [00 00 12 13 00 37];
};

&lan2 {
	local-mac-address = [00 00 12 13 00 27];
};

&lan1 {
	local-mac-address = [00 00 12 13 00 17];
};
```

## src/main.c
```c
/*
 * Copyright (c) 2020 DENX Software Engineering GmbH
 *
 * SPDX-License-Identifier: Apache-2.0
 */

#include <logging/log.h>
LOG_MODULE_REGISTER(net_dsa_lldp_sample, CONFIG_NET_DSA_LOG_LEVEL);

#include <net/dsa.h>
#include "main.h"

static void dsa_slave_port_setup(struct net_if *iface, struct ud *ifaces)
{
	struct dsa_context *context = net_if_get_device(iface)->data;

	if (ifaces->lan1 == NULL) {
		ifaces->lan1 = context->iface_slave[1];
	}

	if (ifaces->lan2 == NULL) {
		ifaces->lan2 = context->iface_slave[2];
	}

	if (ifaces->lan3 == NULL) {
		ifaces->lan3 = context->iface_slave[3];
	}
}

static void iface_cb(struct net_if *iface, void *user_data)
{

	struct ud *ifaces = user_data;

	if (net_if_l2(iface) != &NET_L2_GET_NAME(ETHERNET)) {
		return;
	}

	if (net_eth_get_hw_capabilities(iface) & ETHERNET_DSA_MASTER_PORT) {
		if (ifaces->master == NULL) {
			ifaces->master = iface;
			return;
		}
	}

	if (net_eth_get_hw_capabilities(iface) & ETHERNET_DSA_SLAVE_PORT) {
		dsa_slave_port_setup(iface, ifaces);
	}
}

static const uint8_t eth_filter_l2_addr_base[][6] = {
	/* MAC address of other device - for filtering testing */
	{ 0x01, 0x80, 0xc2, 0x00, 0x00, 0x03 }
};

enum net_verdict dsa_ll_addr_switch_cb(struct net_if *iface,
				       struct net_pkt *pkt)
{
	struct net_eth_hdr *hdr = NET_ETH_HDR(pkt);
	struct net_linkaddr lladst;

	net_pkt_cursor_init(pkt);
	lladst.len = sizeof(hdr->dst.addr);
	lladst.addr = &hdr->dst.addr[0];

	/*
	 * Pass packet to lan1..3 when matching one from
	 * check_ll_ether_addr table
	 */
	if (check_ll_ether_addr(lladst.addr, &eth_filter_l2_addr_base[0][0])) {
		return 1;
	}

	return 0;
}

int start_slave_port_packet_socket(struct net_if *iface,
				   struct instance_data *pd)
{
	struct sockaddr_ll dst;
	int ret;

	pd->sock = socket(AF_PACKET, SOCK_RAW, ETH_P_ALL);
	if (pd->sock < 0) {
		LOG_ERR("Failed to create RAW socket : %d", errno);
		return -errno;
	}

	dst.sll_ifindex = net_if_get_by_iface(iface);
	dst.sll_family = AF_PACKET;

	ret = bind(pd->sock, (const struct sockaddr *)&dst,
		   sizeof(struct sockaddr_ll));
	if (ret < 0) {
		LOG_ERR("Failed to bind packet socket : %d", errno);
		return -errno;
	}

	return 0;
}

struct ud ifaces;
static int init_dsa_ports(void)
{
	struct dsa_context *ctx;
	uint8_t tbl_buf[8];

	/* Initialize interfaces - read them to ifaces */
	(void)memset(&ifaces, 0, sizeof(ifaces));
	net_if_foreach(iface_cb, &ifaces);

	/*
	 * Read the DSA context - single structure for all
	 * LAN ports.
	 */
	ctx = dsa_get_context(ifaces.lan1);
	if (ctx == NULL) {
		LOG_ERR("DSA context not available!");
		return -ENODEV;
	}

	/*
	 * Set static table to forward LLDP protocol packets
	 * to master port.
	 */
	ctx->dapi->switch_set_mac_table_entry(ctx->switch_id,
					      &eth_filter_l2_addr_base[0][0],
					      BIT(4), 0, 0);
	ctx->dapi->switch_get_mac_table_entry(ctx->switch_id, tbl_buf, 0);

	LOG_INF("DSA chip:%d static MAC address table entry [%d]:",
		ctx->switch_id, 0);
	LOG_INF("0x%x 0x%x 0x%x 0x%x 0x%x 0x%x 0x%x 0x%x",
		tbl_buf[7], tbl_buf[6], tbl_buf[5], tbl_buf[4],
		tbl_buf[3], tbl_buf[2], tbl_buf[1], tbl_buf[0]);

	return 0;
}

void main(void)
{
	init_dsa_ports();

	LOG_INF("DSA ports init - OK");
}
```

## src/dsa_lldp.c
```c
/*
 * Copyright (c) 2020 DENX Software Engineering GmbH
 *
 * SPDX-License-Identifier: Apache-2.0
 */

#include <stdlib.h>
#include <stdio.h>
#include <string.h>

#include <net/socket.h>
#include <net/net_core.h>
#include <net/net_l2.h>
#include <net/net_if.h>
#include <net/socket.h>
#include <net/ethernet.h>
#include <net/lldp.h>
#include <errno.h>

#include <logging/log.h>
#include "main.h"

/* Loglevel of dsa_lldp function */
LOG_MODULE_DECLARE(net_dsa_lldp_sample, CONFIG_NET_DSA_LOG_LEVEL);

#define LLDP_SYSTEM_NAME_SIZE 24
#define LLDP_ETHER_TYPE 0x88CC
#define LLDP_INPUT_DATA_BUF_SIZE 512
#define DSA_BUF_SIZ 128
int dsa_lldp_send(struct net_if *iface, struct instance_data *pd,
		  uint16_t lan, int src_port, int origin_port, int cmd,
		  struct eth_addr *origin_addr)
{
	int ret, len;
	char buffer[DSA_BUF_SIZ], sys_name[LLDP_SYSTEM_NAME_SIZE];
	struct sockaddr_ll dst;
	struct ethernet_context *ctx = net_if_l2_data(iface);
	struct net_eth_hdr *eth_hdr = (struct net_eth_hdr *) buffer;
	uint8_t *p = &buffer[sizeof(struct net_eth_hdr)];
	uint8_t *pb = p;

	lan = ctx->dsa_port_idx;

	dst.sll_ifindex = net_if_get_by_iface(iface);
	/* Construct the Ethernet header */
	memset(buffer, 0, DSA_BUF_SIZ);
	/* Ethernet header */
	/* Take MAC address assigned to LAN port */
	memcpy(eth_hdr->src.addr, net_if_get_link_addr(iface)->addr, ETH_ALEN);
	eth_hdr->dst.addr[0] = MCAST_DEST_MAC0;
	eth_hdr->dst.addr[1] = MCAST_DEST_MAC1;
	eth_hdr->dst.addr[2] = MCAST_DEST_MAC2;
	eth_hdr->dst.addr[3] = MCAST_DEST_MAC3;
	eth_hdr->dst.addr[4] = MCAST_DEST_MAC4;
	eth_hdr->dst.addr[5] = MCAST_DEST_MAC5;

	/* Ethertype field */
	eth_hdr->type = htons(LLDP_ETHER_TYPE);

	/* LLDP packet data */
	/* Chasis ID */
	dsa_buf_write_be16((LLDP_TLV_CHASSIS_ID << 9) | (ETH_ALEN + 1), &p);
	*p++ = 4; /* subtype */
	memcpy(p, net_if_get_link_addr(iface)->addr, ETH_ALEN);
	p += ETH_ALEN;

	/* PORT ID */
	dsa_buf_write_be16((LLDP_TLV_PORT_ID << 9) | (ETH_ALEN + 1), &p);
	*p++ = 3; /* subtype */
	memcpy(p, net_if_get_link_addr(iface)->addr, ETH_ALEN);
	p += ETH_ALEN;

	/* TTL ID */
	dsa_buf_write_be16((LLDP_TLV_TTL << 9) | 2, &p);
	*p++ = 0; /* TTL field is 2 bytes long */
	*p++ = 120;

	/* SYSTEM NAME */
	memset(sys_name, 0, sizeof(sys_name));
	sprintf(sys_name, "ip_k66f LAN:%d", lan);
	dsa_buf_write_be16((LLDP_TLV_SYSTEM_NAME << 9) | strlen(sys_name), &p);
	memcpy(p, sys_name, strlen(sys_name));
	p += strlen(sys_name);

	len = sizeof(struct net_eth_hdr) + (p - pb);
	ret = sendto(pd->sock, buffer, len, 0, (const struct sockaddr *)&dst,
		     sizeof(struct sockaddr_ll));
	if (ret < 0) {
		LOG_ERR("Failed to send, errno %d", errno);
	}

	return 0;
}

void dsa_lldp_print_info(uint8_t *lldp_p, uint8_t lanid)
{
	uint16_t tl, length;
	uint8_t type, subtype;
	uint8_t *p, t1, t2;
	char t[LLDP_INPUT_DATA_BUF_SIZE];

	LOG_INF("LLDP pkt recv -> lan%d", lanid);
	do {
		/* In-buffer data is stored as big endian */
		t1 = *lldp_p++;
		t2 = *lldp_p++;
		tl = (uint16_t) t1 << 8 | t2;

		/* Get type and length */
		type = tl >> 9;
		length = tl & 0x1FF;

		switch (type) {
		case LLDP_TLV_CHASSIS_ID:
		case LLDP_TLV_PORT_ID:
			/* Extract subtype */
			subtype = *lldp_p++;
			length--;
			break;
		}

		p = lldp_p;

		switch (type) {
		case LLDP_TLV_END_LLDPDU:
			return;
		case LLDP_TLV_CHASSIS_ID:
			LOG_INF("\tCHASIS ID:\t%02x:%02x:%02x:%02x:%02x:%02x",
				p[0], p[1], p[2], p[3], p[4], p[5]);
			break;
		case LLDP_TLV_PORT_ID:
			LOG_INF("\tPORT ID:\t%02x:%02x:%02x:%02x:%02x:%02x",
				p[0], p[1], p[2], p[3], p[4], p[5]);
			break;
		case LLDP_TLV_TTL:
			/* TTL field has 2 bytes in BE */
			LOG_INF("\tTTL:\t\t%ds", (uint16_t) p[0] << 8 | p[1]);
			break;
		case LLDP_TLV_SYSTEM_NAME:
			memset(t, 0, length + 1);
			memcpy(t, p, length);
			LOG_INF("\tSYSTEM NAME:\t%s", log_strdup(t));
			break;
		}
		lldp_p += length;
	} while (1);
}

int dsa_lldp_recv(struct net_if *iface, struct instance_data *pd,
		  uint16_t *lan, int *origin_port,
		  struct eth_addr *origin_addr)
{
	struct ethernet_context *ctx = net_if_l2_data(iface);
	struct net_eth_hdr *eth_hdr =
		(struct net_eth_hdr *) pd->recv_buffer;
	uint8_t *lldp_p = &pd->recv_buffer[sizeof(struct net_eth_hdr)];
	int received;

	*lan = ctx->dsa_port_idx;

	/* Receive data */
	received = recv(pd->sock, pd->recv_buffer,
			sizeof(pd->recv_buffer), 0);
	if (received < 0) {
		LOG_ERR("RAW : recv error %d", errno);
		return -1;
	}

	if (eth_hdr->type != 0xCC88) {
		LOG_ERR("Wrong LLDP packet type value [0x%x]", eth_hdr->type);
		return -1;
	}

	dsa_lldp_print_info(lldp_p, *lan);
	return 0;
}

DSA_THREAD(1, dsa_lldp_recv, dsa_lldp_send)
DSA_THREAD(2, dsa_lldp_recv, dsa_lldp_send)
DSA_THREAD(3, dsa_lldp_recv, dsa_lldp_send)
```

## src/main.h
```c
/*
 * Copyright (c) 2020 DENX Software Engineering GmbH
 *
 * SPDX-License-Identifier: Apache-2.0
 */

#ifndef __DSA_SAMPLE__
#define __DSA_SAMPLE__

#include <zephyr.h>
#include <errno.h>

#include <net/net_core.h>
#include <net/net_l2.h>
#include <net/net_if.h>
#include <net/socket.h>
#include <net/ethernet.h>

#define MCAST_DEST_MAC0 0x01
#define MCAST_DEST_MAC1 0x80
#define MCAST_DEST_MAC2 0xc2
#define MCAST_DEST_MAC3 0x00
#define MCAST_DEST_MAC4 0x00
#define MCAST_DEST_MAC5 0x03

#define RECV_BUFFER_SIZE 1280
#define ETH_ALEN 6
#define PACKET_LEN 128

extern struct ud ifaces;

struct eth_addr {
	uint8_t addr[ETH_ALEN]; /* origin hardware address */
};

struct instance_data {
	char *if_name;
	int sock;
	char recv_buffer[RECV_BUFFER_SIZE];
};

/* User data for the interface callback */
struct ud {
	struct net_if *lan1;
	struct net_if *lan2;
	struct net_if *lan3;
	struct net_if *master;
};

static inline bool check_ll_ether_addr(const uint8_t *a, const uint8_t *b)
{
	return ((a[0] ^ b[0]) | (a[1] ^ b[1]) | (a[2] ^ b[2]) |
		(a[3] ^ b[3]) | (a[4] ^ b[4]) | (a[5] ^ b[5])) == 0;
}

static inline void dsa_buf_write_be16(uint16_t tl, uint8_t **p)
{
	uint8_t *v = (uint8_t *) &tl;
	**p = v[1];
	(*p)++;
	**p = v[0];
	(*p)++;
}

int start_slave_port_packet_socket(struct net_if *iface,
				   struct instance_data *pd);

enum net_verdict dsa_ll_addr_switch_cb(struct net_if *iface,
				       struct net_pkt *pkt);

#define CMD_DISCOVER 0
#define CMD_ACK      1
#define DSA_STACK_SIZE 4096
#define DSA_PRIORITY      5
#define DSA_THREAD_START_DELAY 4000

#define DSA_THREAD(ID, FN_RECV, FN_SEND)                                       \
	static void dsa_thread_##ID(void *t1, void *t2, void *t3);             \
	K_THREAD_DEFINE(dsa_tid_##ID, DSA_STACK_SIZE,                          \
		dsa_thread_##ID, NULL, NULL, NULL,                             \
			DSA_PRIORITY, 0, DSA_THREAD_START_DELAY);              \
									       \
	void dsa_thread_##ID(void *t1, void *t2, void *t3)                     \
	{                                                                      \
		int origin_port, ret;                                          \
		uint16_t seq;                                                  \
		struct eth_addr origin_addr;                                   \
		struct instance_data data;                                     \
									       \
		data.if_name = "lan"#ID;                                       \
		ret = start_slave_port_packet_socket(ifaces.lan##ID, &data);   \
		if (ret < 0) {                                                 \
			LOG_ERR("start_slave_port_packet_socket failed %d",    \
				ret);                                          \
			return;                                                \
		}                                                              \
		dsa_register_recv_callback(ifaces.lan##ID,                     \
					   dsa_ll_addr_switch_cb);             \
									       \
		LOG_INF("DSA -> eth/lan"#ID" idx: %d sock: %d",                \
			net_if_get_by_iface(ifaces.lan##ID), data.sock);       \
		do {                                                           \
			ret = FN_RECV(ifaces.lan##ID, &data, &seq,             \
				      &origin_port, &origin_addr);             \
			if (ret) {                                             \
				break;                                         \
			}                                                      \
			ret = FN_SEND(ifaces.lan##ID, &data,                   \
				      seq, 0, origin_port, CMD_ACK,            \
				      &origin_addr);                           \
			if (ret) {                                             \
				break;                                         \
			}                                                      \
		} while (true);                                                \
	}

#endif /* __DSA_SAMPLE__ */
```
