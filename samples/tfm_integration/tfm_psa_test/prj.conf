## CMakeLists.txt
```
#
# Copyright (c) 2021 Nordic Semiconductor ASA
#
# SPDX-License-Identifier: Apache-2.0
#

cmake_minimum_required(VERSION 3.13.1)

find_package(Zephyr REQUIRED HINTS $ENV{ZEPHYR_BASE})

project(tfm_psa_storage_test)

target_sources(app PRIVATE src/main.c)

target_include_directories(app PRIVATE
  ${ZEPHYR_TRUSTED_FIRMWARE_M_MODULE_DIR}/trusted-firmware-m/interface/include
)
```

## sample.yaml
```
common:
    tags: tfm
    platform_allow: mps2_an521_nonsecure v2m_musca_s1_nonsecure
                    nrf5340dk_nrf5340_cpuappns nrf9160dk_nrf9160ns
    harness: console
    harness_config:
      type: multi_line
      regex:
        - "\\*\\*\\*\\*\\* PSA Architecture Test Suite - Version .* \\*\\*\\*\\*\\*"
        - "TOTAL FAILED *: 0"
sample:
  name: "TFM PSA Test"

tests:
  sample.tfm.psa_protected_storage_test:
    extra_args: "CONFIG_TFM_PSA_TEST_PROTECTED_STORAGE=y"
    timeout: 100
  sample.tfm.psa_internal_trusted_storage_test:
    extra_args: "CONFIG_TFM_PSA_TEST_INTERNAL_TRUSTED_STORAGE=y"
```

## prj.conf
```kconfig
#
# Copyright (c) 2021 Nordic Semiconductor ASA
#
# SPDX-License-Identifier: Apache-2.0
#

CONFIG_BUILD_WITH_TFM=y

# Needed for CRYPTO and INITIAL_ATTESTATION
CONFIG_MAIN_STACK_SIZE=4096
```

## src/main.c
```c
/*
 * Copyright (c) 2021 Nordic Semiconductor ASA.
 *
 * SPDX-License-Identifier: Apache-2.0
 */

#include <zephyr.h>

/* Run the PSA test suite */
void psa_test(void);

__attribute__((noreturn))
void main(void)
{
#ifdef CONFIG_TFM_PSA_TEST_NONE
	#error "No PSA test suite set. Use Kconfig to enable a test suite.\n"
#else
	psa_test();
#endif

	for (;;) {
	}
}
```
