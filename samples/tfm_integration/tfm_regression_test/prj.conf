## CMakeLists.txt
```
#
# Copyright (c) 2021 Nordic Semiconductor ASA
#
# SPDX-License-Identifier: Apache-2.0
#

cmake_minimum_required(VERSION 3.13.1)

find_package(Zephyr REQUIRED HINTS $ENV{ZEPHYR_BASE})

project(tfm_regression_test)

target_sources(app PRIVATE src/main.c)
```

## sample.yaml
```
common:
    tags: tfm
    platform_allow: mps2_an521_nonsecure v2m_musca_s1_nonsecure
                    nrf5340dk_nrf5340_cpuappns nrf9160dk_nrf9160ns bl5340_dvk_cpuappns
    harness: console
    harness_config:
      type: multi_line
      regex:
        - "Non-Secure system starting..."
        - "\\#\\#\\#\\# Execute test suites for the Non-secure area \\#\\#\\#\\#"
        - "\\*\\*\\* End of Non-secure test suites \\*\\*\\*"

sample:
  name: "TFM Regression Test"

tests:
  sample.tfm.tfm_regression:
    extra_args: ""
    timeout: 200
```

## prj.conf
```kconfig
#
# Copyright (c) 2021 Nordic Semiconductor ASA
#
# SPDX-License-Identifier: Apache-2.0
#

CONFIG_TEST=y
CONFIG_BUILD_WITH_TFM=y
CONFIG_TFM_REGRESSION_S=y
CONFIG_TFM_REGRESSION_NS=y
```

## src/main.c
```c
/*
 * Copyright (c) 2021 Nordic Semiconductor ASA.
 *
 * SPDX-License-Identifier: Apache-2.0
 */

#include <zephyr.h>

__attribute__((noreturn))
void main(void)
{
	printk("Should not be printed, expected TF-M's NS application to be run instead.\n");
	k_panic();

	for (;;) {
	}
}
```
