## CMakeLists.txt
```
# SPDX-License-Identifier: Apache-2.0

cmake_minimum_required(VERSION 3.13.1)
find_package(Zephyr REQUIRED HINTS $ENV{ZEPHYR_BASE})
project(thermometer)

FILE(GLOB app_sources src/*.c)
target_sources(app PRIVATE ${app_sources})
```

## sample.yaml
```
sample:
  name: Quadrature Decoder
tests:
  sample.sensor.qdec:
    tags: sensors
    harness: sensor
    platform_allow: sam_e70_xplained
    integration_platforms:
      - sam_e70_xplained
```

## prj.conf
```kconfig
CONFIG_SENSOR=y
CONFIG_STDOUT_CONSOLE=y
```

## boards/sam_e70_xplained.conf
```kconfig
CONFIG_QDEC_SAM=y
```

## boards/sam_e70_xplained.overlay
```dts
/*
 * Copyright (c) 2021, Piotr Mienkowski
 *
 * SPDX-License-Identifier: Apache-2.0
 */

&tc0 {
	compatible = "atmel,sam-tc-qdec";
	status = "okay";
	pinctrl-0 = <&pa0b_tc0_tioa0 &pa1b_tc0_tiob0>;
	label = "QDEC_0";
};
```

## src/main.c
```c
/*
 * Copyright (c) 2021, Piotr Mienkowski
 *
 * SPDX-License-Identifier: Apache-2.0
 */

#include <zephyr.h>
#include <drivers/sensor.h>
#include <stdio.h>

void main(void)
{
	const struct device *dev;
	int ret;

	printf("Quadrature Decoder sample application\n\n");

	dev = device_get_binding("QDEC_0");
	if (!dev) {
		printf("error: no QDEC_0 device\n");
		return;
	}

	while (1) {
		struct sensor_value value;

		ret = sensor_sample_fetch(dev);
		if (ret) {
			printf("sensor_sample_fetch failed returns: %d\n", ret);
			break;
		}

		ret = sensor_channel_get(dev, SENSOR_CHAN_ROTATION, &value);
		if (ret) {
			printf("sensor_channel_get failed returns: %d\n", ret);
			break;
		}

		printf("Position is %d\n", value.val1);

		k_sleep(K_MSEC(2000));
	}
}
```
