## CMakeLists.txt
```
# SPDX-License-Identifier: Apache-2.0

cmake_minimum_required(VERSION 3.13.1)
find_package(Zephyr REQUIRED HINTS $ENV{ZEPHYR_BASE})
project(grove_light)

FILE(GLOB app_sources src/*.c)
target_sources(app PRIVATE ${app_sources})
```

## sample.yaml
```
common:
  filter: TOOLCHAIN_HAS_NEWLIB == 1
sample:
  name: Grove Light Sensor
tests:
  sample.sensor.grove_light:
    tags: drivers sensor grove light
    platform_allow: nrf52dk_nrf52832
    integration_platforms:
      - nrf52dk_nrf52832
    harness: grove
    depends_on: adc
```

## prj.conf
```kconfig
CONFIG_ADC=y
CONFIG_SENSOR=y
CONFIG_GROVE_LIGHT_SENSOR=y
CONFIG_NEWLIB_LIBC=y
CONFIG_NEWLIB_LIBC_FLOAT_PRINTF=y
CONFIG_CBPRINTF_FP_SUPPORT=y
```

## boards/nrf52dk_nrf52832.overlay
```dts
/*
 * Copyright (c) 2019 Nordic Semiconductor ASA
 *
 * SPDX-License-Identifier: Apache-2.0
 */

/ {
	ntc {
		label = "GLS";
		compatible = "grove,light";
		io-channels = <&arduino_adc 0>;
	};
};
```

## src/main.c
```c
/*
 * Copyright (c) 2016 Intel Corporation
 *
 * SPDX-License-Identifier: Apache-2.0
 */

#include <zephyr.h>
#include <init.h>
#include <stdio.h>
#include <drivers/sensor.h>

#define SLEEP_TIME	K_MSEC(1000)

void main(void)
{
	const struct device *dev = device_get_binding(DT_LABEL(DT_INST(0, grove_light)));

	if (dev == NULL) {
		printf("device not found.  aborting test.\n");
		return;
	}
	while (1) {
		int read;
		struct sensor_value lux;

		read = sensor_sample_fetch(dev);
		if (read) {
			printf("sample fetch error %d\n", read);
			continue;
		}

		sensor_channel_get(dev, SENSOR_CHAN_LIGHT, &lux);

		printf("lux: %f\n", sensor_value_to_double(&lux));

		k_sleep(SLEEP_TIME);
	}
}
```
