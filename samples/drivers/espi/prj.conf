## CMakeLists.txt
```
# SPDX-License-Identifier: Apache-2.0

cmake_minimum_required(VERSION 3.13.1)
find_package(Zephyr REQUIRED HINTS $ENV{ZEPHYR_BASE})
project(samples_driver_espi)

FILE(GLOB app_sources src/*.c)
target_sources(app PRIVATE ${app_sources})

zephyr_compile_options(-Werror)
```

## Kconfig
```
# Private config options for eSPI sample app

# Copyright (c) 2019 Intel Corporation
# SPDX-License-Identifier: Apache-2.0

mainmenu "Enhanced Serial Peripheral Interface application"

config ESPI_VIRTUAL_WIRE_TIMEOUT
	int "Timeout for virtual wires"
	default 5000
	help
	  Timeout for virtual wires

source "Kconfig.zephyr"
```

## sample.yaml
```
sample:
  description: A basic demo to showcase eSPI driver usage and handshake with
    eSPI master
  name: eSPI driver sample
tests:
  sample.drivers.espi:
    tags: drivers espi
    filter: dt_compat_enabled("microchip,mec15xx-board-power")
    depends_on: espi
    harness: console
    harness_config:
        fixture: espi_device_connect
        type: multi_line
        ordered: true
        regex:
            - "Hello eSPI test (.*)"
            - "eSPI test - I/O initialization...complete"
            - "eSPI slave configured successfully!"
            - "eSPI test - callbacks initialization... complete"
            - "eSPI test - Power initialization...complete"
            - "eSPI BUS reset (.*)"
            - "espi: Hello eSPI test mec1501modular_assy6885"
            - "espi: eSPI slave configured successfully"
            - "espi: eSPI test - callbacks initialization..."
            - "espi: complete"
            - "espi: eSPI test - callbacks registration..."
            - "espi: complete"
            - "espi: eSPI BUS reset 1"
            - "espi: VW channel is ready"
            - "espi: Flash channel is ready"
            - "espi: Test eSPI write flash"
            - "espi: 16 write flash transactions completed"
            - "espi: 16 write flash transactions completed"
            - "espi: Test eSPI read flash"
            - "espi: 16 read flash transactions completed"
            - "espi: 16 read flash transactions completed"
            - "espi: eSPI test - Handshake with eSPI master..."
            - "espi: 1st phase completed"
            - "espi: 2nd phase completed"
            - "espi: PLT_RST changed 1"
            - "espi: 3rd phase completed"
            - "espi: get_pch_temp:"
            - "espi: OOB transaction completed rcvd: 4 bytes"
            - "espi: Postcode fe"
            - "espi: Postcode 7f"
            - "espi: eSPI sample completed"
```

## prj.conf
```kconfig
CONFIG_ESPI=y
CONFIG_STDOUT_CONSOLE=y
CONFIG_PRINTK=y
```

## prj_mec1501modular_assy6885.conf
```kconfig
# eSPI + mec1501modular_assy6885
CONFIG_ESPI=y
CONFIG_LOG=y
CONFIG_LOG_BUFFER_SIZE=4096
CONFIG_LOG_PROCESS_THREAD_SLEEP_MS=100
# Disable only for this board to check notifications
CONFIG_ESPI_AUTOMATIC_WARNING_ACKNOWLEDGE=n
# Sample code doesn't handle ACPI host communication
CONFIG_ESPI_PERIPHERAL_HOST_IO=n
# This only makes sense for system using this board
CONFIG_ESPI_OOB_CHANNEL_RX_ASYNC=y
```

## prj_mec15xxevb_assy6853.conf
```kconfig
# eSPI + mec15xxevb_assy6853
CONFIG_ESPI=y
CONFIG_LOG=y
CONFIG_LOG_BUFFER_SIZE=4096
CONFIG_LOG_PROCESS_THREAD_SLEEP_MS=100
# Disable only for this board to check notifications
CONFIG_ESPI_AUTOMATIC_WARNING_ACKNOWLEDGE=n
# Sample code doesn't handle ACPI host communication
CONFIG_ESPI_PERIPHERAL_HOST_IO=n
# Test SAF flash portal read/erase/write on EVB
CONFIG_ESPI_SAF=y
CONFIG_SPI=y
CONFIG_SPI_XEC_QMSPI=y
```

## prj_npcx7m6fb_evb.conf
```kconfig
# eSPI + npcx7m6fb_evb
CONFIG_LOG=y
CONFIG_LOG_BUFFER_SIZE=4096
CONFIG_LOG_PROCESS_THREAD_SLEEP_MS=100

# Not supported yet
CONFIG_ESPI_AUTOMATIC_WARNING_ACKNOWLEDGE=n
```

## boards/mec15xxevb_assy6853.overlay
```dts
/*
 * Copyright (c) 2020 Intel Corporation
 *
 * SPDX-License-Identifier: Apache-2.0
 */

/ {
	resources {
		compatible = "microchip,mec15xx-board-power";
		/* MCHP_GPIO_012 */
		pwrg-gpios = <&gpio_000_036 10 GPIO_ACTIVE_HIGH>;
		/* MCHP_GPIO_0054 */
		rsm-gpios = <&gpio_040_076 12 GPIO_ACTIVE_HIGH>;
	};
};

&spi0 {
	status = "okay";
	port_sel = <0>;
	chip_select = <0>;
	lines = <4>;
};
```

## boards/npcx7m6fb_evb.overlay
```dts
/*
 * Copyright (c) 2020 Nuvoton Technology Corporation.
 *
 * SPDX-License-Identifier: Apache-2.0
 */

/ {
	/* TODO: Add GPIOs for power sequence later */
};
```

## dts/bindings/mec15xx-board-power.yaml
```yaml
# Copyright (c) 2020, Intel Corporation
# SPDX-License-Identifier: Apache-2.0

compatible: "microchip,mec15xx-board-power"

description: |
    This binding provides MEC15xx board gpio power rails resources to
    build and run samples/drives/espi in Zephyr.
    GPIOs required before performing a eSPI host-slave handshake

properties:
   pwrg-gpios:
        type: phandle-array
        required: true
        description: |
          Board GPIO input used to detect that power rails are stable.

   rsm-gpios:
        type: phandle-array
        required: true
        description: |
          Board GPIO output used to notify eSPI master to ackwnowledge
          power has stabilized and bare minimum initialization in eSPI slave
          is complete so eSPI master can proceed with eSPI handshake.
```

## src/espi_oob_handler.c
```c
/*
 * Copyright (c) 2020 Intel Corporation
 *
 * SPDX-License-Identifier: Apache-2.0
 */

#include <device.h>
#include <soc.h>
#include <drivers/gpio.h>
#include <drivers/espi.h>
#include <logging/log_ctrl.h>
#include <logging/log.h>
#include "espi_oob_handler.h"

LOG_MODULE_DECLARE(espi, CONFIG_ESPI_LOG_LEVEL);

struct oob_header {
	uint8_t dest_slave_addr;
	uint8_t oob_cmd_code;
	uint8_t byte_cnt;
	uint8_t src_slave_addr;
};

#ifdef CONFIG_ESPI_OOB_CHANNEL_RX_ASYNC

#define OOB_THREAD_STACK_SIZE  512ul
#define OOB_THREAD_PRIORITY    K_PRIO_COOP(5)
#define OOB_THREAD_WAIT        -1

/* Thread to process asynchronous callbacks */
void espihub_thread(void *p1, void *p2, void *p3);

void temperature_timer(struct k_timer *timer_id);

K_TIMER_DEFINE(temp_timer, temperature_timer, NULL);
K_THREAD_DEFINE(espihub_thrd_id, OOB_THREAD_STACK_SIZE, espihub_thread,
		NULL, NULL, NULL,
		OOB_THREAD_PRIORITY, K_INHERIT_PERMS, OOB_THREAD_WAIT);

K_MSGQ_DEFINE(from_host, sizeof(uint8_t), 8, 4);

struct thread_context {
	const struct device  *espi_dev;
	int                  cycles;
};

static struct thread_context context;
static bool need_temp;
#endif

static struct espi_oob_packet resp_pckt;
static uint8_t buf[MAX_ESPI_BUF_LEN];

static int request_temp(const struct device *dev)
{
	int ret;
	struct oob_header oob_hdr;
	struct espi_oob_packet req_pckt;

	LOG_WRN("%s", __func__);

	oob_hdr.dest_slave_addr = PCH_DEST_SLV_ADDR;
	oob_hdr.oob_cmd_code = OOB_CMDCODE;
	oob_hdr.byte_cnt = 1;
	oob_hdr.src_slave_addr = SRC_SLV_ADDR;

	/* Packetize OOB request */
	req_pckt.buf = (uint8_t *)&oob_hdr;
	req_pckt.len = sizeof(struct oob_header);

	ret = espi_send_oob(dev, &req_pckt);
	if (ret) {
		LOG_ERR("OOB Tx failed %d", ret);
		return ret;
	}

	return 0;
}

static int retrieve_packet(const struct device *dev, uint8_t *sender)
{
	int ret;

#ifdef CONFIG_ESPI_OOB_CHANNEL_RX_ASYNC
	/* Note that no data is in the item */
	uint8_t response_len;

	if (k_msgq_num_used_get(&from_host) == 0U) {
		return -EINVAL;
	}

	k_msgq_get(&from_host, &response_len, K_FOREVER);
#endif

	resp_pckt.buf = (uint8_t *)&buf;
	resp_pckt.len = MAX_ESPI_BUF_LEN;

	ret = espi_receive_oob(dev, &resp_pckt);
	if (ret) {
		LOG_ERR("OOB Rx failed %d", ret);
		return ret;
	}

	LOG_INF("OOB transaction completed rcvd: %d bytes", resp_pckt.len);
	for (int i = 0; i < resp_pckt.len; i++) {
		LOG_INF("%x ", buf[i]);
	}

	if (sender) {
		*sender = buf[OOB_RESPONSE_SENDER_INDEX];
	}

	return 0;
}

int get_pch_temp_sync(const struct device *dev)
{
	int ret;

	for (int i = 0; i < MIN_GET_TEMP_CYCLES; i++) {
		ret = request_temp(dev);
		if (ret) {
			LOG_ERR("OOB req failed %d", ret);
			return ret;
		}

		ret = retrieve_packet(dev, NULL);
		if (ret) {
			LOG_ERR("OOB retrieve failed %d", ret);
			return ret;
		}
	}

	return 0;
}

int get_pch_temp_async(const struct device *dev)
{
#if !defined(CONFIG_ESPI_OOB_CHANNEL) || \
	!defined(CONFIG_ESPI_OOB_CHANNEL_RX_ASYNC)
	return -ENOTSUP;
#else
	context.espi_dev = dev;
	context.cycles = MIN_GET_TEMP_CYCLES;

	k_thread_start(espihub_thrd_id);
	k_thread_join(espihub_thrd_id, K_FOREVER);

	return 0;
#endif
}

#ifdef CONFIG_ESPI_OOB_CHANNEL_RX_ASYNC

void oob_rx_handler(const struct device *dev, struct espi_callback *cb,
		    struct espi_event event)
{
	uint8_t last_resp_len = event.evt_details;

	LOG_WRN("%s", __func__);
	/* Post for post-processing in a thread
	 * Should not attempt to retrieve in callback context
	 */
	k_msgq_put(&from_host, &last_resp_len, K_NO_WAIT);
}


void temperature_timer(struct k_timer *timer_id)
{
	LOG_WRN("%s", __func__);
	need_temp = true;
}

void espihub_thread(void *p1, void *p2, void *p3)
{
	int ret;
	uint8_t temp;
	uint8_t sender;

	LOG_DBG("%s", __func__);
	k_timer_start(&temp_timer, K_MSEC(100), K_MSEC(100));
	while (context.cycles > 0) {
		k_msleep(50);

		ret = retrieve_packet(context.espi_dev, &sender);
		if (!ret) {
			switch (sender) {
			case PCH_DEST_SLV_ADDR:
				LOG_INF("PCH response");
				/* Any other checks */
				if (resp_pckt.len == OOB_RESPONSE_LEN) {
					temp = buf[OOB_RESPONSE_DATA_INDEX];
					LOG_INF("Temp %d", temp);
				} else {
					LOG_ERR("Incorrect size response");
				}

				break;
			default:
				LOG_INF("Other host sender %x", sender);
			}
		} else {
			LOG_ERR("Failure to retrieve temp %d", ret);
		}

		/* Decrease cycles in both cases failure/success */
		context.cycles--;

		if (need_temp) {
			request_temp(context.espi_dev);
			need_temp = false;
		}
	}

	k_timer_stop(&temp_timer);
}
#endif /* CONFIG_ESPI_OOB_CHANNEL_RX_ASYNC */
```

## src/espi_oob_handler.h
```c
/*
 * Copyright (c) 2020 Intel Corporation
 *
 * SPDX-License-Identifier: Apache-2.0
 */

#ifndef __ESPI_OOB_HANDLER_H__
#define __ESPI_OOB_HANDLER_H__

/* eSPI host entity address  */
#define PCH_DEST_SLV_ADDR     0x02u
#define SRC_SLV_ADDR          0x21u

#define OOB_RESPONSE_SENDER_INDEX   0x02u
#define OOB_RESPONSE_DATA_INDEX     0x04u


/* Temperature command opcode */
#define OOB_CMDCODE           0x01u
#define OOB_RESPONSE_LEN            0x05u

/* Maximum bytes for OOB transactions */
#define MAX_ESPI_BUF_LEN      80u
#define MIN_GET_TEMP_CYCLES   5u

/* 100ms */
#define MAX_OOB_TIMEOUT       100ul

void oob_rx_handler(const struct device *dev, struct espi_callback *cb,
		    struct espi_event event);

/**
 * @brief Retrieve PCH temperature over OOB channel.
 * Assumes OOB Tx and Rx as synchronous operation.
 *
 * @param dev eSPI driver handle.
 *
 * @retval 0 If successful.
 * @retval -ENOTSUP returned when OOB channel is not supported.
 * @retval -EINVAL is returned when OOB parameters are invalid.
 *
 */
int get_pch_temp_sync(const struct device *dev);


/**
 * @brief Retrieve PCH temperature over OOB channel.
 * Assumes OOB Tx and Rx as synchronous operation.
 *
 * @param dev eSPI driver handle.
 *
 * @retval 0 If successful.
 * @retval -ENOTSUP returned when OOB channel is not supported.
 * @retval -ETIMEOUT OOB operations could not be started.
 *
 */
int get_pch_temp_async(const struct device *dev);

#endif /* __ESPI_OOB_HANDLER_H__ */
```
