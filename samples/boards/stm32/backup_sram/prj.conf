## CMakeLists.txt
```
# SPDX-License-Identifier: Apache-2.0

cmake_minimum_required(VERSION 3.13.1)
find_package(Zephyr REQUIRED HINTS $ENV{ZEPHYR_BASE})
project(stm32_backup_sram)

FILE(GLOB app_sources src/*.c)
target_sources(app PRIVATE ${app_sources})
```

## sample.yaml
```
sample:
  description: Usage of backup SRAM on STM32
  name: stm32_backup_sram
tests:
  sample.boards.stm32.backup_sram:
    depends_on: backup_sram
    build_only: true
    filter: dt_compat_enabled("st,stm32-backup-sram")
```

## prj.conf
```kconfig
CONFIG_STM32_BACKUP_SRAM=y
```

## src/main.c
```c
/*
 * Copyright (c) 2021 Teslabs Engineering S.L.
 *
 * SPDX-License-Identifier: Apache-2.0
 */

#include <zephyr.h>
#include <sys/printk.h>

/** Value stored in backup SRAM. */
__stm32_backup_sram_section uint32_t backup_value;

void main(void)
{
	printk("Current value in backup SRAM: %d\n", backup_value);

	backup_value++;
#if __DCACHE_PRESENT
	SCB_CleanDCache_by_Addr(&backup_value, sizeof(backup_value));
#endif

	printk("Next reported value should be: %d\n", backup_value);
	printk("Keep VBAT power source and reset the board now!\n");
}
```
