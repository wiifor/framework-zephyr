## CMakeLists.txt
```
# SPDX-License-Identifier: Apache-2.0

set(BOARD intel_s1000_crb)
cmake_minimum_required(VERSION 3.13.1)
find_package(Zephyr REQUIRED HINTS $ENV{ZEPHYR_BASE})
project(intel_s1000_crb_audio)

target_sources(app PRIVATE src/audio_driver.c)
target_sources(app PRIVATE src/audio_core.c)
target_sources(app PRIVATE src/audio_proc.c)
target_sources(app PRIVATE src/tuning_driver.c)
target_sources(app PRIVATE src/usb_transport.c)
target_sources(app PRIVATE src/framework.c)
```

## sample.yaml
```
sample:
  name: 2-way Audio Forwarding Sample
tests:
  sample.board.intel_s1000_crb.audio:
    platform_allow: intel_s1000_crb
    tags: audio
```

## prj.conf
```kconfig
CONFIG_LOG=y
CONFIG_SOC_LOG_LEVEL_WRN=y
CONFIG_AUDIO_CODEC_LOG_LEVEL_WRN=y
CONFIG_I2S_LOG_LEVEL_WRN=y
CONFIG_DMA_LOG_LEVEL_WRN=y
CONFIG_GPIO=y
CONFIG_I2S=y
CONFIG_I2C=y
CONFIG_DMA=y
CONFIG_AUDIO=y
CONFIG_USB=y
CONFIG_USB_DEVICE_HID=y
CONFIG_HID_INTERRUPT_EP_MPS=64
CONFIG_USB_HID_POLL_INTERVAL_MS=1
```

## src/audio_core.c
```c
/*
 * Copyright (c) 2019 Intel Corporation
 *
 * SPDX-License-Identifier: Apache-2.0
 */

#define LOG_LEVEL LOG_LEVEL_INF
#include <logging/log.h>
LOG_MODULE_REGISTER(audio_core);

#include <zephyr.h>
#include "audio_core.h"

/*
 * stereo mic in
 * stereo host in
 * stereo speaker out
 * stereo host out
 */
#define AUDIO_ACTIVE_CHANNELS	2

/* core audio processing buffers with interleaved samples */
static int32_t mic_input[AUDIO_ACTIVE_CHANNELS][AUDIO_SAMPLES_PER_FRAME];
static int32_t host_input[AUDIO_ACTIVE_CHANNELS][AUDIO_SAMPLES_PER_FRAME];

static bool tuning_reply_ready;
static uint32_t *tuning_command_buffer;
static uint32_t tuning_cmd_buf_size_in_words;

#define CMD_START_AUDIO		1
#define CMD_STOP_AUDIO		2

int audio_core_initialize(void)
{
	return 0;
}

int audio_core_process_mic_source(int32_t *buffer, int channels)
{
	int sample;
	int channel;
	int32_t *read;

	read = buffer;

	/* copy audio samples from mic source buffer to mic_input */
	for (sample = 0; sample < AUDIO_SAMPLES_PER_FRAME; sample++) {
		for (channel = 0; channel < AUDIO_ACTIVE_CHANNELS; channel++) {
			mic_input[channel][sample] = read[channel];
		}
		read += channels;
	}

	return 0;
}

int audio_core_process_host_source(int32_t *buffer, int channels)
{
	int sample;
	int channel;
	int32_t *read;

	read = buffer;

	/* copy audio samples from host source buffer to host_input */
	for (sample = 0; sample < AUDIO_SAMPLES_PER_FRAME; sample++) {
		for (channel = 0; channel < AUDIO_ACTIVE_CHANNELS; channel++) {
			host_input[channel][sample] = read[channel];
		}
		read += channels;
	}

	return 0;
}

int audio_core_process_speaker_sink(int32_t *buffer, int channels)
{
	int sample;
	int channel;
	int32_t *write;

	write = buffer;

	/* copy audio samples from host_input to speaker sink buffer */
	for (sample = 0; sample < AUDIO_SAMPLES_PER_FRAME; sample++) {
		for (channel = 0; channel < AUDIO_ACTIVE_CHANNELS; channel++) {
			write[channel] = host_input[channel][sample];
		}
		write += channels;
	}

	return 0;
}

int audio_core_process_host_sink(int32_t *buffer, int channels)
{
	int sample;
	int channel;
	int32_t *write;

	write = buffer;

	/* copy audio samples from mic_input to host sink buffer */
	for (sample = 0; sample < AUDIO_SAMPLES_PER_FRAME; sample++) {
		for (channel = 0; channel < AUDIO_ACTIVE_CHANNELS; channel++) {
			write[channel] = mic_input[channel][sample];
		}
		write += channels;
	}

	return 0;
}

int audio_core_notify_frame_tick(void)
{
	return 0;
}

int audio_core_tuning_interface_init(uint32_t *command_buffer, uint32_t size_in_words)
{
	tuning_command_buffer = command_buffer;
	tuning_cmd_buf_size_in_words = size_in_words;
	return 0;
}

int audio_core_notify_tuning_cmd(void)
{
	uint32_t first_word = *((uint32_t *)tuning_command_buffer);
	uint32_t command = (first_word << 16) >> 16;

	switch (command) {
	case CMD_START_AUDIO:
		audio_driver_start();
		break;

	case CMD_STOP_AUDIO:
		audio_driver_stop();
		break;

	default:
		LOG_INF("Unknown command %d", command);
	}

	tuning_reply_ready = true;
	return 0;
}

bool audio_core_is_tuning_reply_ready(void)
{
	if (tuning_reply_ready == true) {
		tuning_reply_ready = false;
		return true;
	}

	return false;
}

int audio_core_process_background_tasks(void)
{
	return 0;
}

int audio_core_process_small_blocks(void)
{
	return 0;
}

int audio_core_process_large_blocks(void)
{
	return 0;
}
```

## src/audio_core.h
```c
/*
 * Copyright (c) 2019 Intel Corporation
 *
 * SPDX-License-Identifier: Apache-2.0
 */

#ifndef AUDIO_CORE__H
#define AUDIO_CORE__H

/* scheduling priority used by each thread */
#define TUN_DRV_IO_THREAD_PRIORITY		-3
#define AUDIO_DRIVER_THREAD_PRIORITY		2
#define AUDIO_SM_BLOCK_PROC_THREAD_PRIORITY	3
#define AUDIO_LG_BLOCK_PROC_THREAD_PRIORITY	4
#define FRAMEWORK_BG_THREAD_PRIORITY		99

/* size of stack area used by each thread */
#define AUDIO_DRIVER_THREAD_STACKSIZE		2048
#define TUN_DRV_IO_THREAD_STACK_SIZE		1024
#define FRAMEWORK_BG_THREAD_STACK_SIZE		1024
#define AUDIO_SM_BLOCK_PROC_THREAD_STACK_SIZE	1024
#define AUDIO_LG_BLOCK_PROC_THREAD_STACK_SIZE	1024

/* input audio channels */
#define AUDIO_MIC_INPUT_CHANNEL_COUNT		8
#define AUDIO_HOST_INPUT_CHANNEL_COUNT		2
#define	AUDIO_INPUT_CHANNEL_COUNT		\
	(AUDIO_MIC_INPUT_CHANNEL_COUNT +	\
	 AUDIO_HOST_OUTPUT_CHANNEL_COUNT)

/* output audio channels */
#define AUDIO_SPEAKER_OUTPUT_CHANNEL_COUNT	2
#define AUDIO_HOST_OUTPUT_CHANNEL_COUNT		2
#define AUDIO_OUTPUT_CHANNEL_COUNT		\
	(AUDIO_SPEAKER_OUTPUT_CHANNEL_COUNT +	\
	 AUDIO_HOST_OUTPUT_CHANNEL_COUNT)

/* samples per frame */
#define AUDIO_SAMPLES_PER_FRAME			192

int audio_core_initialize(void);
int audio_core_process_mic_source(int32_t *buffer, int channels);
int audio_core_process_host_source(int32_t *buffer, int channels);
int audio_core_process_speaker_sink(int32_t *buffer, int channels);
int audio_core_process_host_sink(int32_t *buffer, int channels);
int audio_core_notify_frame_tick(void);

/* tuning interface prototypes */
int audio_core_tuning_interface_init(uint32_t *command_buffer,
		uint32_t size_in_words);
int audio_core_notify_tuning_cmd(void);
bool audio_core_is_tuning_reply_ready(void);

/* audio driver prototypes */
int audio_driver_start(void);
int audio_driver_stop(void);

/* tick for processing background tasks, called from the background thread */
int audio_core_process_background_tasks(void);

/* tick for processing small audio blocks */
int audio_core_process_small_blocks(void);
int audio_core_process_large_blocks(void);

#endif /* AUDIO_CORE__H */
```

## src/audio_driver.c
```c
/*
 * Copyright (c) 2019 Intel Corporation
 *
 * SPDX-License-Identifier: Apache-2.0
 */

#define LOG_LEVEL LOG_LEVEL_INF
#include <logging/log.h>
LOG_MODULE_REGISTER(audio_io);

#include <zephyr.h>

#include <soc.h>
#include <device.h>
#include <drivers/i2s.h>

#include <audio/codec.h>
#include <audio/dmic.h>
#include "audio_core.h"

#define DMIC_DEV_NAME		"PDM"
#define SPK_OUT_DEV_NAME	"I2S_1"
#define HOST_INOUT_DEV_NAME	"I2S_2"

#define NUM_HOST_CHANNELS	2
#define NUM_SPK_CHANNELS	2
#define NUM_MIC_CHANNELS	8

#define AUDIO_SAMPLE_FREQ	48000
#define AUDIO_SAMPLE_WIDTH	32

#define HOST_FRAME_SAMPLES	(AUDIO_SAMPLES_PER_FRAME * NUM_HOST_CHANNELS)
#define MIC_FRAME_SAMPLES	(AUDIO_SAMPLES_PER_FRAME * NUM_MIC_CHANNELS)
#define SPK_FRAME_SAMPLES	(AUDIO_SAMPLES_PER_FRAME * NUM_SPK_CHANNELS)

#define HOST_FRAME_BYTES	(HOST_FRAME_SAMPLES * AUDIO_SAMPLE_WIDTH / 8)
#define MIC_FRAME_BYTES		(MIC_FRAME_SAMPLES * AUDIO_SAMPLE_WIDTH / 8)
#define SPK_FRAME_BYTES		(SPK_FRAME_SAMPLES * AUDIO_SAMPLE_WIDTH / 8)

#define SPK_OUT_BUF_COUNT	2
#define MIC_IN_BUF_COUNT	2
#define HOST_INOUT_BUF_COUNT	4 /* 2 for TX and 2 for RX */

static void audio_drv_thread(void);

__attribute__((section(".dma_buffers"))) static struct {
	int32_t	host_inout[HOST_INOUT_BUF_COUNT][HOST_FRAME_SAMPLES];
	int32_t	spk_out[SPK_OUT_BUF_COUNT][SPK_FRAME_SAMPLES];
	int32_t	mic_in[MIC_IN_BUF_COUNT][MIC_FRAME_SAMPLES];
} audio_buffers;

static const struct device *codec_dev;
static const struct device *i2s_spk_out_dev;
static const struct device *i2s_host_dev;
static const struct device *dmic_device;

static struct k_mem_slab mic_in_mem_slab;
static struct k_mem_slab host_inout_mem_slab;
static struct k_mem_slab spk_out_mem_slab;

K_SEM_DEFINE(audio_drv_sync_sem, 0, 1);
static bool audio_io_started;

K_THREAD_DEFINE(audio_drv_thread_id, AUDIO_DRIVER_THREAD_STACKSIZE,
		audio_drv_thread, NULL, NULL, NULL,
		AUDIO_DRIVER_THREAD_PRIORITY, 0, 0);

static void audio_driver_process_audio_input(void)
{
	int32_t *host_in_buf;
	int32_t *mic_in_buf;
	size_t size;
	int ret;

	/* read capture input buffer */
	ret = dmic_read(dmic_device, 0, (void **)&mic_in_buf, &size, SYS_FOREVER_MS);
	if (ret) {
		LOG_ERR("dmic_device read failed %d", ret);
		return;
	}

	/* read playback input buffer */
	ret = i2s_read(i2s_host_dev, (void **)&host_in_buf, &size);
	if (ret) {
		LOG_ERR("i2s_host_dev read failed %d", ret);
		return;
	}

	audio_core_process_mic_source(mic_in_buf, NUM_MIC_CHANNELS);
	audio_core_process_host_source(host_in_buf, NUM_HOST_CHANNELS);

	/* free the consumed buffers */
	k_mem_slab_free(&mic_in_mem_slab, (void **)&mic_in_buf);
	k_mem_slab_free(&host_inout_mem_slab, (void **)&host_in_buf);
}

static void audio_driver_process_audio_output(void)
{
	int32_t *spk_out_buf;
	int32_t *host_out_buf;
	int ret;

	ret = k_mem_slab_alloc(&spk_out_mem_slab, (void *)&spk_out_buf,
			K_NO_WAIT);
	if (ret) {
		LOG_ERR("speaker out buffer alloc failed %d mem_slab %p",
				ret, &spk_out_mem_slab);
	}

	ret = k_mem_slab_alloc(&host_inout_mem_slab, (void *)&host_out_buf,
			K_NO_WAIT);
	if (ret) {
		LOG_ERR("host out audio buffer alloc failed %d", ret);
	}

	audio_core_process_speaker_sink(spk_out_buf, NUM_SPK_CHANNELS);
	audio_core_process_host_sink(host_out_buf, NUM_HOST_CHANNELS);

	/* write buffer */
	ret = i2s_write(i2s_spk_out_dev, (void *)spk_out_buf, SPK_FRAME_BYTES);
	if (ret) {
		LOG_ERR("i2s_write for speaker failed %d", ret);
	}

	ret = i2s_write(i2s_host_dev, (void *)host_out_buf, HOST_FRAME_BYTES);
	if (ret) {
		LOG_ERR("i2s_write for host failed %d", ret);
	}
}

static int audio_driver_send_zeros_frame(void)
{
	int ret = 0;
	void *spk_out_buf;
	void *host_out_buf;

	/* allocate speaker output buffer */
	ret = k_mem_slab_alloc(&spk_out_mem_slab, &spk_out_buf, K_NO_WAIT);
	if (ret) {
		LOG_ERR("Buffer alloc for spk output failed %d", ret);
		return ret;
	}

	/* allocate host output buffer */
	ret = k_mem_slab_alloc(&host_inout_mem_slab, &host_out_buf, K_NO_WAIT);
	if (ret) {
		LOG_ERR("Buffer alloc for host output failed %d", ret);
		return ret;
	}

	/* fill buffer with zeros */
	memset(spk_out_buf, 0, SPK_FRAME_BYTES);
	memset(host_out_buf, 0, HOST_FRAME_BYTES);

	ret = i2s_write(i2s_spk_out_dev, spk_out_buf, SPK_FRAME_BYTES);
	if (ret) {
		LOG_ERR("i2s_write for spk output failed %d", ret);
		return ret;
	}

	ret = i2s_write(i2s_host_dev, host_out_buf, HOST_FRAME_BYTES);
	if (ret) {
		LOG_ERR("i2s_write for host output failed %d", ret);
		return ret;
	}

	return ret;
}

static int audio_driver_start_host_streams(void)
{
	int ret = 0;

	/* trigger transmission */
	ret = i2s_trigger(i2s_host_dev, I2S_DIR_TX, I2S_TRIGGER_START);
	if (ret) {
		LOG_ERR("I2S TX failed with code %d", ret);
	}

	/* trigger reception */
	ret = i2s_trigger(i2s_host_dev, I2S_DIR_RX, I2S_TRIGGER_START);
	if (ret) {
		LOG_ERR("I2S RX failed with code %d", ret);
	}

	return ret;
}

static int audio_driver_stop_host_streams(void)
{
	int ret;

	/* stop transmission */
	ret = i2s_trigger(i2s_host_dev, I2S_DIR_TX, I2S_TRIGGER_STOP);
	if (ret) {
		LOG_ERR("I2S TX failed with code %d", ret);
	}

	/* stop reception */
	ret = i2s_trigger(i2s_host_dev, I2S_DIR_RX, I2S_TRIGGER_STOP);
	if (ret) {
		LOG_ERR("I2S RX failed with code %d", ret);
	}

	return ret;
}

static void audio_driver_config_host_streams(void)
{
	int ret;
	struct i2s_config i2s_cfg;

	i2s_host_dev = device_get_binding(HOST_INOUT_DEV_NAME);
	if (!i2s_host_dev) {
		LOG_ERR("unable to find device %s",  HOST_INOUT_DEV_NAME);
		return;
	}

	/* Configure */
	i2s_cfg.word_size = AUDIO_SAMPLE_WIDTH;
	i2s_cfg.channels = NUM_HOST_CHANNELS;
	i2s_cfg.format = I2S_FMT_DATA_FORMAT_I2S | I2S_FMT_CLK_NF_NB;
	i2s_cfg.options = I2S_OPT_FRAME_CLK_MASTER | I2S_OPT_BIT_CLK_MASTER;
	i2s_cfg.frame_clk_freq = AUDIO_SAMPLE_FREQ;
	i2s_cfg.block_size = HOST_FRAME_BYTES;
	i2s_cfg.mem_slab = &host_inout_mem_slab;
	i2s_cfg.timeout = 0;

	k_mem_slab_init(&host_inout_mem_slab, &audio_buffers.host_inout[0][0],
			HOST_FRAME_BYTES, HOST_INOUT_BUF_COUNT);

	/* Configure host input/output I2S */
	ret = i2s_configure(i2s_host_dev, I2S_DIR_RX, &i2s_cfg);
	if (ret != 0) {
		LOG_ERR("i2s_configure RX failed with %d error", ret);
	}
}

static void audio_driver_config_periph_streams(void)
{
	int ret;
	struct i2s_config i2s_cfg;
	struct audio_codec_cfg codec = {
		.dai_type	= AUDIO_DAI_TYPE_I2S,
		.dai_cfg.i2s	= {
			.word_size	= AUDIO_SAMPLE_WIDTH,
			.channels	= NUM_SPK_CHANNELS,
			.format		= I2S_FMT_DATA_FORMAT_I2S |
				I2S_FMT_CLK_NF_NB,
			.options	= I2S_OPT_FRAME_CLK_SLAVE |
				I2S_OPT_BIT_CLK_SLAVE,
			.frame_clk_freq	= AUDIO_SAMPLE_FREQ,
			.block_size	= SPK_FRAME_BYTES,
			.timeout	= 0,
		},
	};
	struct pcm_stream_cfg stream = {
		.pcm_rate		= AUDIO_SAMPLE_FREQ,
		.pcm_width		= AUDIO_SAMPLE_WIDTH,
		.block_size		= MIC_FRAME_BYTES,
		.mem_slab		= &mic_in_mem_slab,
	};
	struct dmic_cfg cfg = {
		.io = {
			.min_pdm_clk_freq	= 1024000,
			.max_pdm_clk_freq	= 4800000,
			.min_pdm_clk_dc		= 48,
			.max_pdm_clk_dc		= 52,
			.pdm_clk_pol		= 0,
			.pdm_data_pol		= 0,
		},
		.streams			= &stream,
		.channel = {
			.req_chan_map_lo	=
				dmic_build_channel_map(0, 0, PDM_CHAN_RIGHT) |
				dmic_build_channel_map(1, 0, PDM_CHAN_LEFT) |
				dmic_build_channel_map(2, 2, PDM_CHAN_RIGHT) |
				dmic_build_channel_map(3, 2, PDM_CHAN_LEFT) |
				dmic_build_channel_map(4, 1, PDM_CHAN_RIGHT) |
				dmic_build_channel_map(5, 1, PDM_CHAN_LEFT) |
				dmic_build_channel_map(6, 3, PDM_CHAN_RIGHT) |
				dmic_build_channel_map(7, 3, PDM_CHAN_LEFT),
			.req_num_chan		= NUM_MIC_CHANNELS,
			.req_num_streams	= 1,
		},
	};

	k_mem_slab_init(&mic_in_mem_slab, &audio_buffers.mic_in[0][0],
			MIC_FRAME_BYTES, MIC_IN_BUF_COUNT);
	dmic_device = device_get_binding(DMIC_DEV_NAME);
	if (!dmic_device) {
		LOG_ERR("unable to find device %s", DMIC_DEV_NAME);
		return;
	}

	ret = dmic_configure(dmic_device, &cfg);
	if (ret != 0) {
		LOG_ERR("dmic_configure failed with %d error", ret);
	}

	i2s_spk_out_dev = device_get_binding(SPK_OUT_DEV_NAME);
	if (!i2s_spk_out_dev) {
		LOG_ERR("unable to find device %s",  SPK_OUT_DEV_NAME);
		return;
	}

	codec_dev = device_get_binding(DT_LABEL(DT_INST(0, ti_tlv320dac)));
	if (!codec_dev) {
		LOG_ERR("unable to find device %s", DT_LABEL(DT_INST(0, ti_tlv320dac)));
		return;
	}

	/* Configure */
	i2s_cfg.word_size = AUDIO_SAMPLE_WIDTH;
	i2s_cfg.channels = NUM_SPK_CHANNELS;
	i2s_cfg.format = I2S_FMT_DATA_FORMAT_I2S | I2S_FMT_CLK_NF_NB;
	i2s_cfg.options = I2S_OPT_FRAME_CLK_MASTER | I2S_OPT_BIT_CLK_MASTER;
	i2s_cfg.frame_clk_freq = AUDIO_SAMPLE_FREQ;
	i2s_cfg.block_size = SPK_FRAME_BYTES;
	i2s_cfg.mem_slab = &spk_out_mem_slab;
	i2s_cfg.timeout = 0;
	k_mem_slab_init(&spk_out_mem_slab, &audio_buffers.spk_out[0][0],
			SPK_FRAME_BYTES, SPK_OUT_BUF_COUNT);

	ret = i2s_configure(i2s_spk_out_dev, I2S_DIR_TX, &i2s_cfg);
	if (ret != 0) {
		LOG_ERR("i2s_configure TX failed with %d error", ret);
	}

	/* configure codec */
	codec.mclk_freq = soc_get_ref_clk_freq();
	audio_codec_configure(codec_dev, &codec);
}

static void audio_driver_start_periph_streams(void)
{
	int ret;

	/* start codec output */
	audio_codec_start_output(codec_dev);

	ret = i2s_trigger(i2s_spk_out_dev, I2S_DIR_TX, I2S_TRIGGER_START);
	if (ret) {
		LOG_ERR("I2S TX failed with code %d", ret);
	}

	ret = dmic_trigger(dmic_device, DMIC_TRIGGER_START);
	if (ret) {
		LOG_ERR("dmic_trigger failed with code %d", ret);
	}
}

static void audio_driver_stop_periph_streams(void)
{
	int ret;

	ret = i2s_trigger(i2s_spk_out_dev, I2S_DIR_TX, I2S_TRIGGER_STOP);
	if (ret) {
		LOG_ERR("I2S TX failed with code %d", ret);
	}

	/* trigger transmission */
	ret = dmic_trigger(dmic_device, DMIC_TRIGGER_STOP);
	if (ret) {
		LOG_ERR("dmic_trigger failed with code %d", ret);
	}
}

int audio_driver_start(void)
{
	if (audio_io_started == true) {
		LOG_INF("Audio I/O already started ...");
		return 0;
	}

	LOG_INF("Starting Audio I/O...");

	/*
	 * start the playback path first followed by the capture path
	 * This ensures that by the time the capture frame tick is
	 * processed, the playback input samples are ready and playback
	 * output samples are transmitted
	 */
	audio_driver_send_zeros_frame();
	audio_driver_send_zeros_frame();

	audio_driver_start_host_streams();
	audio_driver_start_periph_streams();

	audio_io_started = true;
	k_sem_give(&audio_drv_sync_sem);

	return 0;
}

int audio_driver_stop(void)
{
	if (audio_io_started == false) {
		LOG_INF("Audio I/O already stopped ...");
		return 0;
	}

	k_sem_take(&audio_drv_sync_sem, K_FOREVER);
	audio_driver_stop_host_streams();
	audio_driver_stop_periph_streams();
	audio_io_started = false;
	LOG_INF("Stopped Audio I/O...");

	return 0;
}

static void audio_drv_thread(void)
{
	LOG_INF("Starting Audio Driver thread ,,,");

	LOG_INF("Configuring Host Audio Streams ...");
	audio_driver_config_host_streams();

	LOG_INF("Configuring Peripheral Audio Streams ...");
	audio_driver_config_periph_streams();

	LOG_INF("Initializing Audio Core Engine ...");
	audio_core_initialize();

	LOG_DBG("mic_in_mem_slab %p", &mic_in_mem_slab);
	LOG_DBG("spk_out_mem_slab %p", &spk_out_mem_slab);
	LOG_DBG("host_inout_mem_slab %p", &host_inout_mem_slab);

	audio_driver_start();

	while (true) {
		k_sem_take(&audio_drv_sync_sem, K_FOREVER);

		audio_driver_process_audio_input();

		audio_driver_process_audio_output();

		k_sem_give(&audio_drv_sync_sem);

		audio_core_notify_frame_tick();
	}
}
```

## src/audio_proc.c
```c
/*
 * Copyright (c) 2019 Intel Corporation
 *
 * SPDX-License-Identifier: Apache-2.0
 */

#define LOG_LEVEL LOG_LEVEL_INF
#include <logging/log.h>
LOG_MODULE_REGISTER(audio_proc);

#include <zephyr.h>

#include "audio_core.h"

K_SEM_DEFINE(audio_proc_small_block_sem, 0, 1);
K_SEM_DEFINE(audio_proc_large_block_sem, 0, 1);

static void audio_proc_small_block_thread(void);
static void audio_proc_large_block_thread(void);

K_THREAD_DEFINE(audio_proc_sm_blk_tid, AUDIO_SM_BLOCK_PROC_THREAD_STACK_SIZE,
		audio_proc_small_block_thread, NULL, NULL, NULL,
		AUDIO_SM_BLOCK_PROC_THREAD_PRIORITY, 0, 0);

K_THREAD_DEFINE(audio_proc_lg_blk_tid, AUDIO_LG_BLOCK_PROC_THREAD_STACK_SIZE,
		audio_proc_large_block_thread, NULL, NULL, NULL,
		AUDIO_LG_BLOCK_PROC_THREAD_PRIORITY, 0, 0);

static void audio_proc_small_block_thread(void)
{
	LOG_INF("Starting small block processing thread ...");

	while (true) {
		k_sem_take(&audio_proc_small_block_sem, K_FOREVER);
		audio_core_process_small_blocks();
	}
}

static void audio_proc_large_block_thread(void)
{
	LOG_INF("Starting large block processing thread ...");

	while (true) {
		k_sem_take(&audio_proc_large_block_sem, K_FOREVER);
		audio_core_process_large_blocks();
	}
}
```

## src/framework.c
```c
/*
 * Copyright (c) 2019 Intel Corporation
 *
 * SPDX-License-Identifier: Apache-2.0
 */

#define LOG_LEVEL LOG_LEVEL_INF
#include <logging/log.h>
LOG_MODULE_REGISTER(framework);

#include <zephyr.h>

#include "audio_core.h"

extern int tun_drv_packet_handler(void);
static int framework_background_thread(void);

K_THREAD_DEFINE(framework_bg_thread_id, FRAMEWORK_BG_THREAD_STACK_SIZE,
		framework_background_thread, NULL, NULL, NULL,
		FRAMEWORK_BG_THREAD_PRIORITY, 0, 0);

static int framework_background_thread(void)
{
	LOG_INF("Starting framework background thread ...");

	while (true) {
		tun_drv_packet_handler();
		audio_core_process_background_tasks();
	}

	return 0;
}
```

## src/tuning_driver.c
```c
/*
 * Copyright (c) 2019 Intel Corporation
 *
 * SPDX-License-Identifier: Apache-2.0
 */

#define LOG_LEVEL LOG_LEVEL_INF
#include <logging/log.h>
LOG_MODULE_REGISTER(tuning);

#include <sys/byteorder.h>

#include <string.h>
#include <zephyr.h>

#include "audio_core.h"
#include "usb_transport.h"

static void tun_drv_process_command(uint8_t *data, uint32_t len);

/* Buffer size in "words" for the tuning commands and replies */
#define TUN_DRV_CMD_MAX_WORDS	(264)
#define TUN_DRV_CMD_MAX_BYTES	(TUN_DRV_CMD_MAX_WORDS << 2)

#define TUN_DRV_ALERT_Q_LEN	((TUN_DRV_CMD_MAX_BYTES +\
			USB_TPORT_HID_REPORT_DATA_LEN - 1) /\
		USB_TPORT_HID_REPORT_DATA_LEN)

static struct {
	/* room for transport header */
	union usb_hid_report_hdr header;

	/* command buffer for the tuning interface */
	uint8_t buffer[TUN_DRV_CMD_MAX_BYTES];

	/* length of valid data in the buffer */
	uint32_t len;

	/* index into the buffer where incoming data is copied */
	uint32_t index;
} __packed command_buffer;

/* Allocate a synchronization semaphore */
K_SEM_DEFINE(tun_drv_sem, 0, 1);

static int tun_drv_io_thread(void);

K_THREAD_DEFINE(tun_drv_io_thread_id, TUN_DRV_IO_THREAD_STACK_SIZE,
		tun_drv_io_thread, NULL, NULL, NULL, TUN_DRV_IO_THREAD_PRIORITY,
		0, 0);

static int tun_drv_io_thread(void)
{
	LOG_INF("Starting tuning driver I/O thread ...");

	/* initialize the audio core's tuning interface */
	audio_core_tuning_interface_init((uint32_t *)command_buffer.buffer,
			TUN_DRV_CMD_MAX_WORDS);

	/* initialize the tuning transport protocol driver */
	usb_transport_init(tun_drv_process_command);

	while (true) {
		k_sem_take(&tun_drv_sem, K_FOREVER);

		/* notify audio core on tuning command reception */
		audio_core_notify_tuning_cmd();
	}

	return 0;
}

int tun_drv_packet_handler(void)
{
	int ret = 0;
	uint32_t len;
	uint32_t first_word;

	if (audio_core_is_tuning_reply_ready() == false) {
		return ret;
	}

	first_word = *((uint32_t *)command_buffer.buffer);
	len = (first_word >> 16) << 2;

	ret = usb_transport_send_reply(command_buffer.buffer, len);
	if (ret) {
		LOG_ERR("usb_transport_send_reply error %d", ret);
	}
	return ret;
}

static void tun_drv_process_command(uint8_t *data, uint32_t len)
{
	uint32_t first_word;

	if (command_buffer.len == 0) {
		/* extract command length */
		first_word = *((uint32_t *)data);
		command_buffer.len = (first_word >> 16) << 2;

		/* ensure total length does not exceed max */
		if (command_buffer.len > TUN_DRV_CMD_MAX_BYTES) {
			command_buffer.len = TUN_DRV_CMD_MAX_BYTES;
		}
	}

	if ((command_buffer.index + len) >= command_buffer.len) {
		len = command_buffer.len - command_buffer.index;
	}

	if (len) {
		/* copy the received data into the tuning packet buffer */
		memcpy(&command_buffer.buffer[command_buffer.index], data, len);
		command_buffer.index += len;
	}

	if (command_buffer.index == command_buffer.len) {
		/* reset index and length */
		command_buffer.index = command_buffer.len = 0;
		/* notify tuning driver thread */
		k_sem_give(&tun_drv_sem);
	}
}
```

## src/usb_transport.c
```c
/*
 * Copyright (c) 2019 Intel Corporation
 *
 * SPDX-License-Identifier: Apache-2.0
 */

#define LOG_LEVEL LOG_LEVEL_INF
#include <logging/log.h>
LOG_MODULE_REGISTER(usb_transport);

#include <zephyr.h>

#include <usb/usb_device.h>
#include <usb/class/usb_hid.h>

#include "usb_transport.h"

/* callback function list */
static int usb_transport_set_report(const struct device *dev,
		struct usb_setup_packet *setup,
		int32_t *len, uint8_t **data);
static void usb_transport_host_ready(const struct device *dev);

static const struct hid_ops usb_transport_callbacks = {
	.set_report	= usb_transport_set_report,
	.int_in_ready	= usb_transport_host_ready,
};

/* create an HID report descriptor with input and output reports */
static const uint8_t usb_transport_hid_report_desc[] = {
	/* Usage page: vendor defined */
	HID_ITEM(HID_ITEM_TAG_USAGE_PAGE, HID_ITEM_TYPE_GLOBAL, 2), 0x00, 0xFF,

	/* Usage: vendor specific */
	HID_USAGE(0x01),
	/* Collection: Application Collection */
	HID_COLLECTION(HID_COLLECTION_APPLICATION),
	/* Logical Minimum: 0 */
	HID_LOGICAL_MIN8(0x00),
	/* Logical Maximum: 255 */
	HID_LOGICAL_MAX8(0xFF),
	/* Report Size: 8 bits */
	HID_REPORT_SIZE(8),
	/* Report Count (in bytes) */
	HID_REPORT_COUNT(USB_TPORT_HID_REPORT_COUNT - 1),

	/* Report ID: 1 */
	HID_REPORT_ID(USB_TPORT_HID_REPORT_ID),
	/* Vendor Usage 2 */
	HID_USAGE(0x02),
	/* Input: Data, Variable, Absolute & Buffered bytes*/
	HID_INPUT(0x86),

	/* Report ID: 1 */
	HID_REPORT_ID(USB_TPORT_HID_REPORT_ID),
	/* Vendor Usage 2 */
	HID_USAGE(0x02),
	/* Output: Data, Variable, Absolute & Buffered bytes*/
	HID_OUTPUT(0x86),

	/* End collection */
	HID_END_COLLECTION,
};

static usb_transport_receive_callback_t receive_data_cb;

static const struct device *hid_device;

int usb_transport_init(usb_transport_receive_callback_t callback)
{
	int ret;

	hid_device = device_get_binding("HID_0");

	if (hid_device == NULL) {
		LOG_ERR("USB HID Device not found");
		return -ENODEV;
	}

	/* register a HID device and the callback functions */
	usb_hid_register_device(hid_device, usb_transport_hid_report_desc,
			sizeof(usb_transport_hid_report_desc),
			&usb_transport_callbacks);

	receive_data_cb = callback;

	ret = usb_enable(NULL);
	if (ret != 0) {
		LOG_ERR("Failed to enable USB");
		return -EIO;
	}

	/* initialize USB interface and HID class */
	return usb_hid_init(hid_device);
}

int usb_transport_send_reply(uint8_t *data, uint32_t len)
{
	int ret = 0;
	uint32_t written = 0;
	union usb_hid_report_hdr *header;

	/* roll back buffer to point to header */
	data = data - sizeof(union usb_hid_report_hdr);
	header = (union usb_hid_report_hdr *)data;

	/* send reply in one or more HID reports */
	while (len) {
		/* populate header */
		header->byte.report_id = USB_TPORT_HID_REPORT_ID;
		header->byte.unused[0] = header->byte.unused[1] = 0;
		if (len < USB_TPORT_HID_REPORT_DATA_LEN) {
			header->byte.byte_count = len;
			len = 0;
		} else {
			header->byte.byte_count = USB_TPORT_HID_REPORT_DATA_LEN;
			len -= USB_TPORT_HID_REPORT_DATA_LEN;
		}

		ret = hid_int_ep_write(hid_device, (uint8_t *)header,
				USB_TPORT_HID_REPORT_COUNT, &written);

		if (ret) {
			LOG_DBG("usb_write failed with error %d", ret);
			break;
		}

		if (written != USB_TPORT_HID_REPORT_COUNT) {
			/* usb_write is expected to send all data */
			LOG_ERR("usb_write: requested %u sent %u",
					USB_TPORT_HID_REPORT_COUNT, written);
			ret = -EIO;
			break;
		}

		/* move pointer to fill next header */
		header = (union usb_hid_report_hdr *)((uint8_t *)header +
				USB_TPORT_HID_REPORT_DATA_LEN);
	}

	return ret;
}

static int usb_transport_set_report(const struct device *dev,
		struct usb_setup_packet *setup,
		int32_t *len, uint8_t **data)
{
	uint8_t	*buffer;
	int32_t	size;

	/* strip the HID header */
	buffer = *data + sizeof(union usb_hid_report_hdr);
	size = *len - sizeof(union usb_hid_report_hdr);

	receive_data_cb(buffer, size);
	return 0;
}

static void usb_transport_host_ready(const struct device *dev)
{
	LOG_DBG("usb_transport_host_ready");
}
```

## src/usb_transport.h
```c
/*
 * Copyright (c) 2019 Intel Corporation
 *
 * SPDX-License-Identifier: Apache-2.0
 */

#ifndef TUNING_USB_TRANSPORT_H
#define TUNING_USB_TRANSPORT_H

#define USB_TPORT_HID_REPORT_ID		(1)
#define USB_TPORT_HID_REPORT_COUNT	(56)
#define USB_TPORT_HID_REPORT_DATA_LEN	\
	(USB_TPORT_HID_REPORT_COUNT - sizeof(union usb_hid_report_hdr))

/* 4 byte header in every HID report */
union usb_hid_report_hdr {
	struct {
		uint8_t	report_id;
		uint8_t	unused[2];
		uint8_t	byte_count;
	} __packed byte;
	uint32_t	word;
};

typedef void (*usb_transport_receive_callback_t)(uint8_t *data, uint32_t len);

int usb_transport_init(usb_transport_receive_callback_t callback);
int usb_transport_send_reply(uint8_t *data, uint32_t len);

#endif /* TUNING_USB_TRANSPORT_H */
```
