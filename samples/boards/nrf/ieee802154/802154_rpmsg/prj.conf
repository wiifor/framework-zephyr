## CMakeLists.txt
```
# SPDX-License-Identifier: Apache-2.0

cmake_minimum_required(VERSION 3.13.1)

find_package(Zephyr REQUIRED HINTS $ENV{ZEPHYR_BASE})
project(802154_rpmsg)

target_sources(app PRIVATE src/main.c)
```

## sample.yaml
```
sample:
  description: Allows Zephyr to provide 802.15.4 connectivity
    for nRF devices via RPMsg.
  name: 802.15.4 RPMsg serialization
tests:
  sample.boards.nrf.802154_rpmsg:
    build_only: true
    platform_allow: nrf5340dk_nrf5340_cpunet
```

## prj.conf
```kconfig
## Disable serial and UART interface.
CONFIG_SERIAL=n
CONFIG_UART_CONSOLE=n

CONFIG_LOG=n

CONFIG_OPENAMP=y
CONFIG_OPENAMP_MASTER=n
CONFIG_OPENAMP_SLAVE=y

CONFIG_NRF_802154_SER_RADIO=y
```

## src/main.c
```c
/*
 * Copyright (c) 2020 Nordic Semiconductor ASA
 *
 * SPDX-License-Identifier: Apache-2.0
 */

#include <sys/__assert.h>
#include <zephyr.h>

#include <nrf_802154_serialization_error.h>

void nrf_802154_serialization_error(const nrf_802154_ser_err_data_t *err)
{
	(void)err;
	__ASSERT(false, "802.15.4 serialization error");
}

void nrf_802154_sl_fault_handler(uint32_t id, int32_t line, const char *err)
{
	__ASSERT(false, "module_id: %u, line: %d, %s", id, line, err);
}
```
