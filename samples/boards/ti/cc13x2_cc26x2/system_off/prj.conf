## CMakeLists.txt
```
# SPDX-License-Identifier: Apache-2.0

cmake_minimum_required(VERSION 3.13.1)
include($ENV{ZEPHYR_BASE}/cmake/app/boilerplate.cmake NO_POLICY_SCOPE)
project(ti_cc13x2_cc26x2_system_off)

FILE(GLOB app_sources src/*.c)
target_sources(app PRIVATE ${app_sources})
```

## sample.yaml
```
sample:
  name: Low Power State Sample for TI CC13x2/CC26x2
tests:
  sample.boards.ti.cc13x2_cc26x2.system_off:
    build_only: true
    platform_allow: cc1352r1_launchxl
    tags: power
```

## prj.conf
```kconfig
CONFIG_GPIO=y

CONFIG_PM=y

CONFIG_PM_DEVICE=y
```

## src/main.c
```c
/*
 * Copyright (c) 2019 Nordic Semiconductor ASA
 * Copyright (c) 2020 Linaro Ltd.
 *
 * SPDX-License-Identifier: Apache-2.0
 */

#include <stdio.h>
#include <zephyr.h>
#include <init.h>
#include <device.h>
#include <drivers/gpio.h>
#include <pm/pm.h>

#include <driverlib/ioc.h>


#define PORT    DT_GPIO_LABEL(DT_ALIAS(sw0), gpios)
#define PIN     DT_GPIO_PIN(DT_ALIAS(sw0), gpios)
#define PULL_UP DT_GPIO_FLAGS(DT_ALIAS(sw0), gpios)

#define BUSY_WAIT_S 5U
#define SLEEP_US 2000U
#define SLEEP_S     3U

extern void CC1352R1_LAUNCHXL_shutDownExtFlash(void);

void main(void)
{
	uint32_t config, status;
	const struct device *gpiob;

	printk("\n%s system off demo\n", CONFIG_BOARD);

	/* Shut off external flash to save power */
	CC1352R1_LAUNCHXL_shutDownExtFlash();

	/* Configure to generate PORT event (wakeup) on button 1 press. */
	gpiob = device_get_binding(PORT);
	if (!gpiob) {
		printk("error\n");
		return;
	}

	gpio_pin_configure(gpiob, PIN, GPIO_INPUT | PULL_UP);

	/* Set wakeup bits for button gpio */
	config = IOCPortConfigureGet(PIN);
	config |= IOC_WAKE_ON_LOW;
	IOCPortConfigureSet(PIN, IOC_PORT_GPIO, config);

	printk("Busy-wait %u s\n", BUSY_WAIT_S);
	k_busy_wait(BUSY_WAIT_S * USEC_PER_SEC);

	printk("Sleep %u us (IDLE)\n", SLEEP_US);
	k_usleep(SLEEP_US);

	printk("Sleep %u s (STANDBY)\n", SLEEP_S);
	k_sleep(K_SECONDS(SLEEP_S));

	printk("Entering system off (SHUTDOWN); press BUTTON1 to restart\n");

	/* Clear GPIO interrupt */
	status = GPIO_getEventMultiDio(GPIO_DIO_ALL_MASK);
	GPIO_clearEventMultiDio(status);

	/*
	 * Force the SOFT_OFF state.
	 */
	pm_power_state_force((struct pm_state_info){PM_STATE_SOFT_OFF, 0, 0});

	printk("ERROR: System off failed\n");
	while (true) {
		/* spin to avoid fall-off behavior */
	}
}
```

## src/ext_flash.c
```c
/*
 * Copyright (c) 2020, Texas Instruments Incorporated
 * Copyright (c) 2020 Linaro Ltd.
 *
 * SPDX-License-Identifier: Apache-2.0
 */

#include <zephyr.h>
#include <device.h>
#include <drivers/gpio.h>

#include <driverlib/cpu.h>

#define GPIO_PORT DT_LABEL(DT_NODELABEL(gpio0))
#define DIO8_PIN  8
#define DIO9_PIN  9
#define DIO10_PIN 10
#define DIO20_PIN 20


/*
 *  ======== CC1352R1_LAUNCHXL_sendExtFlashByte ========
 */
void CC1352R1_LAUNCHXL_sendExtFlashByte(const struct device *dev,
					uint8_t byte)
{
	uint8_t i;

	/* SPI Flash CS */
	gpio_pin_set(dev, DIO20_PIN, 0);

	for (i = 0; i < 8; i++) {
		gpio_pin_set(dev, DIO10_PIN, 0); /* SPI Flash CLK */

		/* SPI Flash MOSI */
		gpio_pin_set(dev, DIO9_PIN, (byte >> (7 - i)) & 0x01);
		gpio_pin_set(dev, DIO10_PIN, 1); /* SPI Flash CLK */

		/*
		 * Waste a few cycles to keep the CLK high for at
		 * least 45% of the period.
		 * 3 cycles per loop: 8 loops @ 48 Mhz = 0.5 us.
		 */
		CPUdelay(8);
	}

	gpio_pin_set(dev, DIO10_PIN, 0);   /* CLK */
	gpio_pin_set(dev, DIO20_PIN, 1);   /* CS */

	/*
	 * Keep CS high at least 40 us
	 * 3 cycles per loop: 700 loops @ 48 Mhz ~= 44 us
	 */
	CPUdelay(700);
}

/*
 *  ======== CC1352R1_LAUNCHXL_wakeUpExtFlash ========
 */
void CC1352R1_LAUNCHXL_wakeUpExtFlash(const struct device *dev)
{
	/*
	 *  To wake up we need to toggle the chip select at
	 *  least 20 ns and ten wait at least 35 us.
	 */

	/* Toggle chip select for ~20ns to wake ext. flash */
	gpio_pin_set(dev, DIO20_PIN, 0);
	/* 3 cycles per loop: 1 loop @ 48 Mhz ~= 62 ns */
	CPUdelay(1);
	gpio_pin_set(dev, DIO20_PIN, 1);
	/* 3 cycles per loop: 560 loops @ 48 Mhz ~= 35 us */
	CPUdelay(560);
}

/*
 *  ======== CC1352R1_LAUNCHXL_shutDownExtFlash ========
 */
void CC1352R1_LAUNCHXL_shutDownExtFlash(void)
{
	const struct device *dev;
	uint8_t extFlashShutdown = 0xB9;

	dev = device_get_binding(GPIO_PORT);
	/* Set SPI Flash CS pin as output */
	gpio_pin_configure(dev, DIO20_PIN, GPIO_OUTPUT);
	/* Set SPI Flash CLK pin as output */
	gpio_pin_configure(dev, DIO10_PIN, GPIO_OUTPUT);
	/* Set SPI Flash MOSI pin as output */
	gpio_pin_configure(dev, DIO9_PIN, GPIO_OUTPUT);
	/* Set SPI Flash MISO pin as input */
	gpio_pin_configure(dev, DIO8_PIN, GPIO_INPUT | GPIO_PULL_DOWN);

	/*
	 *  To be sure we are putting the flash into sleep and not waking it,
	 *  we first have to make a wake up call
	 */
	CC1352R1_LAUNCHXL_wakeUpExtFlash(dev);

	CC1352R1_LAUNCHXL_sendExtFlashByte(dev, extFlashShutdown);
}
```
