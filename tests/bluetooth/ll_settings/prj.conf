## CMakeLists.txt
```
# SPDX-License-Identifier: Apache-2.0

cmake_minimum_required(VERSION 3.13.1)
find_package(Zephyr REQUIRED HINTS $ENV{ZEPHYR_BASE})
project(bluetooth_ll_settings)

zephyr_library_include_directories(${ZEPHYR_BASE}/subsys/bluetooth/controller/include)

FILE(GLOB app_sources src/*.c)
target_sources(app PRIVATE ${app_sources})
```

## prj.conf
```kconfig
CONFIG_TEST=y
CONFIG_ZTEST=y

CONFIG_BT=y
CONFIG_BT_CTLR=y

CONFIG_SETTINGS=y
CONFIG_SETTINGS_RUNTIME=y

CONFIG_BT_SETTINGS=y
CONFIG_BT_CTLR_SETTINGS=y

CONFIG_BT_CTLR_VERSION_SETTINGS=y
CONFIG_BT_CTLR_COMPANY_ID=0x5F1
CONFIG_BT_CTLR_SUBVERSION_NUMBER=0xFFFF

# Needed only to prevent the switch-unreachable warning from being generated
# for the `__fallthrough;` statement in function ll_rx_dequeue() in ull.c.
CONFIG_BT_OBSERVER=y
```

## src/main.c
```c
/* main.c - Application main entry point */

/*
 * Copyright (c) 2019 Intel Corporation
 *
 * SPDX-License-Identifier: Apache-2.0
 */

#include <zephyr.h>
#include <stddef.h>
#include <ztest.h>

#include <settings/settings.h>

#include "ll_settings.h"

void test_company_id(void)
{
	uint16_t cid;
	int err;

	cid = 0x1234;
	err = settings_runtime_set("bt/ctlr/company", &cid, sizeof(cid));
	zassert_equal(err, 0, "Setting Company Id failed");
	zassert_equal(ll_settings_company_id(), cid,
		      "Company Id does not match");

	cid = 0x5678;
	err = settings_runtime_set("bt/ctlr/company", &cid, sizeof(cid));
	zassert_equal(err, 0, "Changing Company Id failed");
	zassert_equal(ll_settings_company_id(), cid,
		      "Company ID does not match");
}

void test_subversion_number(void)
{
	uint16_t svn;
	int err;

	svn = 0x1234;
	err = settings_runtime_set("bt/ctlr/subver", &svn, sizeof(svn));
	zassert_equal(err, 0, "Setting Subversion number failed");
	zassert_equal(ll_settings_subversion_number(), svn,
		      "Subversion number does not match");

	svn = 0x5678;
	err = settings_runtime_set("bt/ctlr/subver", &svn, sizeof(svn));
	zassert_equal(err, 0, "Changing Subversion number failed");
	zassert_equal(ll_settings_subversion_number(), svn,
		      "Subversion number does not match");
}

/*test case main entry*/
void test_main(void)
{
	ztest_test_suite(test_ll_settings,
			 ztest_unit_test(test_company_id),
			 ztest_unit_test(test_subversion_number));
	ztest_run_test_suite(test_ll_settings);
}
```
