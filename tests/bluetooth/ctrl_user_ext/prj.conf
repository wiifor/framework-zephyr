## CMakeLists.txt
```
# SPDX-License-Identifier: Apache-2.0

cmake_minimum_required(VERSION 3.13.1)
include_directories("./src")

find_package(Zephyr REQUIRED HINTS $ENV{ZEPHYR_BASE})
project(bluetooth_ctrl_user_ext)

zephyr_library_include_directories(${ZEPHYR_BASE}/subsys/bluetooth/controller/)

FILE(GLOB app_sources src/*.c)

target_sources(app PRIVATE ${app_sources})
```

## prj.conf
```kconfig
CONFIG_BT=y
CONFIG_BT_CTLR=y
CONFIG_BT_LL_SW_SPLIT=y
CONFIG_BT_PERIPHERAL=y
CONFIG_BT_CENTRAL=y
CONFIG_ZTEST=y
CONFIG_BT_CTLR_ADVANCED_FEATURES=y
CONFIG_BT_CTLR_USER_EXT=y
CONFIG_BT_CTLR_USER_EVT_RANGE=10
CONFIG_BT_RX_USER_PDU_LEN=7
CONFIG_BT_CTLR_USER_CPR_INTERVAL_MIN=y
```

## src/main.c
```c
/* main.c - Application main entry point */

/*
 * Copyright (c) 2015-2016 Intel Corporation
 *
 * SPDX-License-Identifier: Apache-2.0
 */

#include <zephyr/types.h>
#include <stddef.h>
#include <sys/printk.h>
#include <ztest.h>

#include <bluetooth/bluetooth.h>

void test_ctrl_user_ext(void)
{
	zassert_false(bt_enable(NULL), "Bluetooth ctrl_user_ext failed");
}

/*test case main entry*/
void test_main(void)
{
	ztest_test_suite(test_bluetooth,
			ztest_unit_test(test_ctrl_user_ext));
	ztest_run_test_suite(test_bluetooth);
}
```

## src/hci_user_ext.c
```c
/*
 * Copyright (c) 2019 Oticon A/S
 *
 * SPDX-License-Identifier: Apache-2.0
 */

#if defined(CONFIG_BT_CTLR_USER_EXT)

#include <toolchain.h>
#include <zephyr/types.h>
#include <net/buf.h>

#include "util/memq.h"
#include "ll_sw/pdu.h"
#include "ll_sw/lll.h"
#include "hci/hci_user_ext.h"

/* The test is made to show that hci.c and other code can compile when
 * certain Kconfig options are set. This includes functions that are
 * used for proprietary user extension. The function implementations
 * in this file are simple stubs without functional behavior.
 */

int8_t hci_user_ext_get_class(struct node_rx_pdu *node_rx)
{
	return 0;
}

void hci_user_ext_encode_control(struct node_rx_pdu *node_rx, struct pdu_data *pdu_data, struct net_buf *buf)
{
	return;
}

#endif
```

## src/ull_vendor.h
```c
/*
 * Copyright (c) 2019 Oticon A/S
 *
 * SPDX-License-Identifier: Apache-2.0
 */

#if defined(CONFIG_BT_CTLR_USER_EXT)

/* The test is made to show that ull.c and other code can compile when
 * certain Kconfig options are set. This includes functions that are
 * used for vendor specific behavior, as such the function implementations
 * in this file are simple stubs without functional behavior.
 */

static inline int ull_user_init(void)
{
	return 0;
}

static inline int rx_demux_rx_proprietary(memq_link_t *link,
					  struct node_rx_hdr *rx,
					  memq_link_t *tail,
					  memq_link_t **head)
{
	return 0;
}

static inline void ull_proprietary_done(struct node_rx_event_done *evdone)
{
	/* Nothing to do */
}


static inline uint16_t ull_conn_interval_min_get(struct ll_conn *conn)
{
	/* Just return a value */
	return 6;
}

#endif /* CONFIG_BT_CTLR_USER_EXT */
```
