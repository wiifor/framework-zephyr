## CMakeLists.txt
```
# SPDX-License-Identifier: Apache-2.0

cmake_minimum_required(VERSION 3.13.1)
find_package(Zephyr REQUIRED HINTS $ENV{ZEPHYR_BASE})
project(cbprintf_package)

target_sources(app PRIVATE src/main.c src/maincxx.cxx)
```

## prj.conf
```kconfig
CONFIG_ZTEST=y
CONFIG_CBPRINTF_LIBC_SUBSTS=y
```

## src/main.c
```c
/*
 * Copyright (c) 2021 Nordic Semiconductor ASA
 *
 * SPDX-License-Identifier: Apache-2.0
 */
#include <ztest.h>
#include <string.h>

#include "test.inc"

void test_cxx(void);
void test_cc(void);

void test_main(void)
{
	test_cc();
	test_cxx();
}
```
