## CMakeLists.txt
```
# SPDX-License-Identifier: Apache-2.0

cmake_minimum_required(VERSION 3.13.1)

find_package(Zephyr REQUIRED HINTS $ENV{ZEPHYR_BASE})
project(cbprintf_fp)

target_sources(app PRIVATE src/main.c)
```

## Kconfig
```
# Copyright (c) 2020 Nordic Semiconductor ASA
# SPDX-License-Identifier: Apache-2.0

choice APP_FORMATTER
	prompt "Select print formatter"
	default APP_FORMATTER_PRINTK

config APP_FORMATTER_PRINTK
	bool "Emit with printk"

config APP_FORMATTER_PRINTF
	bool "Emit with printf"

config APP_FORMATTER_PRINTFCB
	bool "Emit with printfcb"

config APP_FORMATTER_FPRINTF
	bool "Emit with fprintf"

config APP_FORMATTER_FPRINTFCB
	bool "Emit with fprintfcb"

endchoice # APP_FORMATTER

source "Kconfig.zephyr"
```

## prj.conf
```kconfig
CONFIG_TEST=y
CONFIG_STDOUT_CONSOLE=y
CONFIG_CBPRINTF_LIBC_SUBSTS=y
```

## src/main.c
```c
/*
 * Copyright (c) 2020 Nordic Semiconductor ASA
 *
 * SPDX-License-Identifier: Apache-2.0
 */

#if defined(CONFIG_APP_FORMATTER_PRINTK)
#include <sys/printk.h>
#define PRINT_S "printk"
#define PRINT(...) printk(__VA_ARGS__)
#elif defined(CONFIG_APP_FORMATTER_PRINTF)
#include <stdio.h>
#ifdef CONFIG_NEWLIB_LIBC
#define PRINT_S "printf/newlib"
#else /* NEWLIB_LIBC */
#define PRINT_S "printf"
#endif /* NEWLIB_LIBC */
#define PRINT(...) printf(__VA_ARGS__)
#elif defined(CONFIG_APP_FORMATTER_PRINTFCB)
#include <sys/cbprintf.h>
#ifdef CONFIG_NEWLIB_LIBC
#define PRINT_S "printfcb/newlib"
#else /* NEWLIB_LIBC */
#define PRINT_S "printfcb"
#endif /* NEWLIB_LIBC */
#define PRINT(...) printfcb(__VA_ARGS__)
#elif defined(CONFIG_APP_FORMATTER_FPRINTF)
#include <stdio.h>
#define PRINT_S "fprintf"
#define PRINT(...) fprintf(stdout, __VA_ARGS__)
#elif defined(CONFIG_APP_FORMATTER_FPRINTFCB)
#include <sys/cbprintf.h>
#define PRINT_S "fprintfcb"
#define PRINT(...) fprintfcb(stdout, __VA_ARGS__)
#else
#error Unsupported configuration
#endif

void main(void)
{
	PRINT("Hello with %s on %s\nComplete\n", PRINT_S, CONFIG_BOARD);
}
```
