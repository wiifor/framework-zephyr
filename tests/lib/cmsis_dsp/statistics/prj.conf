## CMakeLists.txt
```
# SPDX-License-Identifier: Apache-2.0

cmake_minimum_required(VERSION 3.13.1)
find_package(Zephyr REQUIRED HINTS $ENV{ZEPHYR_BASE})
project(cmsis_dsp_statistics)

FILE(GLOB app_sources src/*.c)
target_sources(app PRIVATE ${app_sources})
```

## prj.conf
```kconfig
CONFIG_ZTEST=y
CONFIG_NEWLIB_LIBC=y
CONFIG_CMSIS_DSP=y
CONFIG_CMSIS_DSP_STATISTICS=y
```

## src/main.c
```c
/*
 * Copyright (c) 2020 Stephanos Ioannidis <root@stephanos.io>
 *
 * SPDX-License-Identifier: Apache-2.0
 */

#include <ztest.h>
#include <zephyr.h>

extern void test_statistics_q7(void);
extern void test_statistics_q15(void);
extern void test_statistics_q31(void);
extern void test_statistics_f32(void);
extern void test_statistics_f64(void);

void test_main(void)
{
	test_statistics_q7();
	test_statistics_q15();
	test_statistics_q31();
	test_statistics_f32();
	test_statistics_f64();
}
```

## src/f32.c
```c
/*
 * Copyright (c) 2020 Stephanos Ioannidis <root@stephanos.io>
 * Copyright (C) 2010-2020 ARM Limited or its affiliates. All rights reserved.
 *
 * SPDX-License-Identifier: Apache-2.0
 */

#include <ztest.h>
#include <zephyr.h>
#include <stdlib.h>
#include <arm_math.h>
#include "../../common/test_common.h"

#include "f32.pat"

#define SNR_ERROR_THRESH	((float32_t)120)
#define REL_ERROR_THRESH	(1.0e-5)

static void test_arm_max_f32(
	const uint32_t *input1, int ref_index, size_t length)
{
	float32_t val;
	uint32_t index;

	/* Run test function */
	arm_max_f32((float32_t *)input1, length, &val, &index);

	/* Validate output */
	zassert_equal(val, ((float32_t *)ref_max_val)[ref_index],
		ASSERT_MSG_INCORRECT_COMP_RESULT);

	zassert_equal(index, ref_max_idx[ref_index],
		ASSERT_MSG_INCORRECT_COMP_RESULT);
}

DEFINE_TEST_VARIANT3(arm_max_f32, 3, in_com1, 0, 3);
DEFINE_TEST_VARIANT3(arm_max_f32, 8, in_com1, 1, 8);
DEFINE_TEST_VARIANT3(arm_max_f32, 11, in_com1, 2, 11);

static void test_arm_max_no_idx_f32(
	const uint32_t *input1, int ref_index, size_t length)
{
	float32_t val;

	/* Run test function */
	arm_max_no_idx_f32((float32_t *)input1, length, &val);

	/* Validate output */
	zassert_equal(val, ((float32_t *)ref_max_val)[ref_index],
		ASSERT_MSG_INCORRECT_COMP_RESULT);
}

DEFINE_TEST_VARIANT3(arm_max_no_idx_f32, 3, in_com1, 0, 3);
DEFINE_TEST_VARIANT3(arm_max_no_idx_f32, 8, in_com1, 1, 8);
DEFINE_TEST_VARIANT3(arm_max_no_idx_f32, 11, in_com1, 2, 11);

static void test_arm_min_f32(
	const uint32_t *input1, int ref_index, size_t length)
{
	float32_t val;
	uint32_t index;

	/* Run test function */
	arm_min_f32((float32_t *)input1, length, &val, &index);

	/* Validate output */
	zassert_equal(val, ((float32_t *)ref_min_val)[ref_index],
		ASSERT_MSG_INCORRECT_COMP_RESULT);

	zassert_equal(index, ref_min_idx[ref_index],
		ASSERT_MSG_INCORRECT_COMP_RESULT);
}

DEFINE_TEST_VARIANT3(arm_min_f32, 3, in_com1, 0, 3);
DEFINE_TEST_VARIANT3(arm_min_f32, 8, in_com1, 1, 8);
DEFINE_TEST_VARIANT3(arm_min_f32, 11, in_com1, 2, 11);

static void test_arm_mean_f32(
	const uint32_t *input1, int ref_index, size_t length)
{
	float32_t ref[1];
	float32_t *output;

	/* Load reference */
	ref[0] = ((float32_t *)ref_mean)[ref_index];

	/* Allocate output buffer */
	output = malloc(1 * sizeof(float32_t));
	zassert_not_null(output, ASSERT_MSG_BUFFER_ALLOC_FAILED);

	/* Run test function */
	arm_mean_f32((float32_t *)input1, length, &output[0]);

	/* Validate output */
	zassert_true(
		test_snr_error_f32(1, output, ref, SNR_ERROR_THRESH),
		ASSERT_MSG_SNR_LIMIT_EXCEED);

	zassert_true(
		test_rel_error_f32(1, output, ref, REL_ERROR_THRESH),
		ASSERT_MSG_REL_ERROR_LIMIT_EXCEED);

	/* Free output buffer */
	free(output);
}

DEFINE_TEST_VARIANT3(arm_mean_f32, 3, in_com2, 0, 3);
DEFINE_TEST_VARIANT3(arm_mean_f32, 8, in_com2, 1, 8);
DEFINE_TEST_VARIANT3(arm_mean_f32, 11, in_com2, 2, 11);

static void test_arm_power_f32(
	const uint32_t *input1, int ref_index, size_t length)
{
	float32_t ref[1];
	float32_t *output;

	/* Load reference */
	ref[0] = ((float32_t *)ref_power)[ref_index];

	/* Allocate output buffer */
	output = malloc(1 * sizeof(float32_t));
	zassert_not_null(output, ASSERT_MSG_BUFFER_ALLOC_FAILED);

	/* Run test function */
	arm_power_f32((float32_t *)input1, length, &output[0]);

	/* Validate output */
	zassert_true(
		test_snr_error_f32(1, output, ref, SNR_ERROR_THRESH),
		ASSERT_MSG_SNR_LIMIT_EXCEED);

	zassert_true(
		test_rel_error_f32(1, output, ref, REL_ERROR_THRESH),
		ASSERT_MSG_REL_ERROR_LIMIT_EXCEED);

	/* Free output buffer */
	free(output);
}

DEFINE_TEST_VARIANT3(arm_power_f32, 3, in_com1, 0, 3);
DEFINE_TEST_VARIANT3(arm_power_f32, 8, in_com1, 1, 8);
DEFINE_TEST_VARIANT3(arm_power_f32, 11, in_com1, 2, 11);

static void test_arm_rms_f32(
	const uint32_t *input1, int ref_index, size_t length)
{
	float32_t ref[1];
	float32_t *output;

	/* Load reference */
	ref[0] = ((float32_t *)ref_rms)[ref_index];

	/* Allocate output buffer */
	output = malloc(1 * sizeof(float32_t));
	zassert_not_null(output, ASSERT_MSG_BUFFER_ALLOC_FAILED);

	/* Run test function */
	arm_rms_f32((float32_t *)input1, length, &output[0]);

	/* Validate output */
	zassert_true(
		test_snr_error_f32(1, output, ref, SNR_ERROR_THRESH),
		ASSERT_MSG_SNR_LIMIT_EXCEED);

	zassert_true(
		test_rel_error_f32(1, output, ref, REL_ERROR_THRESH),
		ASSERT_MSG_REL_ERROR_LIMIT_EXCEED);

	/* Free output buffer */
	free(output);
}

DEFINE_TEST_VARIANT3(arm_rms_f32, 3, in_com1, 0, 3);
DEFINE_TEST_VARIANT3(arm_rms_f32, 8, in_com1, 1, 8);
DEFINE_TEST_VARIANT3(arm_rms_f32, 11, in_com1, 2, 11);

static void test_arm_std_f32(
	const uint32_t *input1, int ref_index, size_t length)
{
	float32_t ref[1];
	float32_t *output;

	/* Load reference */
	ref[0] = ((float32_t *)ref_std)[ref_index];

	/* Allocate output buffer */
	output = malloc(1 * sizeof(float32_t));
	zassert_not_null(output, ASSERT_MSG_BUFFER_ALLOC_FAILED);

	/* Run test function */
	arm_std_f32((float32_t *)input1, length, &output[0]);

	/* Validate output */
	zassert_true(
		test_snr_error_f32(1, output, ref, SNR_ERROR_THRESH),
		ASSERT_MSG_SNR_LIMIT_EXCEED);

	zassert_true(
		test_rel_error_f32(1, output, ref, REL_ERROR_THRESH),
		ASSERT_MSG_REL_ERROR_LIMIT_EXCEED);

	/* Free output buffer */
	free(output);
}

DEFINE_TEST_VARIANT3(arm_std_f32, 3, in_com1, 0, 3);
DEFINE_TEST_VARIANT3(arm_std_f32, 8, in_com1, 1, 8);
DEFINE_TEST_VARIANT3(arm_std_f32, 11, in_com1, 2, 11);

static void test_arm_var_f32(
	const uint32_t *input1, int ref_index, size_t length)
{
	float32_t ref[1];
	float32_t *output;

	/* Load reference */
	ref[0] = ((float32_t *)ref_var)[ref_index];

	/* Allocate output buffer */
	output = malloc(1 * sizeof(float32_t));
	zassert_not_null(output, ASSERT_MSG_BUFFER_ALLOC_FAILED);

	/* Run test function */
	arm_var_f32((float32_t *)input1, length, &output[0]);

	/* Validate output */
	zassert_true(
		test_snr_error_f32(1, output, ref, SNR_ERROR_THRESH),
		ASSERT_MSG_SNR_LIMIT_EXCEED);

	zassert_true(
		test_rel_error_f32(1, output, ref, REL_ERROR_THRESH),
		ASSERT_MSG_REL_ERROR_LIMIT_EXCEED);

	/* Free output buffer */
	free(output);
}

DEFINE_TEST_VARIANT3(arm_var_f32, 3, in_com1, 0, 3);
DEFINE_TEST_VARIANT3(arm_var_f32, 8, in_com1, 1, 8);
DEFINE_TEST_VARIANT3(arm_var_f32, 11, in_com1, 2, 11);

static void test_arm_entropy_f32(void)
{
	size_t index;
	size_t length = in_entropy_dim[0];
	const float32_t *ref = (float32_t *)ref_entropy;
	const float32_t *input = (float32_t *)in_entropy;
	float32_t *output;

	__ASSERT_NO_MSG(ARRAY_SIZE(in_entropy_dim) > length);
	__ASSERT_NO_MSG(ARRAY_SIZE(ref_entropy) >= length);

	/* Allocate output buffer */
	output = malloc(length * sizeof(float32_t));
	zassert_not_null(output, ASSERT_MSG_BUFFER_ALLOC_FAILED);

	/* Run test function */
	for (index = 0; index < length; index++) {
		output[index] =
			arm_entropy_f32(input, in_entropy_dim[index + 1]);
		input += in_entropy_dim[index + 1];
	}

	/* Validate output */
	zassert_true(
		test_snr_error_f32(length, ref, output, SNR_ERROR_THRESH),
		ASSERT_MSG_SNR_LIMIT_EXCEED);

	zassert_true(
		test_near_equal_f32(length, ref, output, REL_ERROR_THRESH),
		ASSERT_MSG_REL_ERROR_LIMIT_EXCEED);

	/* Free output buffer */
	free(output);
}

static void test_arm_logsumexp_f32(void)
{
	size_t index;
	size_t length = in_logsumexp_dim[0];
	const float32_t *ref = (float32_t *)ref_logsumexp;
	const float32_t *input = (float32_t *)in_logsumexp;
	float32_t *output;

	__ASSERT_NO_MSG(ARRAY_SIZE(in_logsumexp_dim) > length);
	__ASSERT_NO_MSG(ARRAY_SIZE(ref_logsumexp) >= length);

	/* Allocate output buffer */
	output = malloc(length * sizeof(float32_t));
	zassert_not_null(output, ASSERT_MSG_BUFFER_ALLOC_FAILED);

	/* Run test function */
	for (index = 0; index < length; index++) {
		output[index] =
			arm_logsumexp_f32(input, in_logsumexp_dim[index + 1]);
		input += in_logsumexp_dim[index + 1];
	}

	/* Validate output */
	zassert_true(
		test_snr_error_f32(length, ref, output, SNR_ERROR_THRESH),
		ASSERT_MSG_SNR_LIMIT_EXCEED);

	zassert_true(
		test_near_equal_f32(length, ref, output, REL_ERROR_THRESH),
		ASSERT_MSG_REL_ERROR_LIMIT_EXCEED);

	/* Free output buffer */
	free(output);
}

static void test_arm_kullback_leibler_f32(void)
{
	size_t index;
	size_t length = in_kl_dim[0];
	const float32_t *ref = (float32_t *)ref_kl;
	const float32_t *input1 = (float32_t *)in_kl1;
	const float32_t *input2 = (float32_t *)in_kl2;
	float32_t *output;

	__ASSERT_NO_MSG(ARRAY_SIZE(in_kl_dim) > length);
	__ASSERT_NO_MSG(ARRAY_SIZE(ref_kl) >= length);

	/* Allocate output buffer */
	output = malloc(length * sizeof(float32_t));
	zassert_not_null(output, ASSERT_MSG_BUFFER_ALLOC_FAILED);

	/* Run test function */
	for (index = 0; index < length; index++) {
		output[index] =
			arm_kullback_leibler_f32(
				input1, input2, in_kl_dim[index + 1]);

		input1 += in_kl_dim[index + 1];
		input2 += in_kl_dim[index + 1];
	}

	/* Validate output */
	zassert_true(
		test_snr_error_f32(length, ref, output, SNR_ERROR_THRESH),
		ASSERT_MSG_SNR_LIMIT_EXCEED);

	zassert_true(
		test_near_equal_f32(length, ref, output, REL_ERROR_THRESH),
		ASSERT_MSG_REL_ERROR_LIMIT_EXCEED);

	/* Free output buffer */
	free(output);
}

static void test_arm_logsumexp_dot_prod_f32(void)
{
	size_t index;
	size_t length = in_logsumexp_dp_dim[0];
	const float32_t *ref = (float32_t *)ref_logsumexp_dp;
	const float32_t *input1 = (float32_t *)in_logsumexp_dp1;
	const float32_t *input2 = (float32_t *)in_logsumexp_dp2;
	float32_t *output;
	float32_t *tmp;

	__ASSERT_NO_MSG(ARRAY_SIZE(in_logsumexp_dp_dim) > length);
	__ASSERT_NO_MSG(ARRAY_SIZE(ref_logsumexp_dp) >= length);

	/* Allocate buffers */
	output = malloc(length * sizeof(float32_t));
	zassert_not_null(output, ASSERT_MSG_BUFFER_ALLOC_FAILED);

	tmp = malloc(12 * sizeof(float32_t));
	zassert_not_null(tmp, ASSERT_MSG_BUFFER_ALLOC_FAILED);

	/* Run test function */
	for (index = 0; index < length; index++) {
		output[index] =
			arm_logsumexp_dot_prod_f32(
				input1, input2,
				in_logsumexp_dp_dim[index + 1], tmp);

		input1 += in_logsumexp_dp_dim[index + 1];
		input2 += in_logsumexp_dp_dim[index + 1];
	}

	/* Validate output */
	zassert_true(
		test_snr_error_f32(length, ref, output, SNR_ERROR_THRESH),
		ASSERT_MSG_SNR_LIMIT_EXCEED);

	zassert_true(
		test_near_equal_f32(length, ref, output, REL_ERROR_THRESH),
		ASSERT_MSG_REL_ERROR_LIMIT_EXCEED);

	/* Free buffers */
	free(output);
	free(tmp);
}

void test_statistics_f32(void)
{
	ztest_test_suite(statistics_f32,
		ztest_unit_test(test_arm_max_f32_3),
		ztest_unit_test(test_arm_max_f32_8),
		ztest_unit_test(test_arm_max_f32_11),
		ztest_unit_test(test_arm_min_f32_3),
		ztest_unit_test(test_arm_min_f32_8),
		ztest_unit_test(test_arm_min_f32_11),
		ztest_unit_test(test_arm_mean_f32_3),
		ztest_unit_test(test_arm_mean_f32_8),
		ztest_unit_test(test_arm_mean_f32_11),
		ztest_unit_test(test_arm_power_f32_3),
		ztest_unit_test(test_arm_power_f32_8),
		ztest_unit_test(test_arm_power_f32_11),
		ztest_unit_test(test_arm_rms_f32_3),
		ztest_unit_test(test_arm_rms_f32_8),
		ztest_unit_test(test_arm_rms_f32_11),
		ztest_unit_test(test_arm_std_f32_3),
		ztest_unit_test(test_arm_std_f32_8),
		ztest_unit_test(test_arm_std_f32_11),
		ztest_unit_test(test_arm_var_f32_3),
		ztest_unit_test(test_arm_var_f32_8),
		ztest_unit_test(test_arm_var_f32_11),
		ztest_unit_test(test_arm_entropy_f32),
		ztest_unit_test(test_arm_logsumexp_f32),
		ztest_unit_test(test_arm_kullback_leibler_f32),
		ztest_unit_test(test_arm_logsumexp_dot_prod_f32),
		ztest_unit_test(test_arm_max_no_idx_f32_3),
		ztest_unit_test(test_arm_max_no_idx_f32_8),
		ztest_unit_test(test_arm_max_no_idx_f32_11)
		);

	ztest_run_test_suite(statistics_f32);
}
```

## src/f64.c
```c
/*
 * Copyright (c) 2020 Stephanos Ioannidis <root@stephanos.io>
 * Copyright (C) 2010-2020 ARM Limited or its affiliates. All rights reserved.
 *
 * SPDX-License-Identifier: Apache-2.0
 */

#include <ztest.h>
#include <zephyr.h>
#include <stdlib.h>
#include <arm_math.h>
#include "../../common/test_common.h"

#include "f64.pat"

#define SNR_ERROR_THRESH	((float64_t)300)
#define REL_ERROR_THRESH	(1.0e-14)

static void test_arm_entropy_f64(void)
{
	size_t index;
	size_t length = in_entropy_dim[0];
	const float64_t *ref = (float64_t *)ref_entropy;
	const float64_t *input = (float64_t *)in_entropy;
	float64_t *output;

	__ASSERT_NO_MSG(ARRAY_SIZE(in_entropy_dim) > length);
	__ASSERT_NO_MSG(ARRAY_SIZE(ref_entropy) >= length);

	/* Allocate output buffer */
	output = malloc(length * sizeof(float64_t));
	zassert_not_null(output, ASSERT_MSG_BUFFER_ALLOC_FAILED);

	/* Run test function */
	for (index = 0; index < length; index++) {
		output[index] =
			arm_entropy_f64(input, in_entropy_dim[index + 1]);
		input += in_entropy_dim[index + 1];
	}

	/* Validate output */
	zassert_true(
		test_snr_error_f64(length, ref, output, SNR_ERROR_THRESH),
		ASSERT_MSG_SNR_LIMIT_EXCEED);

	zassert_true(
		test_near_equal_f64(length, ref, output, REL_ERROR_THRESH),
		ASSERT_MSG_REL_ERROR_LIMIT_EXCEED);

	/* Free output buffer */
	free(output);
}

static void test_arm_kullback_leibler_f64(void)
{
	size_t index;
	size_t length = in_kl_dim[0];
	const float64_t *ref = (float64_t *)ref_kl;
	const float64_t *input1 = (float64_t *)in_kl1;
	const float64_t *input2 = (float64_t *)in_kl2;
	float64_t *output;

	__ASSERT_NO_MSG(ARRAY_SIZE(in_kl_dim) > length);
	__ASSERT_NO_MSG(ARRAY_SIZE(ref_kl) >= length);

	/* Allocate output buffer */
	output = malloc(length * sizeof(float64_t));
	zassert_not_null(output, ASSERT_MSG_BUFFER_ALLOC_FAILED);

	/* Run test function */
	for (index = 0; index < length; index++) {
		output[index] =
			arm_kullback_leibler_f64(
				input1, input2, in_kl_dim[index + 1]);

		input1 += in_kl_dim[index + 1];
		input2 += in_kl_dim[index + 1];
	}

	/* Validate output */
	zassert_true(
		test_snr_error_f64(length, ref, output, SNR_ERROR_THRESH),
		ASSERT_MSG_SNR_LIMIT_EXCEED);

	zassert_true(
		test_near_equal_f64(length, ref, output, REL_ERROR_THRESH),
		ASSERT_MSG_REL_ERROR_LIMIT_EXCEED);

	/* Free output buffer */
	free(output);
}

void test_statistics_f64(void)
{
	ztest_test_suite(statistics_f64,
		ztest_unit_test(test_arm_entropy_f64),
		ztest_unit_test(test_arm_kullback_leibler_f64)
		);

	ztest_run_test_suite(statistics_f64);
}
```

## src/q15.c
```c
/*
 * Copyright (c) 2020 Stephanos Ioannidis <root@stephanos.io>
 * Copyright (C) 2010-2020 ARM Limited or its affiliates. All rights reserved.
 *
 * SPDX-License-Identifier: Apache-2.0
 */

#include <ztest.h>
#include <zephyr.h>
#include <stdlib.h>
#include <arm_math.h>
#include "../../common/test_common.h"

#include "q15.pat"

#define SNR_ERROR_THRESH	((float32_t)50)
#define ABS_ERROR_THRESH_Q15	((q15_t)100)
#define ABS_ERROR_THRESH_Q63	((q63_t)(1 << 17))

static void test_arm_max_q15(
	const q15_t *input1, int ref_index, size_t length)
{
	q15_t val;
	uint32_t index;

	/* Run test function */
	arm_max_q15(input1, length, &val, &index);

	/* Validate output */
	zassert_equal(val, ref_max_val[ref_index],
		ASSERT_MSG_INCORRECT_COMP_RESULT);

	zassert_equal(index, ref_max_idx[ref_index],
		ASSERT_MSG_INCORRECT_COMP_RESULT);
}

DEFINE_TEST_VARIANT3(arm_max_q15, 7, in_com1, 0, 7);
DEFINE_TEST_VARIANT3(arm_max_q15, 16, in_com1, 1, 16);
DEFINE_TEST_VARIANT3(arm_max_q15, 23, in_com1, 2, 23);

static void test_arm_min_q15(
	const q15_t *input1, int ref_index, size_t length)
{
	q15_t val;
	uint32_t index;

	/* Run test function */
	arm_min_q15(input1, length, &val, &index);

	/* Validate output */
	zassert_equal(val, ref_min_val[ref_index],
		ASSERT_MSG_INCORRECT_COMP_RESULT);

	zassert_equal(index, ref_min_idx[ref_index],
		ASSERT_MSG_INCORRECT_COMP_RESULT);
}

DEFINE_TEST_VARIANT3(arm_min_q15, 7, in_com1, 0, 7);
DEFINE_TEST_VARIANT3(arm_min_q15, 16, in_com1, 1, 16);
DEFINE_TEST_VARIANT3(arm_min_q15, 23, in_com1, 2, 23);

static void test_arm_mean_q15(
	const q15_t *input1, int ref_index, size_t length)
{
	q15_t ref[1];
	q15_t *output;

	/* Load reference */
	ref[0] = ref_mean[ref_index];

	/* Allocate output buffer */
	output = malloc(1 * sizeof(q15_t));
	zassert_not_null(output, ASSERT_MSG_BUFFER_ALLOC_FAILED);

	/* Run test function */
	arm_mean_q15(input1, length, &output[0]);

	/* Validate output */
	zassert_true(
		test_snr_error_q15(1, output, ref, SNR_ERROR_THRESH),
		ASSERT_MSG_SNR_LIMIT_EXCEED);

	zassert_true(
		test_near_equal_q15(1, output, ref, ABS_ERROR_THRESH_Q15),
		ASSERT_MSG_ABS_ERROR_LIMIT_EXCEED);

	/* Free output buffer */
	free(output);
}

DEFINE_TEST_VARIANT3(arm_mean_q15, 7, in_com2, 0, 7);
DEFINE_TEST_VARIANT3(arm_mean_q15, 16, in_com2, 1, 16);
DEFINE_TEST_VARIANT3(arm_mean_q15, 23, in_com2, 2, 23);

static void test_arm_power_q15(
	const q15_t *input1, int ref_index, size_t length)
{
	q63_t ref[1];
	q63_t *output;

	/* Load reference */
	ref[0] = ref_power[ref_index];

	/* Allocate output buffer */
	output = malloc(1 * sizeof(q63_t));
	zassert_not_null(output, ASSERT_MSG_BUFFER_ALLOC_FAILED);

	/* Run test function */
	arm_power_q15(input1, length, &output[0]);

	/* Validate output */
	zassert_true(
		test_snr_error_q63(1, output, ref, SNR_ERROR_THRESH),
		ASSERT_MSG_SNR_LIMIT_EXCEED);

	zassert_true(
		test_near_equal_q63(1, output, ref, ABS_ERROR_THRESH_Q63),
		ASSERT_MSG_ABS_ERROR_LIMIT_EXCEED);

	/* Free output buffer */
	free(output);
}

DEFINE_TEST_VARIANT3(arm_power_q15, 7, in_com1, 0, 7);
DEFINE_TEST_VARIANT3(arm_power_q15, 16, in_com1, 1, 16);
DEFINE_TEST_VARIANT3(arm_power_q15, 23, in_com1, 2, 23);

static void test_arm_rms_q15(
	const q15_t *input1, int ref_index, size_t length)
{
	q15_t ref[1];
	q15_t *output;

	/* Load reference */
	ref[0] = ref_rms[ref_index];

	/* Allocate output buffer */
	output = malloc(1 * sizeof(q15_t));
	zassert_not_null(output, ASSERT_MSG_BUFFER_ALLOC_FAILED);

	/* Run test function */
	arm_rms_q15(input1, length, &output[0]);

	/* Validate output */
	zassert_true(
		test_snr_error_q15(1, output, ref, SNR_ERROR_THRESH),
		ASSERT_MSG_SNR_LIMIT_EXCEED);

	zassert_true(
		test_near_equal_q15(1, output, ref, ABS_ERROR_THRESH_Q15),
		ASSERT_MSG_ABS_ERROR_LIMIT_EXCEED);

	/* Free output buffer */
	free(output);
}

DEFINE_TEST_VARIANT3(arm_rms_q15, 7, in_com1, 0, 7);
DEFINE_TEST_VARIANT3(arm_rms_q15, 16, in_com1, 1, 16);
DEFINE_TEST_VARIANT3(arm_rms_q15, 23, in_com1, 2, 23);

static void test_arm_std_q15(
	const q15_t *input1, int ref_index, size_t length)
{
	q15_t ref[1];
	q15_t *output;

	/* Load reference */
	ref[0] = ref_std[ref_index];

	/* Allocate output buffer */
	output = malloc(1 * sizeof(q15_t));
	zassert_not_null(output, ASSERT_MSG_BUFFER_ALLOC_FAILED);

	/* Run test function */
	arm_std_q15(input1, length, &output[0]);

	/* Validate output */
	zassert_true(
		test_snr_error_q15(1, output, ref, SNR_ERROR_THRESH),
		ASSERT_MSG_SNR_LIMIT_EXCEED);

	zassert_true(
		test_near_equal_q15(1, output, ref, ABS_ERROR_THRESH_Q15),
		ASSERT_MSG_ABS_ERROR_LIMIT_EXCEED);

	/* Free output buffer */
	free(output);
}

DEFINE_TEST_VARIANT3(arm_std_q15, 7, in_com1, 0, 7);
DEFINE_TEST_VARIANT3(arm_std_q15, 16, in_com1, 1, 16);
DEFINE_TEST_VARIANT3(arm_std_q15, 23, in_com1, 2, 23);

static void test_arm_var_q15(
	const q15_t *input1, int ref_index, size_t length)
{
	q15_t ref[1];
	q15_t *output;

	/* Load reference */
	ref[0] = ref_var[ref_index];

	/* Allocate output buffer */
	output = malloc(1 * sizeof(q15_t));
	zassert_not_null(output, ASSERT_MSG_BUFFER_ALLOC_FAILED);

	/* Run test function */
	arm_var_q15(input1, length, &output[0]);

	/* Validate output */
	zassert_true(
		test_snr_error_q15(1, output, ref, SNR_ERROR_THRESH),
		ASSERT_MSG_SNR_LIMIT_EXCEED);

	zassert_true(
		test_near_equal_q15(1, output, ref, ABS_ERROR_THRESH_Q15),
		ASSERT_MSG_ABS_ERROR_LIMIT_EXCEED);

	/* Free output buffer */
	free(output);
}

DEFINE_TEST_VARIANT3(arm_var_q15, 7, in_com1, 0, 7);
DEFINE_TEST_VARIANT3(arm_var_q15, 16, in_com1, 1, 16);
DEFINE_TEST_VARIANT3(arm_var_q15, 23, in_com1, 2, 23);

void test_statistics_q15(void)
{
	ztest_test_suite(statistics_q15,
		ztest_unit_test(test_arm_max_q15_7),
		ztest_unit_test(test_arm_max_q15_16),
		ztest_unit_test(test_arm_max_q15_23),
		ztest_unit_test(test_arm_min_q15_7),
		ztest_unit_test(test_arm_min_q15_16),
		ztest_unit_test(test_arm_min_q15_23),
		ztest_unit_test(test_arm_mean_q15_7),
		ztest_unit_test(test_arm_mean_q15_16),
		ztest_unit_test(test_arm_mean_q15_23),
		ztest_unit_test(test_arm_power_q15_7),
		ztest_unit_test(test_arm_power_q15_16),
		ztest_unit_test(test_arm_power_q15_23),
		ztest_unit_test(test_arm_rms_q15_7),
		ztest_unit_test(test_arm_rms_q15_16),
		ztest_unit_test(test_arm_rms_q15_23),
		ztest_unit_test(test_arm_std_q15_7),
		ztest_unit_test(test_arm_std_q15_16),
		ztest_unit_test(test_arm_std_q15_23),
		ztest_unit_test(test_arm_var_q15_7),
		ztest_unit_test(test_arm_var_q15_16),
		ztest_unit_test(test_arm_var_q15_23)
		);

	ztest_run_test_suite(statistics_q15);
}
```

## src/q31.c
```c
/*
 * Copyright (c) 2020 Stephanos Ioannidis <root@stephanos.io>
 * Copyright (C) 2010-2020 ARM Limited or its affiliates. All rights reserved.
 *
 * SPDX-License-Identifier: Apache-2.0
 */

#include <ztest.h>
#include <zephyr.h>
#include <stdlib.h>
#include <arm_math.h>
#include "../../common/test_common.h"

#include "q31.pat"

#define SNR_ERROR_THRESH	((float32_t)100)
#define ABS_ERROR_THRESH_Q15	((q31_t)100)
#define ABS_ERROR_THRESH_Q63	((q63_t)(1 << 18))

static void test_arm_max_q31(
	const q31_t *input1, int ref_index, size_t length)
{
	q31_t val;
	uint32_t index;

	/* Run test function */
	arm_max_q31(input1, length, &val, &index);

	/* Validate output */
	zassert_equal(val, ref_max_val[ref_index],
		ASSERT_MSG_INCORRECT_COMP_RESULT);

	zassert_equal(index, ref_max_idx[ref_index],
		ASSERT_MSG_INCORRECT_COMP_RESULT);
}

DEFINE_TEST_VARIANT3(arm_max_q31, 3, in_com1, 0, 3);
DEFINE_TEST_VARIANT3(arm_max_q31, 8, in_com1, 1, 8);
DEFINE_TEST_VARIANT3(arm_max_q31, 11, in_com1, 2, 11);

static void test_arm_min_q31(
	const q31_t *input1, int ref_index, size_t length)
{
	q31_t val;
	uint32_t index;

	/* Run test function */
	arm_min_q31(input1, length, &val, &index);

	/* Validate output */
	zassert_equal(val, ref_min_val[ref_index],
		ASSERT_MSG_INCORRECT_COMP_RESULT);

	zassert_equal(index, ref_min_idx[ref_index],
		ASSERT_MSG_INCORRECT_COMP_RESULT);
}

DEFINE_TEST_VARIANT3(arm_min_q31, 3, in_com1, 0, 3);
DEFINE_TEST_VARIANT3(arm_min_q31, 8, in_com1, 1, 8);
DEFINE_TEST_VARIANT3(arm_min_q31, 11, in_com1, 2, 11);

static void test_arm_mean_q31(
	const q31_t *input1, int ref_index, size_t length)
{
	q31_t ref[1];
	q31_t *output;

	/* Load reference */
	ref[0] = ref_mean[ref_index];

	/* Allocate output buffer */
	output = malloc(1 * sizeof(q31_t));
	zassert_not_null(output, ASSERT_MSG_BUFFER_ALLOC_FAILED);

	/* Run test function */
	arm_mean_q31(input1, length, &output[0]);

	/* Validate output */
	zassert_true(
		test_snr_error_q31(1, output, ref, SNR_ERROR_THRESH),
		ASSERT_MSG_SNR_LIMIT_EXCEED);

	zassert_true(
		test_near_equal_q31(1, output, ref, ABS_ERROR_THRESH_Q15),
		ASSERT_MSG_ABS_ERROR_LIMIT_EXCEED);

	/* Free output buffer */
	free(output);
}

DEFINE_TEST_VARIANT3(arm_mean_q31, 3, in_com2, 0, 3);
DEFINE_TEST_VARIANT3(arm_mean_q31, 8, in_com2, 1, 8);
DEFINE_TEST_VARIANT3(arm_mean_q31, 11, in_com2, 2, 11);

static void test_arm_power_q31(
	const q31_t *input1, int ref_index, size_t length)
{
	q63_t ref[1];
	q63_t *output;

	/* Load reference */
	ref[0] = ref_power[ref_index];

	/* Allocate output buffer */
	output = malloc(1 * sizeof(q63_t));
	zassert_not_null(output, ASSERT_MSG_BUFFER_ALLOC_FAILED);

	/* Run test function */
	arm_power_q31(input1, length, &output[0]);

	/* Validate output */
	zassert_true(
		test_snr_error_q63(1, output, ref, SNR_ERROR_THRESH),
		ASSERT_MSG_SNR_LIMIT_EXCEED);

	zassert_true(
		test_near_equal_q63(1, output, ref, ABS_ERROR_THRESH_Q63),
		ASSERT_MSG_ABS_ERROR_LIMIT_EXCEED);

	/* Free output buffer */
	free(output);
}

DEFINE_TEST_VARIANT3(arm_power_q31, 3, in_com1, 0, 3);
DEFINE_TEST_VARIANT3(arm_power_q31, 8, in_com1, 1, 8);
DEFINE_TEST_VARIANT3(arm_power_q31, 11, in_com1, 2, 11);

static void test_arm_rms_q31(
	const q31_t *input1, int ref_index, size_t length)
{
	q31_t ref[1];
	q31_t *output;

	/* Load reference */
	ref[0] = ref_rms[ref_index];

	/* Allocate output buffer */
	output = malloc(1 * sizeof(q31_t));
	zassert_not_null(output, ASSERT_MSG_BUFFER_ALLOC_FAILED);

	/* Run test function */
	arm_rms_q31(input1, length, &output[0]);

	/* Validate output */
	zassert_true(
		test_snr_error_q31(1, output, ref, SNR_ERROR_THRESH),
		ASSERT_MSG_SNR_LIMIT_EXCEED);

	zassert_true(
		test_near_equal_q31(1, output, ref, ABS_ERROR_THRESH_Q15),
		ASSERT_MSG_ABS_ERROR_LIMIT_EXCEED);

	/* Free output buffer */
	free(output);
}

DEFINE_TEST_VARIANT3(arm_rms_q31, 3, in_com1, 0, 3);
DEFINE_TEST_VARIANT3(arm_rms_q31, 8, in_com1, 1, 8);
DEFINE_TEST_VARIANT3(arm_rms_q31, 11, in_com1, 2, 11);

static void test_arm_std_q31(
	const q31_t *input1, int ref_index, size_t length)
{
	q31_t ref[1];
	q31_t *output;

	/* Load reference */
	ref[0] = ref_std[ref_index];

	/* Allocate output buffer */
	output = malloc(1 * sizeof(q31_t));
	zassert_not_null(output, ASSERT_MSG_BUFFER_ALLOC_FAILED);

	/* Run test function */
	arm_std_q31(input1, length, &output[0]);

	/* Validate output */
	zassert_true(
		test_snr_error_q31(1, output, ref, SNR_ERROR_THRESH),
		ASSERT_MSG_SNR_LIMIT_EXCEED);

	zassert_true(
		test_near_equal_q31(1, output, ref, ABS_ERROR_THRESH_Q15),
		ASSERT_MSG_ABS_ERROR_LIMIT_EXCEED);

	/* Free output buffer */
	free(output);
}

DEFINE_TEST_VARIANT3(arm_std_q31, 3, in_com1, 0, 3);
DEFINE_TEST_VARIANT3(arm_std_q31, 8, in_com1, 1, 8);
DEFINE_TEST_VARIANT3(arm_std_q31, 11, in_com1, 2, 11);

static void test_arm_var_q31(
	const q31_t *input1, int ref_index, size_t length)
{
	q31_t ref[1];
	q31_t *output;

	/* Load reference */
	ref[0] = ref_var[ref_index];

	/* Allocate output buffer */
	output = malloc(1 * sizeof(q31_t));
	zassert_not_null(output, ASSERT_MSG_BUFFER_ALLOC_FAILED);

	/* Run test function */
	arm_var_q31(input1, length, &output[0]);

	/* Validate output */
	zassert_true(
		test_snr_error_q31(1, output, ref, SNR_ERROR_THRESH),
		ASSERT_MSG_SNR_LIMIT_EXCEED);

	zassert_true(
		test_near_equal_q31(1, output, ref, ABS_ERROR_THRESH_Q15),
		ASSERT_MSG_ABS_ERROR_LIMIT_EXCEED);

	/* Free output buffer */
	free(output);
}

DEFINE_TEST_VARIANT3(arm_var_q31, 3, in_com1, 0, 3);
DEFINE_TEST_VARIANT3(arm_var_q31, 8, in_com1, 1, 8);
DEFINE_TEST_VARIANT3(arm_var_q31, 11, in_com1, 2, 11);

void test_statistics_q31(void)
{
	ztest_test_suite(statistics_q31,
		ztest_unit_test(test_arm_max_q31_3),
		ztest_unit_test(test_arm_max_q31_8),
		ztest_unit_test(test_arm_max_q31_11),
		ztest_unit_test(test_arm_min_q31_3),
		ztest_unit_test(test_arm_min_q31_8),
		ztest_unit_test(test_arm_min_q31_11),
		ztest_unit_test(test_arm_mean_q31_3),
		ztest_unit_test(test_arm_mean_q31_8),
		ztest_unit_test(test_arm_mean_q31_11),
		ztest_unit_test(test_arm_power_q31_3),
		ztest_unit_test(test_arm_power_q31_8),
		ztest_unit_test(test_arm_power_q31_11),
		ztest_unit_test(test_arm_rms_q31_3),
		ztest_unit_test(test_arm_rms_q31_8),
		ztest_unit_test(test_arm_rms_q31_11),
		ztest_unit_test(test_arm_std_q31_3),
		ztest_unit_test(test_arm_std_q31_8),
		ztest_unit_test(test_arm_std_q31_11),
		ztest_unit_test(test_arm_var_q31_3),
		ztest_unit_test(test_arm_var_q31_8),
		ztest_unit_test(test_arm_var_q31_11)
		);

	ztest_run_test_suite(statistics_q31);
}
```

## src/q7.c
```c
/*
 * Copyright (c) 2020 Stephanos Ioannidis <root@stephanos.io>
 * Copyright (C) 2010-2020 ARM Limited or its affiliates. All rights reserved.
 *
 * SPDX-License-Identifier: Apache-2.0
 */

#include <ztest.h>
#include <zephyr.h>
#include <stdlib.h>
#include <arm_math.h>
#include "../../common/test_common.h"

#include "q7.pat"

#define SNR_ERROR_THRESH	((float32_t)20)
#define ABS_ERROR_THRESH_Q7	((q7_t)20)
#define ABS_ERROR_THRESH_Q31	((q31_t)(1 << 15))

static void test_arm_max_q7(
	const q7_t *input1, int ref_index, size_t length)
{
	q7_t val;
	uint32_t index;

	/* Run test function */
	arm_max_q7(input1, length, &val, &index);

	/* Validate output */
	zassert_equal(val, ref_max_val[ref_index],
		ASSERT_MSG_INCORRECT_COMP_RESULT);

	zassert_equal(index, ref_max_idx[ref_index],
		ASSERT_MSG_INCORRECT_COMP_RESULT);
}

DEFINE_TEST_VARIANT3(arm_max_q7, 15, in_com1, 0, 15);
DEFINE_TEST_VARIANT3(arm_max_q7, 32, in_com1, 1, 32);
DEFINE_TEST_VARIANT3(arm_max_q7, 47, in_com1, 2, 47);
DEFINE_TEST_VARIANT3(arm_max_q7, max, in_max_maxidx, 3, 280);

static void test_arm_min_q7(
	const q7_t *input1, int ref_index, size_t length)
{
	q7_t val;
	uint32_t index;

	/* Run test function */
	arm_min_q7(input1, length, &val, &index);

	/* Validate output */
	zassert_equal(val, ref_min_val[ref_index],
		ASSERT_MSG_INCORRECT_COMP_RESULT);

	zassert_equal(index, ref_min_idx[ref_index],
		ASSERT_MSG_INCORRECT_COMP_RESULT);
}

DEFINE_TEST_VARIANT3(arm_min_q7, 15, in_com1, 0, 15);
DEFINE_TEST_VARIANT3(arm_min_q7, 32, in_com1, 1, 32);
DEFINE_TEST_VARIANT3(arm_min_q7, 47, in_com1, 2, 47);
DEFINE_TEST_VARIANT3(arm_min_q7, max, in_min_maxidx, 3, 280);

static void test_arm_mean_q7(
	const q7_t *input1, int ref_index, size_t length)
{
	q7_t ref[1];
	q7_t *output;

	/* Load reference */
	ref[0] = ref_mean[ref_index];

	/* Allocate output buffer */
	output = malloc(1 * sizeof(q7_t));
	zassert_not_null(output, ASSERT_MSG_BUFFER_ALLOC_FAILED);

	/* Run test function */
	arm_mean_q7(input1, length, &output[0]);

	/* Validate output */
	zassert_true(
		test_snr_error_q7(1, output, ref, SNR_ERROR_THRESH),
		ASSERT_MSG_SNR_LIMIT_EXCEED);

	zassert_true(
		test_near_equal_q7(1, output, ref, ABS_ERROR_THRESH_Q7),
		ASSERT_MSG_ABS_ERROR_LIMIT_EXCEED);

	/* Free output buffer */
	free(output);
}

DEFINE_TEST_VARIANT3(arm_mean_q7, 15, in_com2, 0, 15);
DEFINE_TEST_VARIANT3(arm_mean_q7, 32, in_com2, 1, 32);
DEFINE_TEST_VARIANT3(arm_mean_q7, 47, in_com2, 2, 47);

static void test_arm_power_q7(
	const q7_t *input1, int ref_index, size_t length)
{
	q31_t ref[1];
	q31_t *output;

	/* Load reference */
	ref[0] = ref_power[ref_index];

	/* Allocate output buffer */
	output = malloc(1 * sizeof(q31_t));
	zassert_not_null(output, ASSERT_MSG_BUFFER_ALLOC_FAILED);

	/* Run test function */
	arm_power_q7(input1, length, &output[0]);

	/* Validate output */
	zassert_true(
		test_snr_error_q31(1, output, ref, SNR_ERROR_THRESH),
		ASSERT_MSG_SNR_LIMIT_EXCEED);

	zassert_true(
		test_near_equal_q31(1, output, ref, ABS_ERROR_THRESH_Q31),
		ASSERT_MSG_ABS_ERROR_LIMIT_EXCEED);

	/* Free output buffer */
	free(output);
}

DEFINE_TEST_VARIANT3(arm_power_q7, 15, in_com1, 0, 15);
DEFINE_TEST_VARIANT3(arm_power_q7, 32, in_com1, 1, 32);
DEFINE_TEST_VARIANT3(arm_power_q7, 47, in_com1, 2, 47);

void test_statistics_q7(void)
{
	ztest_test_suite(statistics_q7,
		ztest_unit_test(test_arm_max_q7_15),
		ztest_unit_test(test_arm_max_q7_32),
		ztest_unit_test(test_arm_max_q7_47),
		ztest_unit_test(test_arm_max_q7_max),
		ztest_unit_test(test_arm_min_q7_15),
		ztest_unit_test(test_arm_min_q7_32),
		ztest_unit_test(test_arm_min_q7_47),
		ztest_unit_test(test_arm_min_q7_max),
		ztest_unit_test(test_arm_mean_q7_15),
		ztest_unit_test(test_arm_mean_q7_32),
		ztest_unit_test(test_arm_mean_q7_47),
		ztest_unit_test(test_arm_power_q7_15),
		ztest_unit_test(test_arm_power_q7_32),
		ztest_unit_test(test_arm_power_q7_47)
		);

	ztest_run_test_suite(statistics_q7);
}
```
