## CMakeLists.txt
```
# SPDX-License-Identifier: Apache-2.0

cmake_minimum_required(VERSION 3.13.1)
find_package(Zephyr REQUIRED HINTS $ENV{ZEPHYR_BASE})
project(cmsis_dsp_filtering)

FILE(GLOB app_sources src/*.c)

target_sources(app PRIVATE src/main.c)

target_sources_ifdef(
  CONFIG_CMSIS_DSP_TEST_FILTERING_BIQUAD
  app PRIVATE
  src/biquad_q15.c
  src/biquad_q31.c
  src/biquad_f32.c
  src/biquad_f64.c
  )

target_sources_ifdef(
  CONFIG_CMSIS_DSP_TEST_FILTERING_FIR
  app PRIVATE
  src/fir_q7.c
  src/fir_q15.c
  src/fir_q31.c
  src/fir_f32.c
  )

target_sources_ifdef(
  CONFIG_CMSIS_DSP_TEST_FILTERING_MISC
  app PRIVATE
  src/misc_q7.c
  src/misc_q15.c
  src/misc_q31.c
  src/misc_f32.c
  )
```

## Kconfig
```
# Copyright (c) 2019 Stephanos Ioannidis <root@stephanos.io>
# SPDX-License-Identifier: Apache-2.0

config CMSIS_DSP_TEST_FILTERING_BIQUAD
	bool "Test: Filtering BIQUAD"

config CMSIS_DSP_TEST_FILTERING_FIR
	bool "Test: Filtering FIR"

config CMSIS_DSP_TEST_FILTERING_MISC
	bool "Test: Filtering MISC"

source "Kconfig"
```

## prj.conf
```kconfig
CONFIG_ZTEST=y
CONFIG_NEWLIB_LIBC=y
CONFIG_CMSIS_DSP=y
CONFIG_CMSIS_DSP_FILTERING=y

# Test Options
CONFIG_CMSIS_DSP_TEST_FILTERING_BIQUAD=y
CONFIG_CMSIS_DSP_TEST_FILTERING_FIR=y
CONFIG_CMSIS_DSP_TEST_FILTERING_MISC=y
```

## prj_base.conf
```kconfig
CONFIG_ZTEST=y
CONFIG_NEWLIB_LIBC=y
CONFIG_CMSIS_DSP=y
CONFIG_CMSIS_DSP_FILTERING=y
```

## src/main.c
```c
/*
 * Copyright (c) 2020 Stephanos Ioannidis <root@stephanos.io>
 *
 * SPDX-License-Identifier: Apache-2.0
 */

#include <ztest.h>
#include <zephyr.h>

extern void test_filtering_biquad_q15(void);
extern void test_filtering_biquad_q31(void);
extern void test_filtering_biquad_f32(void);
extern void test_filtering_biquad_f64(void);

extern void test_filtering_fir_q7(void);
extern void test_filtering_fir_q15(void);
extern void test_filtering_fir_q31(void);
extern void test_filtering_fir_f32(void);

extern void test_filtering_misc_q7(void);
extern void test_filtering_misc_q15(void);
extern void test_filtering_misc_q31(void);
extern void test_filtering_misc_f32(void);

void test_main(void)
{
#ifdef CONFIG_CMSIS_DSP_TEST_FILTERING_BIQUAD
	test_filtering_biquad_q15();
	test_filtering_biquad_q31();
	test_filtering_biquad_f32();
	test_filtering_biquad_f64();
#endif

#ifdef CONFIG_CMSIS_DSP_TEST_FILTERING_FIR
	test_filtering_fir_q7();
	test_filtering_fir_q15();
	test_filtering_fir_q31();
	test_filtering_fir_f32();
#endif

#ifdef CONFIG_CMSIS_DSP_TEST_FILTERING_MISC
	test_filtering_misc_q7();
	test_filtering_misc_q15();
	test_filtering_misc_q31();
	test_filtering_misc_f32();
#endif
}
```

## src/biquad_f32.c
```c
/*
 * Copyright (c) 2020 Stephanos Ioannidis <root@stephanos.io>
 * Copyright (C) 2010-2020 ARM Limited or its affiliates. All rights reserved.
 *
 * SPDX-License-Identifier: Apache-2.0
 */

#include <ztest.h>
#include <zephyr.h>
#include <stdlib.h>
#include <arm_math.h>
#include "../../common/test_common.h"

#include "biquad_f32.pat"

#define SNR_ERROR_THRESH	((float32_t)98)
#define REL_ERROR_THRESH	(1.2e-3)

static void test_arm_biquad_cascade_df1_f32_default(void)
{
	size_t index;
	size_t length = ARRAY_SIZE(ref_default);
	size_t block_size = length / 2;
	const float32_t *input = (const float32_t *)in_default_val;
	const float32_t *coeff = (const float32_t *)in_default_coeff;
	const float32_t *ref = (const float32_t *)ref_default;
	float32_t *state, *output_buf, *output;
	arm_biquad_casd_df1_inst_f32 inst;

	/* Allocate buffers */
	state = malloc(128 * sizeof(float32_t));
	zassert_not_null(state, ASSERT_MSG_BUFFER_ALLOC_FAILED);

	output_buf = malloc(length * sizeof(float32_t));
	zassert_not_null(output_buf, ASSERT_MSG_BUFFER_ALLOC_FAILED);

	output = output_buf;

	/* Initialise instance */
	arm_biquad_cascade_df1_init_f32(&inst, 3, coeff, state);

	/* TODO: Add MVEF support */

	/* Enumerate blocks */
	for (index = 0; index < 2; index++) {
		/* Run test function */
		arm_biquad_cascade_df1_f32(&inst, input, output, block_size);

		/* Increment pointers */
		input += block_size;
		output += block_size;
	}

	/* Validate output */
	zassert_true(
		test_snr_error_f32(length, output_buf, ref, SNR_ERROR_THRESH),
		ASSERT_MSG_SNR_LIMIT_EXCEED);

	zassert_true(
		test_rel_error_f32(length, output_buf, ref, REL_ERROR_THRESH),
		ASSERT_MSG_REL_ERROR_LIMIT_EXCEED);

	/* Free buffers */
	free(state);
	free(output_buf);
}

static void test_arm_biquad_cascade_df2t_f32_default(void)
{
	size_t index;
	size_t length = ARRAY_SIZE(ref_default);
	size_t block_size = length / 2;
	const float32_t *input = (const float32_t *)in_default_val;
	const float32_t *coeff = (const float32_t *)in_default_coeff;
	const float32_t *ref = (const float32_t *)ref_default;
	float32_t *state, *output_buf, *output;
	arm_biquad_cascade_df2T_instance_f32 inst;

	/* Allocate buffers */
	state = malloc(128 * sizeof(float32_t));
	zassert_not_null(state, ASSERT_MSG_BUFFER_ALLOC_FAILED);

	output_buf = malloc(length * sizeof(float32_t));
	zassert_not_null(output_buf, ASSERT_MSG_BUFFER_ALLOC_FAILED);

	output = output_buf;

	/* Initialise instance */
	arm_biquad_cascade_df2T_init_f32(&inst, 3, coeff, state);

	/* TODO: Add NEON support */

	/* Enumerate blocks */
	for (index = 0; index < 2; index++) {
		/* Run test function */
		arm_biquad_cascade_df2T_f32(&inst, input, output, block_size);

		/* Increment pointers */
		input += block_size;
		output += block_size;
	}

	/* Validate output */
	zassert_true(
		test_snr_error_f32(length, output_buf, ref, SNR_ERROR_THRESH),
		ASSERT_MSG_SNR_LIMIT_EXCEED);

	zassert_true(
		test_rel_error_f32(length, output_buf, ref, REL_ERROR_THRESH),
		ASSERT_MSG_REL_ERROR_LIMIT_EXCEED);

	/* Free buffers */
	free(state);
	free(output_buf);
}

static void test_arm_biquad_cascade_df1_f32_rand(void)
{
	size_t sample_index, stage_count, block_size;
	size_t sample_count = ARRAY_SIZE(in_rand_config) / 2;
	size_t length = ARRAY_SIZE(ref_rand_mono);
	const uint16_t *config = in_rand_config;
	const float32_t *input = (const float32_t *)in_rand_mono_val;
	const float32_t *coeff = (const float32_t *)in_rand_coeff;
	const float32_t *ref = (const float32_t *)ref_rand_mono;
	float32_t *state, *output_buf, *output;
	arm_biquad_casd_df1_inst_f32 inst;

	/* Allocate buffers */
	state = malloc(128 * sizeof(float32_t));
	zassert_not_null(state, ASSERT_MSG_BUFFER_ALLOC_FAILED);

	output_buf = malloc(length * sizeof(float32_t));
	zassert_not_null(output_buf, ASSERT_MSG_BUFFER_ALLOC_FAILED);

	output = output_buf;

	/* Enumerate samples */
	for (sample_index = 0; sample_index < sample_count; sample_index++) {
		/* Resolve sample configurations */
		stage_count = config[0];
		block_size = config[1];

		/* Initialise instance */
		arm_biquad_cascade_df1_init_f32(
			&inst, stage_count, coeff, state);

		/* TODO: Add MVEF support */

		/* Run test function */
		arm_biquad_cascade_df1_f32(&inst, input, output, block_size);

		/* Increment pointers */
		input += block_size;
		output += block_size;
		coeff += stage_count * 5;
		config += 2;
	}

	/* Validate output */
	zassert_true(
		test_snr_error_f32(length, output_buf, ref, SNR_ERROR_THRESH),
		ASSERT_MSG_SNR_LIMIT_EXCEED);

	zassert_true(
		test_rel_error_f32(length, output_buf, ref, REL_ERROR_THRESH),
		ASSERT_MSG_REL_ERROR_LIMIT_EXCEED);

	/* Free buffers */
	free(state);
	free(output_buf);
}

static void test_arm_biquad_cascade_df2t_f32_rand(void)
{
	size_t sample_index, stage_count, block_size;
	size_t sample_count = ARRAY_SIZE(in_rand_config) / 2;
	size_t length = ARRAY_SIZE(ref_rand_mono);
	const uint16_t *config = in_rand_config;
	const float32_t *input = (const float32_t *)in_rand_mono_val;
	const float32_t *coeff = (const float32_t *)in_rand_coeff;
	const float32_t *ref = (const float32_t *)ref_rand_mono;
	float32_t *state, *output_buf, *output;
	arm_biquad_cascade_df2T_instance_f32 inst;

	/* Allocate buffers */
	state = malloc(128 * sizeof(float32_t));
	zassert_not_null(state, ASSERT_MSG_BUFFER_ALLOC_FAILED);

	output_buf = malloc(length * sizeof(float32_t));
	zassert_not_null(output_buf, ASSERT_MSG_BUFFER_ALLOC_FAILED);

	output = output_buf;

	/* Enumerate samples */
	for (sample_index = 0; sample_index < sample_count; sample_index++) {
		/* Resolve sample configurations */
		stage_count = config[0];
		block_size = config[1];

		/* Initialise instance */
		arm_biquad_cascade_df2T_init_f32(
			&inst, stage_count, coeff, state);

		/* TODO: Add NEON support */

		/* Run test function */
		arm_biquad_cascade_df2T_f32(&inst, input, output, block_size);

		/* Increment pointers */
		input += block_size;
		output += block_size;
		coeff += stage_count * 5;
		config += 2;
	}

	/* Validate output */
	zassert_true(
		test_snr_error_f32(length, output_buf, ref, SNR_ERROR_THRESH),
		ASSERT_MSG_SNR_LIMIT_EXCEED);

	zassert_true(
		test_rel_error_f32(length, output_buf, ref, REL_ERROR_THRESH),
		ASSERT_MSG_REL_ERROR_LIMIT_EXCEED);

	/* Free buffers */
	free(state);
	free(output_buf);
}

static void test_arm_biquad_cascade_stereo_df2t_f32_rand(void)
{
	size_t sample_index, stage_count, block_size;
	size_t sample_count = ARRAY_SIZE(in_rand_config) / 2;
	size_t length = ARRAY_SIZE(ref_rand_stereo);
	const uint16_t *config = in_rand_config;
	const float32_t *input = (const float32_t *)in_rand_stereo_val;
	const float32_t *coeff = (const float32_t *)in_rand_coeff;
	const float32_t *ref = (const float32_t *)ref_rand_stereo;
	float32_t *state, *output_buf, *output;
	arm_biquad_cascade_stereo_df2T_instance_f32 inst;

	/* Allocate buffers */
	state = malloc(128 * sizeof(float32_t));
	zassert_not_null(state, ASSERT_MSG_BUFFER_ALLOC_FAILED);

	output_buf = malloc(length * sizeof(float32_t));
	zassert_not_null(output_buf, ASSERT_MSG_BUFFER_ALLOC_FAILED);

	output = output_buf;

	/* Enumerate samples */
	for (sample_index = 0; sample_index < sample_count; sample_index++) {
		/* Resolve sample configurations */
		stage_count = config[0];
		block_size = config[1];

		/* Initialise instance */
		arm_biquad_cascade_stereo_df2T_init_f32(
			&inst, stage_count, coeff, state);

		/* Run test function */
		arm_biquad_cascade_stereo_df2T_f32(
			&inst, input, output, block_size);

		/* Increment pointers */
		input += 2 * block_size;
		output += 2 * block_size;
		coeff += stage_count * 5;
		config += 2;
	}

	/* Validate output */
	zassert_true(
		test_snr_error_f32(length, output_buf, ref, SNR_ERROR_THRESH),
		ASSERT_MSG_SNR_LIMIT_EXCEED);

	zassert_true(
		test_rel_error_f32(length, output_buf, ref, REL_ERROR_THRESH),
		ASSERT_MSG_REL_ERROR_LIMIT_EXCEED);

	/* Free buffers */
	free(state);
	free(output_buf);
}

void test_filtering_biquad_f32(void)
{
	ztest_test_suite(filtering_biquad_f32,
		ztest_unit_test(test_arm_biquad_cascade_df1_f32_default),
		ztest_unit_test(test_arm_biquad_cascade_df2t_f32_default),
		ztest_unit_test(test_arm_biquad_cascade_df1_f32_rand),
		ztest_unit_test(test_arm_biquad_cascade_df2t_f32_rand),
		ztest_unit_test(test_arm_biquad_cascade_stereo_df2t_f32_rand)
		);

	ztest_run_test_suite(filtering_biquad_f32);
}
```

## src/biquad_f64.c
```c
/*
 * Copyright (c) 2020 Stephanos Ioannidis <root@stephanos.io>
 * Copyright (C) 2010-2020 ARM Limited or its affiliates. All rights reserved.
 *
 * SPDX-License-Identifier: Apache-2.0
 */

#include <ztest.h>
#include <zephyr.h>
#include <stdlib.h>
#include <arm_math.h>
#include "../../common/test_common.h"

#include "biquad_f64.pat"

#define SNR_ERROR_THRESH	((float64_t)98)
#define REL_ERROR_THRESH	(1.2e-3)

static void test_arm_biquad_cascade_df2t_f64_default(void)
{
	size_t index;
	size_t length = ARRAY_SIZE(ref_default);
	size_t block_size = length / 2;
	const float64_t *input = (const float64_t *)in_default_val;
	const float64_t *coeff = (const float64_t *)in_default_coeff;
	const float64_t *ref = (const float64_t *)ref_default;
	float64_t *state, *output_buf, *output;
	arm_biquad_cascade_df2T_instance_f64 inst;

	/* Allocate buffers */
	state = malloc(128 * sizeof(float64_t));
	zassert_not_null(state, ASSERT_MSG_BUFFER_ALLOC_FAILED);

	output_buf = malloc(length * sizeof(float64_t));
	zassert_not_null(output_buf, ASSERT_MSG_BUFFER_ALLOC_FAILED);

	output = output_buf;

	/* Initialise instance */
	arm_biquad_cascade_df2T_init_f64(&inst, 3, coeff, state);

	/* TODO: Add NEON support */

	/* Enumerate blocks */
	for (index = 0; index < 2; index++) {
		/* Run test function */
		arm_biquad_cascade_df2T_f64(
			&inst, input, output, block_size);

		/* Increment pointers */
		input += block_size;
		output += block_size;
	}

	/* Validate output */
	zassert_true(
		test_snr_error_f64(length, output_buf, ref, SNR_ERROR_THRESH),
		ASSERT_MSG_SNR_LIMIT_EXCEED);

	zassert_true(
		test_rel_error_f64(length, output_buf, ref, REL_ERROR_THRESH),
		ASSERT_MSG_REL_ERROR_LIMIT_EXCEED);

	/* Free buffers */
	free(state);
	free(output_buf);
}

static void test_arm_biquad_cascade_df2t_f64_rand(void)
{
	size_t sample_index, stage_count, block_size;
	size_t sample_count = ARRAY_SIZE(in_rand_config) / 2;
	size_t length = ARRAY_SIZE(ref_rand_mono);
	const uint16_t *config = in_rand_config;
	const float64_t *input = (const float64_t *)in_rand_mono_val;
	const float64_t *coeff = (const float64_t *)in_rand_coeff;
	const float64_t *ref = (const float64_t *)ref_rand_mono;
	float64_t *state, *output_buf, *output;
	arm_biquad_cascade_df2T_instance_f64 inst;

	/* Allocate buffers */
	state = malloc(128 * sizeof(float64_t));
	zassert_not_null(state, ASSERT_MSG_BUFFER_ALLOC_FAILED);

	output_buf = malloc(length * sizeof(float64_t));
	zassert_not_null(output_buf, ASSERT_MSG_BUFFER_ALLOC_FAILED);

	output = output_buf;

	/* Enumerate samples */
	for (sample_index = 0; sample_index < sample_count; sample_index++) {
		/* Resolve sample configurations */
		stage_count = config[0];
		block_size = config[1];

		/* Initialise instance */
		arm_biquad_cascade_df2T_init_f64(
			&inst, stage_count, coeff, state);

		/* TODO: Add NEON support */

		/* Run test function */
		arm_biquad_cascade_df2T_f64(
			&inst, input, output, block_size);

		/* Increment pointers */
		input += block_size;
		output += block_size;
		coeff += stage_count * 5;
		config += 2;
	}

	/* Validate output */
	zassert_true(
		test_snr_error_f64(length, output_buf, ref, SNR_ERROR_THRESH),
		ASSERT_MSG_SNR_LIMIT_EXCEED);

	zassert_true(
		test_rel_error_f64(length, output_buf, ref, REL_ERROR_THRESH),
		ASSERT_MSG_REL_ERROR_LIMIT_EXCEED);

	/* Free buffers */
	free(state);
	free(output_buf);
}

void test_filtering_biquad_f64(void)
{
	ztest_test_suite(filtering_biquad_f64,
		ztest_unit_test(test_arm_biquad_cascade_df2t_f64_default),
		ztest_unit_test(test_arm_biquad_cascade_df2t_f64_rand)
		);

	ztest_run_test_suite(filtering_biquad_f64);
}
```

## src/biquad_q15.c
```c
/*
 * Copyright (c) 2020 Stephanos Ioannidis <root@stephanos.io>
 * Copyright (C) 2010-2020 ARM Limited or its affiliates. All rights reserved.
 *
 * SPDX-License-Identifier: Apache-2.0
 */

#include <ztest.h>
#include <zephyr.h>
#include <stdlib.h>
#include <arm_math.h>
#include "../../common/test_common.h"

#include "biquad_q15.pat"

#define SNR_ERROR_THRESH	((float32_t)30)
#define ABS_ERROR_THRESH_Q15	((q15_t)500)

static void test_arm_biquad_cascade_df1_q15(void)
{
	size_t index;
	size_t length = ARRAY_SIZE(ref_default);
	size_t block_size = length / 2;
	const q15_t *input = in_default_val;
	const q15_t *coeff = in_default_coeff;
	const q15_t *ref = ref_default;
	q15_t *state, *output_buf, *output;
	arm_biquad_casd_df1_inst_q15 inst;

	/* Allocate buffers */
	state = malloc(32 * sizeof(q15_t));
	zassert_not_null(state, ASSERT_MSG_BUFFER_ALLOC_FAILED);

	output_buf = malloc(length * sizeof(q15_t));
	zassert_not_null(output_buf, ASSERT_MSG_BUFFER_ALLOC_FAILED);

	output = output_buf;

	/* Initialise instance */
	arm_biquad_cascade_df1_init_q15(&inst, 3, coeff, state, 2);

	/* Enumerate blocks */
	for (index = 0; index < 2; index++) {
		/* Run test function */
		arm_biquad_cascade_df1_q15(&inst, input, output, block_size);

		/* Increment pointers */
		input += block_size;
		output += block_size;
	}

	/* Validate output */
	zassert_true(
		test_snr_error_q15(length, output_buf, ref, SNR_ERROR_THRESH),
		ASSERT_MSG_SNR_LIMIT_EXCEED);

	zassert_true(
		test_near_equal_q15(length, output_buf, ref,
			ABS_ERROR_THRESH_Q15),
		ASSERT_MSG_ABS_ERROR_LIMIT_EXCEED);

	/* Free buffers */
	free(state);
	free(output_buf);
}

void test_filtering_biquad_q15(void)
{
	ztest_test_suite(filtering_biquad_q15,
		ztest_unit_test(test_arm_biquad_cascade_df1_q15)
		);

	ztest_run_test_suite(filtering_biquad_q15);
}
```

## src/biquad_q31.c
```c
/*
 * Copyright (c) 2020 Stephanos Ioannidis <root@stephanos.io>
 * Copyright (C) 2010-2020 ARM Limited or its affiliates. All rights reserved.
 *
 * SPDX-License-Identifier: Apache-2.0
 */

#include <ztest.h>
#include <zephyr.h>
#include <stdlib.h>
#include <arm_math.h>
#include "../../common/test_common.h"

#include "biquad_q31.pat"

#define SNR_ERROR_THRESH		((float32_t)115)
#define ABS_ERROR_THRESH_Q31		((q31_t)1000)

#define SNR_ERROR_THRESH_32x64		((float32_t)140)
#define ABS_ERROR_THRESH_Q31_32x64	((q31_t)25)

static void test_arm_biquad_cascade_df1_q31(void)
{
	size_t index;
	size_t length = ARRAY_SIZE(ref_default);
	size_t block_size = length / 2;
	const q31_t *input = in_default_val;
	const q31_t *coeff = in_default_coeff;
	const q31_t *ref = ref_default;
	q31_t *state, *output_buf, *output;
	arm_biquad_casd_df1_inst_q31 inst;

	/* Allocate buffers */
	state = malloc(32 * sizeof(q31_t));
	zassert_not_null(state, ASSERT_MSG_BUFFER_ALLOC_FAILED);

	output_buf = malloc(length * sizeof(q31_t));
	zassert_not_null(output_buf, ASSERT_MSG_BUFFER_ALLOC_FAILED);

	output = output_buf;

	/* Initialise instance */
	arm_biquad_cascade_df1_init_q31(&inst, 3, coeff, state, 2);

	/* Enumerate blocks */
	for (index = 0; index < 2; index++) {
		/* Run test function */
		arm_biquad_cascade_df1_q31(&inst, input, output, block_size);

		/* Increment pointers */
		input += block_size;
		output += block_size;
	}

	/* Validate output */
	zassert_true(
		test_snr_error_q31(length, output_buf, ref, SNR_ERROR_THRESH),
		ASSERT_MSG_SNR_LIMIT_EXCEED);

	zassert_true(
		test_near_equal_q31(length, output_buf, ref,
			ABS_ERROR_THRESH_Q31),
		ASSERT_MSG_ABS_ERROR_LIMIT_EXCEED);

	/* Free buffers */
	free(state);
	free(output_buf);
}

static void test_arm_biquad_cascade_df1_32x64_q31(void)
{
	size_t index;
	size_t length = ARRAY_SIZE(ref_default);
	size_t block_size = length / 2;
	const q31_t *input = in_default_val;
	const q31_t *coeff = in_default_coeff;
	const q31_t *ref = ref_default;
	q63_t *state;
	q31_t *output_buf, *output;
	arm_biquad_cas_df1_32x64_ins_q31 inst;

	/* Allocate buffers */
	state = malloc(32 * sizeof(q63_t));
	zassert_not_null(state, ASSERT_MSG_BUFFER_ALLOC_FAILED);

	output_buf = malloc(length * sizeof(q31_t));
	zassert_not_null(output_buf, ASSERT_MSG_BUFFER_ALLOC_FAILED);

	output = output_buf;

	/* Initialise instance */
	arm_biquad_cas_df1_32x64_init_q31(&inst, 3, coeff, state, 2);

	/* Enumerate blocks */
	for (index = 0; index < 2; index++) {
		/* Run test function */
		arm_biquad_cas_df1_32x64_q31(&inst, input, output, block_size);

		/* Increment pointers */
		input += block_size;
		output += block_size;
	}

	/* Validate output */
	zassert_true(
		test_snr_error_q31(length, output_buf, ref,
			SNR_ERROR_THRESH_32x64),
		ASSERT_MSG_SNR_LIMIT_EXCEED);

	zassert_true(
		test_near_equal_q31(length, output_buf, ref,
			ABS_ERROR_THRESH_Q31_32x64),
		ASSERT_MSG_ABS_ERROR_LIMIT_EXCEED);

	/* Free buffers */
	free(state);
	free(output_buf);
}

void test_filtering_biquad_q31(void)
{
	ztest_test_suite(filtering_biquad_q31,
		ztest_unit_test(test_arm_biquad_cascade_df1_q31),
		ztest_unit_test(test_arm_biquad_cascade_df1_32x64_q31)
		);

	ztest_run_test_suite(filtering_biquad_q31);
}
```

## src/fir_f32.c
```c
/*
 * Copyright (c) 2020 Stephanos Ioannidis <root@stephanos.io>
 * Copyright (C) 2010-2020 ARM Limited or its affiliates. All rights reserved.
 *
 * SPDX-License-Identifier: Apache-2.0
 */

#include <ztest.h>
#include <zephyr.h>
#include <stdlib.h>
#include <arm_math.h>
#include "../../common/test_common.h"

#include "fir_f32.pat"

#define SNR_ERROR_THRESH	((float32_t)120)
#define REL_ERROR_THRESH	(3.0e-5)

static void test_arm_fir_f32(void)
{
	size_t sample_index, block_index;
	size_t block_size, tap_count;
	size_t sample_count = ARRAY_SIZE(in_config) / 2;
	size_t length = ARRAY_SIZE(ref_val);
	const uint16_t *config = in_config;
	const float32_t *input = (const float32_t *)in_val;
	const float32_t *coeff = (const float32_t *)in_coeff;
	const float32_t *ref = (const float32_t *)ref_val;
	float32_t *state, *output_buf, *output;
	arm_fir_instance_f32 inst;

	/* Allocate buffers */
	state = malloc(64 * sizeof(float32_t));
	zassert_not_null(state, ASSERT_MSG_BUFFER_ALLOC_FAILED);

	output_buf = malloc(length * sizeof(float32_t));
	zassert_not_null(output_buf, ASSERT_MSG_BUFFER_ALLOC_FAILED);

	output = output_buf;

	/* Enumerate samples */
	for (sample_index = 0; sample_index < sample_count; sample_index++) {
		/* Resolve sample configurations */
		block_size = config[0];
		tap_count = config[1];

		/* Initialise instance */
		arm_fir_init_f32(&inst, tap_count, coeff, state, block_size);

		/* TODO: Add MEVF support */

		/* Reset input pointer */
		input = (const float32_t *)in_val;

		/* Enumerate blocks */
		for (block_index = 0; block_index < 2; block_index++) {
			/* Run test function */
			arm_fir_f32(&inst, input, output, block_size);

			/* Increment pointers */
			input += block_size;
			output += block_size;
		}

		/* Increment pointers */
		coeff += tap_count;
		config += 2;
	}

	/* Validate output */
	zassert_true(
		test_snr_error_f32(length, output_buf, ref, SNR_ERROR_THRESH),
		ASSERT_MSG_SNR_LIMIT_EXCEED);

	zassert_true(
		test_rel_error_f32(length, output_buf, ref, REL_ERROR_THRESH),
		ASSERT_MSG_REL_ERROR_LIMIT_EXCEED);

	/* Free buffers */
	free(state);
	free(output_buf);
}

void test_filtering_fir_f32(void)
{
	ztest_test_suite(filtering_fir_f32,
		ztest_unit_test(test_arm_fir_f32)
		);

	ztest_run_test_suite(filtering_fir_f32);
}
```

## src/fir_q15.c
```c
/*
 * Copyright (c) 2020 Stephanos Ioannidis <root@stephanos.io>
 * Copyright (C) 2010-2020 ARM Limited or its affiliates. All rights reserved.
 *
 * SPDX-License-Identifier: Apache-2.0
 */

#include <ztest.h>
#include <zephyr.h>
#include <stdlib.h>
#include <arm_math.h>
#include "../../common/test_common.h"

#include "fir_q15.pat"

#define SNR_ERROR_THRESH	((float32_t)59)
#define ABS_ERROR_THRESH_Q15	((q15_t)2)

static void test_arm_fir_q15(void)
{
	size_t sample_index, block_index;
	size_t block_size, tap_count;
	size_t sample_count = ARRAY_SIZE(in_config) / 2;
	size_t length = ARRAY_SIZE(ref_val);
	const uint16_t *config = in_config;
	const q15_t *input = (const q15_t *)in_val;
	const q15_t *coeff = (const q15_t *)in_coeff;
	const q15_t *ref = (const q15_t *)ref_val;
	q15_t *state, *output_buf, *output;
	arm_fir_instance_q15 inst;

	/* Allocate buffers */
	state = malloc(64 * sizeof(q15_t));
	zassert_not_null(state, ASSERT_MSG_BUFFER_ALLOC_FAILED);

	output_buf = malloc(length * sizeof(q15_t));
	zassert_not_null(output_buf, ASSERT_MSG_BUFFER_ALLOC_FAILED);

	output = output_buf;

	/* Enumerate samples */
	for (sample_index = 0; sample_index < sample_count; sample_index++) {
		/* Resolve sample configurations */
		block_size = config[0];
		tap_count = config[1];

		/* Initialise instance */
		arm_fir_init_q15(&inst, tap_count, coeff, state, block_size);

		/* TODO: Add MEVI support */

		/* Reset input pointer */
		input = (const q15_t *)in_val;

		/* Enumerate blocks */
		for (block_index = 0; block_index < 2; block_index++) {
			/* Run test function */
			arm_fir_q15(&inst, input, output, block_size);

			/* Increment pointers */
			input += block_size;
			output += block_size;
		}

		/* Increment pointers */
		coeff += tap_count;
		config += 2;
	}

	/* Validate output */
	zassert_true(
		test_snr_error_q15(length, output_buf, ref, SNR_ERROR_THRESH),
		ASSERT_MSG_SNR_LIMIT_EXCEED);

	zassert_true(
		test_near_equal_q15(length, output_buf, ref,
			ABS_ERROR_THRESH_Q15),
		ASSERT_MSG_ABS_ERROR_LIMIT_EXCEED);

	/* Free buffers */
	free(state);
	free(output_buf);
}

void test_filtering_fir_q15(void)
{
	ztest_test_suite(filtering_fir_q15,
		ztest_unit_test(test_arm_fir_q15)
		);

	ztest_run_test_suite(filtering_fir_q15);
}
```

## src/fir_q31.c
```c
/*
 * Copyright (c) 2020 Stephanos Ioannidis <root@stephanos.io>
 * Copyright (C) 2010-2020 ARM Limited or its affiliates. All rights reserved.
 *
 * SPDX-License-Identifier: Apache-2.0
 */

#include <ztest.h>
#include <zephyr.h>
#include <stdlib.h>
#include <arm_math.h>
#include "../../common/test_common.h"

#include "fir_q31.pat"

#define SNR_ERROR_THRESH	((float32_t)100)
#define ABS_ERROR_THRESH_Q31	((q31_t)2)

static void test_arm_fir_q31(void)
{
	size_t sample_index, block_index;
	size_t block_size, tap_count;
	size_t sample_count = ARRAY_SIZE(in_config) / 2;
	size_t length = ARRAY_SIZE(ref_val);
	const uint16_t *config = in_config;
	const q31_t *input = (const q31_t *)in_val;
	const q31_t *coeff = (const q31_t *)in_coeff;
	const q31_t *ref = (const q31_t *)ref_val;
	q31_t *state, *output_buf, *output;
	arm_fir_instance_q31 inst;

	/* Allocate buffers */
	state = malloc(64 * sizeof(q31_t));
	zassert_not_null(state, ASSERT_MSG_BUFFER_ALLOC_FAILED);

	output_buf = malloc(length * sizeof(q31_t));
	zassert_not_null(output_buf, ASSERT_MSG_BUFFER_ALLOC_FAILED);

	output = output_buf;

	/* Enumerate samples */
	for (sample_index = 0; sample_index < sample_count; sample_index++) {
		/* Resolve sample configurations */
		block_size = config[0];
		tap_count = config[1];

		/* Initialise instance */
		arm_fir_init_q31(&inst, tap_count, coeff, state, block_size);

		/* TODO: Add MEVI support */

		/* Reset input pointer */
		input = (const q31_t *)in_val;

		/* Enumerate blocks */
		for (block_index = 0; block_index < 2; block_index++) {
			/* Run test function */
			arm_fir_q31(&inst, input, output, block_size);

			/* Increment pointers */
			input += block_size;
			output += block_size;
		}

		/* Increment pointers */
		coeff += tap_count;
		config += 2;
	}

	/* Validate output */
	zassert_true(
		test_snr_error_q31(length, output_buf, ref, SNR_ERROR_THRESH),
		ASSERT_MSG_SNR_LIMIT_EXCEED);

	zassert_true(
		test_near_equal_q31(length, output_buf, ref,
			ABS_ERROR_THRESH_Q31),
		ASSERT_MSG_ABS_ERROR_LIMIT_EXCEED);

	/* Free buffers */
	free(state);
	free(output_buf);
}

void test_filtering_fir_q31(void)
{
	ztest_test_suite(filtering_fir_q31,
		ztest_unit_test(test_arm_fir_q31)
		);

	ztest_run_test_suite(filtering_fir_q31);
}
```

## src/fir_q7.c
```c
/*
 * Copyright (c) 2020 Stephanos Ioannidis <root@stephanos.io>
 * Copyright (C) 2010-2020 ARM Limited or its affiliates. All rights reserved.
 *
 * SPDX-License-Identifier: Apache-2.0
 */

#include <ztest.h>
#include <zephyr.h>
#include <stdlib.h>
#include <arm_math.h>
#include "../../common/test_common.h"

#include "fir_q7.pat"

#define SNR_ERROR_THRESH	((float32_t)10)
#define ABS_ERROR_THRESH_Q7	((q7_t)2)

static void test_arm_fir_q7(void)
{
	size_t sample_index, block_index;
	size_t block_size, tap_count;
	size_t sample_count = ARRAY_SIZE(in_config) / 2;
	size_t length = ARRAY_SIZE(ref_val);
	const uint16_t *config = in_config;
	const q7_t *input = (const q7_t *)in_val;
	const q7_t *coeff = (const q7_t *)in_coeff;
	const q7_t *ref = (const q7_t *)ref_val;
	q7_t *state, *output_buf, *output;
	arm_fir_instance_q7 inst;

	/* Allocate buffers */
	state = malloc(64 * sizeof(q7_t));
	zassert_not_null(state, ASSERT_MSG_BUFFER_ALLOC_FAILED);

	output_buf = malloc(length * sizeof(q7_t));
	zassert_not_null(output_buf, ASSERT_MSG_BUFFER_ALLOC_FAILED);

	output = output_buf;

	/* Enumerate samples */
	for (sample_index = 0; sample_index < sample_count; sample_index++) {
		/* Resolve sample configurations */
		block_size = config[0];
		tap_count = config[1];

		/* Initialise instance */
		arm_fir_init_q7(&inst, tap_count, coeff, state, block_size);

		/* TODO: Add MEVI support */

		/* Reset input pointer */
		input = (const q7_t *)in_val;

		/* Enumerate blocks */
		for (block_index = 0; block_index < 2; block_index++) {
			/* Run test function */
			arm_fir_q7(&inst, input, output, block_size);

			/* Increment pointers */
			input += block_size;
			output += block_size;
		}

		/* Increment pointers */
		coeff += tap_count;
		config += 2;
	}

	/* Validate output */
	zassert_true(
		test_snr_error_q7(length, output_buf, ref, SNR_ERROR_THRESH),
		ASSERT_MSG_SNR_LIMIT_EXCEED);

	zassert_true(
		test_near_equal_q7(length, output_buf, ref,
			ABS_ERROR_THRESH_Q7),
		ASSERT_MSG_ABS_ERROR_LIMIT_EXCEED);

	/* Free buffers */
	free(state);
	free(output_buf);
}

void test_filtering_fir_q7(void)
{
	ztest_test_suite(filtering_fir_q7,
		ztest_unit_test(test_arm_fir_q7)
		);

	ztest_run_test_suite(filtering_fir_q7);
}
```

## src/misc_f32.c
```c
/*
 * Copyright (c) 2020 Stephanos Ioannidis <root@stephanos.io>
 * Copyright (C) 2010-2020 ARM Limited or its affiliates. All rights reserved.
 *
 * SPDX-License-Identifier: Apache-2.0
 */

#include <ztest.h>
#include <zephyr.h>
#include <stdlib.h>
#include <arm_math.h>
#include "../../common/test_common.h"

#include "misc_f32.pat"

#define SNR_ERROR_THRESH	((float32_t)120)
#define REL_ERROR_THRESH	(1.0e-6)
#define ABS_ERROR_THRESH	(1.0e-5)

static void test_arm_correlate_f32(
	size_t in1_length, size_t in2_length, const uint32_t *ref,
	size_t ref_length)
{
	float32_t *output;

	/* Allocate output buffer */
	output = calloc(ref_length, sizeof(float32_t));

	/* Run test function */
	arm_correlate_f32(
		(float32_t *)in_com1, in1_length,
		(float32_t *)in_com2, in2_length, output);

	/* Validate output */
	zassert_true(
		test_snr_error_f32(ref_length, (float32_t *)ref, output,
			SNR_ERROR_THRESH),
		ASSERT_MSG_SNR_LIMIT_EXCEED);

	zassert_true(
		test_close_error_f32(ref_length, (float32_t *)ref, output,
			ABS_ERROR_THRESH, REL_ERROR_THRESH),
		ASSERT_MSG_ERROR_LIMIT_EXCEED);

	/* Free output buffer */
	free(output);
}

#define DEFINE_CORRELATE_TEST(a, b) \
	DEFINE_TEST_VARIANT4( \
		arm_correlate_f32, a##_##b, a, b, \
		ref_correlate_##a##_##b, ARRAY_SIZE(ref_correlate_##a##_##b))

DEFINE_CORRELATE_TEST(4, 1);
DEFINE_CORRELATE_TEST(4, 2);
DEFINE_CORRELATE_TEST(4, 3);
DEFINE_CORRELATE_TEST(4, 8);
DEFINE_CORRELATE_TEST(4, 11);
DEFINE_CORRELATE_TEST(5, 1);
DEFINE_CORRELATE_TEST(5, 2);
DEFINE_CORRELATE_TEST(5, 3);
DEFINE_CORRELATE_TEST(5, 8);
DEFINE_CORRELATE_TEST(5, 11);
DEFINE_CORRELATE_TEST(6, 1);
DEFINE_CORRELATE_TEST(6, 2);
DEFINE_CORRELATE_TEST(6, 3);
DEFINE_CORRELATE_TEST(6, 8);
DEFINE_CORRELATE_TEST(6, 11);
DEFINE_CORRELATE_TEST(9, 1);
DEFINE_CORRELATE_TEST(9, 2);
DEFINE_CORRELATE_TEST(9, 3);
DEFINE_CORRELATE_TEST(9, 8);
DEFINE_CORRELATE_TEST(9, 11);
DEFINE_CORRELATE_TEST(10, 1);
DEFINE_CORRELATE_TEST(10, 2);
DEFINE_CORRELATE_TEST(10, 3);
DEFINE_CORRELATE_TEST(10, 8);
DEFINE_CORRELATE_TEST(10, 11);
DEFINE_CORRELATE_TEST(11, 1);
DEFINE_CORRELATE_TEST(11, 2);
DEFINE_CORRELATE_TEST(11, 3);
DEFINE_CORRELATE_TEST(11, 8);
DEFINE_CORRELATE_TEST(11, 11);
DEFINE_CORRELATE_TEST(12, 1);
DEFINE_CORRELATE_TEST(12, 2);
DEFINE_CORRELATE_TEST(12, 3);
DEFINE_CORRELATE_TEST(12, 8);
DEFINE_CORRELATE_TEST(12, 11);
DEFINE_CORRELATE_TEST(13, 1);
DEFINE_CORRELATE_TEST(13, 2);
DEFINE_CORRELATE_TEST(13, 3);
DEFINE_CORRELATE_TEST(13, 8);
DEFINE_CORRELATE_TEST(13, 11);

static void test_arm_conv_f32(
	size_t in1_length, size_t in2_length, const uint32_t *ref,
	size_t ref_length)
{
	float32_t *output;

	/* Allocate output buffer */
	output = calloc(ref_length, sizeof(float32_t));

	/* Run test function */
	arm_conv_f32(
		(float32_t *)in_com1, in1_length,
		(float32_t *)in_com2, in2_length, output);

	/* Validate output */
	zassert_true(
		test_snr_error_f32(ref_length, (float32_t *)ref, output,
			SNR_ERROR_THRESH),
		ASSERT_MSG_SNR_LIMIT_EXCEED);

	zassert_true(
		test_close_error_f32(ref_length, (float32_t *)ref, output,
			ABS_ERROR_THRESH, REL_ERROR_THRESH),
		ASSERT_MSG_ERROR_LIMIT_EXCEED);

	/* Free output buffer */
	free(output);
}

#define DEFINE_CONV_TEST(a, b) \
	DEFINE_TEST_VARIANT4( \
		arm_conv_f32, a##_##b, a, b, \
		ref_conv_##a##_##b, ARRAY_SIZE(ref_conv_##a##_##b))

DEFINE_CONV_TEST(4, 1);
DEFINE_CONV_TEST(4, 2);
DEFINE_CONV_TEST(4, 3);
DEFINE_CONV_TEST(4, 8);
DEFINE_CONV_TEST(4, 11);
DEFINE_CONV_TEST(5, 1);
DEFINE_CONV_TEST(5, 2);
DEFINE_CONV_TEST(5, 3);
DEFINE_CONV_TEST(5, 8);
DEFINE_CONV_TEST(5, 11);
DEFINE_CONV_TEST(6, 1);
DEFINE_CONV_TEST(6, 2);
DEFINE_CONV_TEST(6, 3);
DEFINE_CONV_TEST(6, 8);
DEFINE_CONV_TEST(6, 11);
DEFINE_CONV_TEST(9, 1);
DEFINE_CONV_TEST(9, 2);
DEFINE_CONV_TEST(9, 3);
DEFINE_CONV_TEST(9, 8);
DEFINE_CONV_TEST(9, 11);
DEFINE_CONV_TEST(10, 1);
DEFINE_CONV_TEST(10, 2);
DEFINE_CONV_TEST(10, 3);
DEFINE_CONV_TEST(10, 8);
DEFINE_CONV_TEST(10, 11);
DEFINE_CONV_TEST(11, 1);
DEFINE_CONV_TEST(11, 2);
DEFINE_CONV_TEST(11, 3);
DEFINE_CONV_TEST(11, 8);
DEFINE_CONV_TEST(11, 11);
DEFINE_CONV_TEST(12, 1);
DEFINE_CONV_TEST(12, 2);
DEFINE_CONV_TEST(12, 3);
DEFINE_CONV_TEST(12, 8);
DEFINE_CONV_TEST(12, 11);
DEFINE_CONV_TEST(13, 1);
DEFINE_CONV_TEST(13, 2);
DEFINE_CONV_TEST(13, 3);
DEFINE_CONV_TEST(13, 8);
DEFINE_CONV_TEST(13, 11);

void test_filtering_misc_f32(void)
{
	ztest_test_suite(filtering_misc_f32,
		ztest_unit_test(test_arm_correlate_f32_4_1),
		ztest_unit_test(test_arm_correlate_f32_4_2),
		ztest_unit_test(test_arm_correlate_f32_4_3),
		ztest_unit_test(test_arm_correlate_f32_4_8),
		ztest_unit_test(test_arm_correlate_f32_4_11),
		ztest_unit_test(test_arm_correlate_f32_5_1),
		ztest_unit_test(test_arm_correlate_f32_5_2),
		ztest_unit_test(test_arm_correlate_f32_5_3),
		ztest_unit_test(test_arm_correlate_f32_5_8),
		ztest_unit_test(test_arm_correlate_f32_5_11),
		ztest_unit_test(test_arm_correlate_f32_6_1),
		ztest_unit_test(test_arm_correlate_f32_6_2),
		ztest_unit_test(test_arm_correlate_f32_6_3),
		ztest_unit_test(test_arm_correlate_f32_6_8),
		ztest_unit_test(test_arm_correlate_f32_6_11),
		ztest_unit_test(test_arm_correlate_f32_9_1),
		ztest_unit_test(test_arm_correlate_f32_9_2),
		ztest_unit_test(test_arm_correlate_f32_9_3),
		ztest_unit_test(test_arm_correlate_f32_9_8),
		ztest_unit_test(test_arm_correlate_f32_9_11),
		ztest_unit_test(test_arm_correlate_f32_10_1),
		ztest_unit_test(test_arm_correlate_f32_10_2),
		ztest_unit_test(test_arm_correlate_f32_10_3),
		ztest_unit_test(test_arm_correlate_f32_10_8),
		ztest_unit_test(test_arm_correlate_f32_10_11),
		ztest_unit_test(test_arm_correlate_f32_11_1),
		ztest_unit_test(test_arm_correlate_f32_11_2),
		ztest_unit_test(test_arm_correlate_f32_11_3),
		ztest_unit_test(test_arm_correlate_f32_11_8),
		ztest_unit_test(test_arm_correlate_f32_11_11),
		ztest_unit_test(test_arm_correlate_f32_12_1),
		ztest_unit_test(test_arm_correlate_f32_12_2),
		ztest_unit_test(test_arm_correlate_f32_12_3),
		ztest_unit_test(test_arm_correlate_f32_12_8),
		ztest_unit_test(test_arm_correlate_f32_12_11),
		ztest_unit_test(test_arm_correlate_f32_13_1),
		ztest_unit_test(test_arm_correlate_f32_13_2),
		ztest_unit_test(test_arm_correlate_f32_13_3),
		ztest_unit_test(test_arm_correlate_f32_13_8),
		ztest_unit_test(test_arm_correlate_f32_13_11),
		ztest_unit_test(test_arm_conv_f32_4_1),
		ztest_unit_test(test_arm_conv_f32_4_2),
		ztest_unit_test(test_arm_conv_f32_4_3),
		ztest_unit_test(test_arm_conv_f32_4_8),
		ztest_unit_test(test_arm_conv_f32_4_11),
		ztest_unit_test(test_arm_conv_f32_5_1),
		ztest_unit_test(test_arm_conv_f32_5_2),
		ztest_unit_test(test_arm_conv_f32_5_3),
		ztest_unit_test(test_arm_conv_f32_5_8),
		ztest_unit_test(test_arm_conv_f32_5_11),
		ztest_unit_test(test_arm_conv_f32_6_1),
		ztest_unit_test(test_arm_conv_f32_6_2),
		ztest_unit_test(test_arm_conv_f32_6_3),
		ztest_unit_test(test_arm_conv_f32_6_8),
		ztest_unit_test(test_arm_conv_f32_6_11),
		ztest_unit_test(test_arm_conv_f32_9_1),
		ztest_unit_test(test_arm_conv_f32_9_2),
		ztest_unit_test(test_arm_conv_f32_9_3),
		ztest_unit_test(test_arm_conv_f32_9_8),
		ztest_unit_test(test_arm_conv_f32_9_11),
		ztest_unit_test(test_arm_conv_f32_10_1),
		ztest_unit_test(test_arm_conv_f32_10_2),
		ztest_unit_test(test_arm_conv_f32_10_3),
		ztest_unit_test(test_arm_conv_f32_10_8),
		ztest_unit_test(test_arm_conv_f32_10_11),
		ztest_unit_test(test_arm_conv_f32_11_1),
		ztest_unit_test(test_arm_conv_f32_11_2),
		ztest_unit_test(test_arm_conv_f32_11_3),
		ztest_unit_test(test_arm_conv_f32_11_8),
		ztest_unit_test(test_arm_conv_f32_11_11),
		ztest_unit_test(test_arm_conv_f32_12_1),
		ztest_unit_test(test_arm_conv_f32_12_2),
		ztest_unit_test(test_arm_conv_f32_12_3),
		ztest_unit_test(test_arm_conv_f32_12_8),
		ztest_unit_test(test_arm_conv_f32_12_11),
		ztest_unit_test(test_arm_conv_f32_13_1),
		ztest_unit_test(test_arm_conv_f32_13_2),
		ztest_unit_test(test_arm_conv_f32_13_3),
		ztest_unit_test(test_arm_conv_f32_13_8),
		ztest_unit_test(test_arm_conv_f32_13_11)
		);

	ztest_run_test_suite(filtering_misc_f32);
}
```

## src/misc_q15.c
```c
/*
 * Copyright (c) 2020 Stephanos Ioannidis <root@stephanos.io>
 * Copyright (C) 2010-2020 ARM Limited or its affiliates. All rights reserved.
 *
 * SPDX-License-Identifier: Apache-2.0
 */

#include <ztest.h>
#include <zephyr.h>
#include <stdlib.h>
#include <arm_math.h>
#include "../../common/test_common.h"

#include "misc_q15.pat"

#define SNR_ERROR_THRESH	((float32_t)70)
#define ABS_ERROR_THRESH_Q15	((q15_t)10)

static void test_arm_correlate_q15(
	size_t in1_length, size_t in2_length, const q15_t *ref,
	size_t ref_length)
{
	q15_t *output;

	/* Allocate output buffer */
	output = calloc(ref_length, sizeof(q15_t));

	/* Run test function */
	arm_correlate_q15(in_com1, in1_length, in_com2, in2_length, output);

	/* Validate output */
	zassert_true(
		test_snr_error_q15(ref_length, ref, output, SNR_ERROR_THRESH),
		ASSERT_MSG_SNR_LIMIT_EXCEED);

	zassert_true(
		test_near_equal_q15(ref_length, ref, output,
			ABS_ERROR_THRESH_Q15),
		ASSERT_MSG_ABS_ERROR_LIMIT_EXCEED);

	/* Free output buffer */
	free(output);
}

#define DEFINE_CORRELATE_TEST(a, b) \
	DEFINE_TEST_VARIANT4( \
		arm_correlate_q15, a##_##b, a, b, \
		ref_correlate_##a##_##b, ARRAY_SIZE(ref_correlate_##a##_##b))

DEFINE_CORRELATE_TEST(14, 15);
DEFINE_CORRELATE_TEST(14, 16);
DEFINE_CORRELATE_TEST(14, 17);
DEFINE_CORRELATE_TEST(14, 18);
DEFINE_CORRELATE_TEST(14, 33);
DEFINE_CORRELATE_TEST(15, 15);
DEFINE_CORRELATE_TEST(15, 16);
DEFINE_CORRELATE_TEST(15, 17);
DEFINE_CORRELATE_TEST(15, 18);
DEFINE_CORRELATE_TEST(15, 33);
DEFINE_CORRELATE_TEST(16, 15);
DEFINE_CORRELATE_TEST(16, 16);
DEFINE_CORRELATE_TEST(16, 17);
DEFINE_CORRELATE_TEST(16, 18);
DEFINE_CORRELATE_TEST(16, 33);
DEFINE_CORRELATE_TEST(17, 15);
DEFINE_CORRELATE_TEST(17, 16);
DEFINE_CORRELATE_TEST(17, 17);
DEFINE_CORRELATE_TEST(17, 18);
DEFINE_CORRELATE_TEST(17, 33);
DEFINE_CORRELATE_TEST(32, 15);
DEFINE_CORRELATE_TEST(32, 16);
DEFINE_CORRELATE_TEST(32, 17);
DEFINE_CORRELATE_TEST(32, 18);
DEFINE_CORRELATE_TEST(32, 33);

static void test_arm_conv_q15(
	size_t in1_length, size_t in2_length, const q15_t *ref,
	size_t ref_length)
{
	q15_t *output;

	/* Allocate output buffer */
	output = calloc(ref_length, sizeof(q15_t));

	/* Run test function */
	arm_conv_q15(in_com1, in1_length, in_com2, in2_length, output);

	/* Validate output */
	zassert_true(
		test_snr_error_q15(ref_length, ref, output, SNR_ERROR_THRESH),
		ASSERT_MSG_SNR_LIMIT_EXCEED);

	zassert_true(
		test_near_equal_q15(ref_length, ref, output,
			ABS_ERROR_THRESH_Q15),
		ASSERT_MSG_ABS_ERROR_LIMIT_EXCEED);

	/* Free output buffer */
	free(output);
}

#define DEFINE_CONV_TEST(a, b) \
	DEFINE_TEST_VARIANT4( \
		arm_conv_q15, a##_##b, a, b, \
		ref_conv_##a##_##b, ARRAY_SIZE(ref_conv_##a##_##b))

DEFINE_CONV_TEST(14, 15);
DEFINE_CONV_TEST(14, 16);
DEFINE_CONV_TEST(14, 17);
DEFINE_CONV_TEST(14, 18);
DEFINE_CONV_TEST(14, 33);
DEFINE_CONV_TEST(15, 15);
DEFINE_CONV_TEST(15, 16);
DEFINE_CONV_TEST(15, 17);
DEFINE_CONV_TEST(15, 18);
DEFINE_CONV_TEST(15, 33);
DEFINE_CONV_TEST(16, 15);
DEFINE_CONV_TEST(16, 16);
DEFINE_CONV_TEST(16, 17);
DEFINE_CONV_TEST(16, 18);
DEFINE_CONV_TEST(16, 33);
DEFINE_CONV_TEST(17, 15);
DEFINE_CONV_TEST(17, 16);
DEFINE_CONV_TEST(17, 17);
DEFINE_CONV_TEST(17, 18);
DEFINE_CONV_TEST(17, 33);
DEFINE_CONV_TEST(32, 15);
DEFINE_CONV_TEST(32, 16);
DEFINE_CONV_TEST(32, 17);
DEFINE_CONV_TEST(32, 18);
DEFINE_CONV_TEST(32, 33);

void test_filtering_misc_q15(void)
{
	ztest_test_suite(filtering_misc_q15,
		ztest_unit_test(test_arm_correlate_q15_14_15),
		ztest_unit_test(test_arm_correlate_q15_14_16),
		ztest_unit_test(test_arm_correlate_q15_14_17),
		ztest_unit_test(test_arm_correlate_q15_14_18),
		ztest_unit_test(test_arm_correlate_q15_14_33),
		ztest_unit_test(test_arm_correlate_q15_15_15),
		ztest_unit_test(test_arm_correlate_q15_15_16),
		ztest_unit_test(test_arm_correlate_q15_15_17),
		ztest_unit_test(test_arm_correlate_q15_15_18),
		ztest_unit_test(test_arm_correlate_q15_15_33),
		ztest_unit_test(test_arm_correlate_q15_16_15),
		ztest_unit_test(test_arm_correlate_q15_16_16),
		ztest_unit_test(test_arm_correlate_q15_16_17),
		ztest_unit_test(test_arm_correlate_q15_16_18),
		ztest_unit_test(test_arm_correlate_q15_16_33),
		ztest_unit_test(test_arm_correlate_q15_17_15),
		ztest_unit_test(test_arm_correlate_q15_17_16),
		ztest_unit_test(test_arm_correlate_q15_17_17),
		ztest_unit_test(test_arm_correlate_q15_17_18),
		ztest_unit_test(test_arm_correlate_q15_17_33),
		ztest_unit_test(test_arm_correlate_q15_32_15),
		ztest_unit_test(test_arm_correlate_q15_32_16),
		ztest_unit_test(test_arm_correlate_q15_32_17),
		ztest_unit_test(test_arm_correlate_q15_32_18),
		ztest_unit_test(test_arm_correlate_q15_32_33),
		ztest_unit_test(test_arm_conv_q15_14_15),
		ztest_unit_test(test_arm_conv_q15_14_16),
		ztest_unit_test(test_arm_conv_q15_14_17),
		ztest_unit_test(test_arm_conv_q15_14_18),
		ztest_unit_test(test_arm_conv_q15_14_33),
		ztest_unit_test(test_arm_conv_q15_15_15),
		ztest_unit_test(test_arm_conv_q15_15_16),
		ztest_unit_test(test_arm_conv_q15_15_17),
		ztest_unit_test(test_arm_conv_q15_15_18),
		ztest_unit_test(test_arm_conv_q15_15_33),
		ztest_unit_test(test_arm_conv_q15_16_15),
		ztest_unit_test(test_arm_conv_q15_16_16),
		ztest_unit_test(test_arm_conv_q15_16_17),
		ztest_unit_test(test_arm_conv_q15_16_18),
		ztest_unit_test(test_arm_conv_q15_16_33),
		ztest_unit_test(test_arm_conv_q15_17_15),
		ztest_unit_test(test_arm_conv_q15_17_16),
		ztest_unit_test(test_arm_conv_q15_17_17),
		ztest_unit_test(test_arm_conv_q15_17_18),
		ztest_unit_test(test_arm_conv_q15_17_33),
		ztest_unit_test(test_arm_conv_q15_32_15),
		ztest_unit_test(test_arm_conv_q15_32_16),
		ztest_unit_test(test_arm_conv_q15_32_17),
		ztest_unit_test(test_arm_conv_q15_32_18),
		ztest_unit_test(test_arm_conv_q15_32_33)
		);

	ztest_run_test_suite(filtering_misc_q15);
}
```

## src/misc_q7.c
```c
/*
 * Copyright (c) 2020 Stephanos Ioannidis <root@stephanos.io>
 * Copyright (C) 2010-2020 ARM Limited or its affiliates. All rights reserved.
 *
 * SPDX-License-Identifier: Apache-2.0
 */

#include <ztest.h>
#include <zephyr.h>
#include <stdlib.h>
#include <arm_math.h>
#include "../../common/test_common.h"

#include "misc_q7.pat"

#define SNR_ERROR_THRESH	((float32_t)15)
#define ABS_ERROR_THRESH_Q7	((q7_t)5)

static void test_arm_correlate_q7(
	size_t in1_length, size_t in2_length, const q7_t *ref,
	size_t ref_length)
{
	q7_t *output;

	/* Allocate output buffer */
	output = calloc(ref_length, sizeof(q7_t));

	/* Run test function */
	arm_correlate_q7(in_com1, in1_length, in_com2, in2_length, output);

	/* Validate output */
	zassert_true(
		test_snr_error_q7(ref_length, ref, output, SNR_ERROR_THRESH),
		ASSERT_MSG_SNR_LIMIT_EXCEED);

	zassert_true(
		test_near_equal_q7(ref_length, ref, output,
			ABS_ERROR_THRESH_Q7),
		ASSERT_MSG_ABS_ERROR_LIMIT_EXCEED);

	/* Free output buffer */
	free(output);
}

#define DEFINE_CORRELATE_TEST(a, b) \
	DEFINE_TEST_VARIANT4( \
		arm_correlate_q7, a##_##b, a, b, \
		ref_correlate_##a##_##b, ARRAY_SIZE(ref_correlate_##a##_##b))

DEFINE_CORRELATE_TEST(30, 31);
DEFINE_CORRELATE_TEST(30, 32);
DEFINE_CORRELATE_TEST(30, 33);
DEFINE_CORRELATE_TEST(30, 34);
DEFINE_CORRELATE_TEST(30, 49);
DEFINE_CORRELATE_TEST(31, 31);
DEFINE_CORRELATE_TEST(31, 32);
DEFINE_CORRELATE_TEST(31, 33);
DEFINE_CORRELATE_TEST(31, 34);
DEFINE_CORRELATE_TEST(31, 49);
DEFINE_CORRELATE_TEST(32, 31);
DEFINE_CORRELATE_TEST(32, 32);
DEFINE_CORRELATE_TEST(32, 33);
DEFINE_CORRELATE_TEST(32, 34);
DEFINE_CORRELATE_TEST(32, 49);
DEFINE_CORRELATE_TEST(33, 31);
DEFINE_CORRELATE_TEST(33, 32);
DEFINE_CORRELATE_TEST(33, 33);
DEFINE_CORRELATE_TEST(33, 34);
DEFINE_CORRELATE_TEST(33, 49);
DEFINE_CORRELATE_TEST(48, 31);
DEFINE_CORRELATE_TEST(48, 32);
DEFINE_CORRELATE_TEST(48, 33);
DEFINE_CORRELATE_TEST(48, 34);
DEFINE_CORRELATE_TEST(48, 49);

static void test_arm_conv_q7(
	size_t in1_length, size_t in2_length, const q7_t *ref,
	size_t ref_length)
{
	q7_t *output;

	/* Allocate output buffer */
	output = calloc(ref_length, sizeof(q7_t));

	/* Run test function */
	arm_conv_q7(in_com1, in1_length, in_com2, in2_length, output);

	/* Validate output */
	zassert_true(
		test_snr_error_q7(ref_length, ref, output, SNR_ERROR_THRESH),
		ASSERT_MSG_SNR_LIMIT_EXCEED);

	zassert_true(
		test_near_equal_q7(ref_length, ref, output,
			ABS_ERROR_THRESH_Q7),
		ASSERT_MSG_ABS_ERROR_LIMIT_EXCEED);

	/* Free output buffer */
	free(output);
}

#define DEFINE_CONV_TEST(a, b) \
	DEFINE_TEST_VARIANT4( \
		arm_conv_q7, a##_##b, a, b, \
		ref_conv_##a##_##b, ARRAY_SIZE(ref_conv_##a##_##b))

DEFINE_CONV_TEST(30, 31);
DEFINE_CONV_TEST(30, 32);
DEFINE_CONV_TEST(30, 33);
DEFINE_CONV_TEST(30, 34);
DEFINE_CONV_TEST(30, 49);
DEFINE_CONV_TEST(31, 31);
DEFINE_CONV_TEST(31, 32);
DEFINE_CONV_TEST(31, 33);
DEFINE_CONV_TEST(31, 34);
DEFINE_CONV_TEST(31, 49);
DEFINE_CONV_TEST(32, 31);
DEFINE_CONV_TEST(32, 32);
DEFINE_CONV_TEST(32, 33);
DEFINE_CONV_TEST(32, 34);
DEFINE_CONV_TEST(32, 49);
DEFINE_CONV_TEST(33, 31);
DEFINE_CONV_TEST(33, 32);
DEFINE_CONV_TEST(33, 33);
DEFINE_CONV_TEST(33, 34);
DEFINE_CONV_TEST(33, 49);
DEFINE_CONV_TEST(48, 31);
DEFINE_CONV_TEST(48, 32);
DEFINE_CONV_TEST(48, 33);
DEFINE_CONV_TEST(48, 34);
DEFINE_CONV_TEST(48, 49);

void test_filtering_misc_q7(void)
{
	ztest_test_suite(filtering_misc_q7,
		ztest_unit_test(test_arm_correlate_q7_30_31),
		ztest_unit_test(test_arm_correlate_q7_30_32),
		ztest_unit_test(test_arm_correlate_q7_30_33),
		ztest_unit_test(test_arm_correlate_q7_30_34),
		ztest_unit_test(test_arm_correlate_q7_30_49),
		ztest_unit_test(test_arm_correlate_q7_31_31),
		ztest_unit_test(test_arm_correlate_q7_31_32),
		ztest_unit_test(test_arm_correlate_q7_31_33),
		ztest_unit_test(test_arm_correlate_q7_31_34),
		ztest_unit_test(test_arm_correlate_q7_31_49),
		ztest_unit_test(test_arm_correlate_q7_32_31),
		ztest_unit_test(test_arm_correlate_q7_32_32),
		ztest_unit_test(test_arm_correlate_q7_32_33),
		ztest_unit_test(test_arm_correlate_q7_32_34),
		ztest_unit_test(test_arm_correlate_q7_32_49),
		ztest_unit_test(test_arm_correlate_q7_33_31),
		ztest_unit_test(test_arm_correlate_q7_33_32),
		ztest_unit_test(test_arm_correlate_q7_33_33),
		ztest_unit_test(test_arm_correlate_q7_33_34),
		ztest_unit_test(test_arm_correlate_q7_33_49),
		ztest_unit_test(test_arm_correlate_q7_48_31),
		ztest_unit_test(test_arm_correlate_q7_48_32),
		ztest_unit_test(test_arm_correlate_q7_48_33),
		ztest_unit_test(test_arm_correlate_q7_48_34),
		ztest_unit_test(test_arm_correlate_q7_48_49),
		ztest_unit_test(test_arm_conv_q7_30_31),
		ztest_unit_test(test_arm_conv_q7_30_32),
		ztest_unit_test(test_arm_conv_q7_30_33),
		ztest_unit_test(test_arm_conv_q7_30_34),
		ztest_unit_test(test_arm_conv_q7_30_49),
		ztest_unit_test(test_arm_conv_q7_31_31),
		ztest_unit_test(test_arm_conv_q7_31_32),
		ztest_unit_test(test_arm_conv_q7_31_33),
		ztest_unit_test(test_arm_conv_q7_31_34),
		ztest_unit_test(test_arm_conv_q7_31_49),
		ztest_unit_test(test_arm_conv_q7_32_31),
		ztest_unit_test(test_arm_conv_q7_32_32),
		ztest_unit_test(test_arm_conv_q7_32_33),
		ztest_unit_test(test_arm_conv_q7_32_34),
		ztest_unit_test(test_arm_conv_q7_32_49),
		ztest_unit_test(test_arm_conv_q7_33_31),
		ztest_unit_test(test_arm_conv_q7_33_32),
		ztest_unit_test(test_arm_conv_q7_33_33),
		ztest_unit_test(test_arm_conv_q7_33_34),
		ztest_unit_test(test_arm_conv_q7_33_49),
		ztest_unit_test(test_arm_conv_q7_48_31),
		ztest_unit_test(test_arm_conv_q7_48_32),
		ztest_unit_test(test_arm_conv_q7_48_33),
		ztest_unit_test(test_arm_conv_q7_48_34),
		ztest_unit_test(test_arm_conv_q7_48_49)
		);

	ztest_run_test_suite(filtering_misc_q7);
}
```
