## CMakeLists.txt
```
# SPDX-License-Identifier: Apache-2.0

cmake_minimum_required(VERSION 3.13.1)
include($ENV{ZEPHYR_BASE}/cmake/app/boilerplate.cmake NO_POLICY_SCOPE)
project(fs_api)

FILE(GLOB app_sources src/*.c)
target_sources(app PRIVATE ${app_sources})
```

## prj.conf
```kconfig
CONFIG_FILE_SYSTEM=y
CONFIG_ZTEST=y
```

## src/main.c
```c
/*
 * Copyright (c) 2016 Intel Corporation.
 *
 * SPDX-License-Identifier: Apache-2.0
 */

#include "test_fs.h"

/**
 * @brief Test file system interface implemented in kernel
 *
 * @defgroup filesystem File System
 *
 * @ingroup all_test
 * @{
 * @}
 */

static void fs_setup(void)
{
	fs_register(TEST_FS_1, &temp_fs);
}

static void dummy_teardown(void)
{
	return;
}

static void dummy_setup(void)
{
	return;
}

static void fs_teardown(void)
{
	fs_unregister(TEST_FS_1, &temp_fs);
}

/**
 * @brief Common file system operations through a general interface
 *
 * @details After register file system:
 *            - mount
 *            - statvfs
 *            - mkdir
 *            - opendir
 *            - readdir
 *            - closedir
 *            - open
 *            - write
 *            - read
 *            - lseek
 *            - tell
 *            - truncate
 *            - sync
 *            - close
 *            - rename
 *            - stat
 *            - unlink
 *            - unmount
 *            - unregister file system
 *          the order of test cases is critical, one case depend on ther
 *          case before it.
 *
 * @ingroup filesystem
 *
 */
void test_main(void)
{
	ztest_test_suite(fat_fs_basic_test,
			 ztest_unit_test(test_fs_register),
			 ztest_unit_test_setup_teardown(test_mount,
							fs_setup,
							dummy_teardown),
			 ztest_unit_test(test_fs_file_t_init),
			 ztest_unit_test(test_fs_dir_t_init),
			 ztest_unit_test(test_file_statvfs),
			 ztest_unit_test(test_mkdir),
			 ztest_unit_test(test_opendir),
			 ztest_unit_test(test_closedir),
			 ztest_unit_test(test_opendir_closedir),
			 ztest_unit_test(test_lsdir),
			 ztest_unit_test(test_file_open),
			 ztest_unit_test(test_file_write),
			 ztest_unit_test(test_file_read),
			 ztest_unit_test(test_file_seek),
			 ztest_unit_test(test_file_truncate),
			 ztest_unit_test(test_file_close),
			 ztest_unit_test(test_file_sync),
			 ztest_unit_test(test_file_rename),
			 ztest_unit_test(test_file_stat),
			 ztest_unit_test(test_file_unlink),
			 ztest_unit_test(test_unmount),
			 ztest_unit_test_setup_teardown(test_mount_flags,
							dummy_setup,
							fs_teardown)
			 );
	ztest_run_test_suite(fat_fs_basic_test);
}
```

## src/test_fs.c
```c
/*
 * Copyright (c) 2020 Intel Corporation.
 *
 * SPDX-License-Identifier: Apache-2.0
 */

#include <stdio.h>
#include <string.h>
#include <kernel.h>
#include <zephyr/types.h>
#include <errno.h>
#include <init.h>
#include <fs/fs.h>
#include <fs/fs_sys.h>
#include <sys/__assert.h>
#include "test_fs.h"

#define BUF_LEN 128
static char buffer[BUF_LEN];
static char *read_pos = buffer;
static char *cur = buffer;
static int file_length;
static struct fs_mount_t *mp[FS_TYPE_EXTERNAL_BASE];
static bool nospace;
static int opendir_result;

static
int temp_open(struct fs_file_t *zfp, const char *file_name, fs_mode_t flags)
{
	if (zfp == NULL || file_name == NULL) {
		return -EINVAL;
	}

	if (zfp->filep) {
		if (strcmp(zfp->filep, file_name) == 0) {
			/* file has been opened */
			return -EEXIST;
		}
	}

	if (!(flags & FS_O_MASK)) {
		return -EINVAL;
	}

	zfp->filep = (char *)file_name;
	return 0;
}

static int temp_close(struct fs_file_t *zfp)
{
	if (zfp == NULL) {
		return -EINVAL;
	}

	if (zfp->filep) {
		zfp->filep = NULL;
	} else {
		return -EIO;
	}

	return 0;
}

static int temp_unlink(struct fs_mount_t *mountp, const char *path)
{
	if (mountp == NULL || path == NULL) {
		return -EINVAL;
	}

	if (strcmp(mountp->mnt_point, path) == 0) {
		return -EPERM;
	}
	return 0;
}

static int temp_rename(struct fs_mount_t *mountp, const char *from,
			const char *to)
{
	if (mountp == NULL || from == NULL || to == NULL) {
		return -EINVAL;
	}

	if (strcmp(to, TEST_FILE_EX) == 0) {
		return -EINVAL;
	}
	return 0;
}

static ssize_t temp_read(struct fs_file_t *zfp, void *ptr, size_t size)
{
	unsigned int br;

	if (zfp == NULL || ptr == NULL) {
		return -EINVAL;
	}

	br = size;
	if (read_pos - buffer + br > file_length) {
		br = file_length - (read_pos - buffer);
	}
	memcpy(ptr, read_pos, br);
	read_pos += br;
	cur = read_pos;

	return br;
}

static ssize_t temp_write(struct fs_file_t *zfp, const void *ptr, size_t size)
{
	unsigned int bw;

	if (zfp == NULL || ptr == NULL) {
		return -EINVAL;
	}

	if (nospace) {
		return -ENOSPC;
	}

	bw = size;
	if (file_length + bw >  BUF_LEN) {
		bw = BUF_LEN - file_length;
		nospace = true;
	}

	memcpy(buffer + file_length, ptr, bw);
	file_length += bw;
	cur = buffer + file_length;

	return bw;
}

static int temp_seek(struct fs_file_t *zfp, off_t offset, int whence)
{

	if (!zfp) {
		return -EINVAL;
	}

	switch (whence) {
	case FS_SEEK_SET:
		cur = buffer + offset;
		break;
	case FS_SEEK_CUR:
		cur += offset;
		break;
	case FS_SEEK_END:
		cur = buffer + file_length + offset;
		break;
	default:
		return -EINVAL;
	}

	if ((cur < buffer) || (cur > buffer + file_length)) {
		return -EINVAL;
	}

	return 0;
}

static off_t temp_tell(struct fs_file_t *zfp)
{
	if (!zfp) {
		return -EINVAL;
	}

	if (nospace) {
		return -ENOSPC;
	}

	return cur - buffer;
}

static int temp_truncate(struct fs_file_t *zfp, off_t length)
{
	if (!zfp) {
		return -EINVAL;
	}

	if (length > BUF_LEN) {
		return -EINVAL;
	}
	file_length = length;
	return 0;
}

static int temp_sync(struct fs_file_t *zfp)
{
	if (!zfp) {
		return -EINVAL;
	}

	if (nospace) {
		return -ENOSPC;
	}

	return 0;
}

static int temp_mkdir(struct fs_mount_t *mountp, const char *path)
{
	if (mountp == NULL || path == NULL) {
		return -EINVAL;
	}

	if (strcmp(mountp->mnt_point, path) == 0) {
		return -EPERM;
	}
	return 0;
}

void mock_opendir_result(int ret)
{
	opendir_result = ret;
}

static int temp_opendir(struct fs_dir_t *zdp, const char *path)
{
	if (zdp == NULL || path == NULL) {
		return -EINVAL;
	}

	if (opendir_result) {
		return opendir_result;
	}

	zdp->dirp = (char *)path;
	return 0;
}

static int i;
static int temp_readdir(struct fs_dir_t *zdp, struct fs_dirent *entry)
{
	if (!zdp) {
		return -EINVAL;
	}

	if (!entry) {
		return -ENOENT;
	}

	switch (i) {
	case 0:
		strcpy(entry->name, ".");
		entry->type = FS_DIR_ENTRY_DIR;
		i++;
		break;
	case 1:
		strcpy(entry->name, "testdir");
		entry->type = FS_DIR_ENTRY_DIR;
		i++;
		break;
	case 2:
		strcpy(entry->name, "test.txt");
		entry->type = FS_DIR_ENTRY_FILE;
		i++;
		break;
	case 3:
		strcpy(entry->name, "..");
		entry->type = FS_DIR_ENTRY_DIR;
		i++;
		break;
	default:
		strcpy(entry->name, "\0");
		i = 0;
		break;
	}
	return 0;
}

static int temp_closedir(struct fs_dir_t *zdp)
{
	if (!zdp) {
		return -EINVAL;
	}

	if (!(zdp->dirp)) {
		return -EIO;
	}
	zdp->dirp = NULL;
	return 0;
}

static int temp_stat(struct fs_mount_t *mountp,
		      const char *path, struct fs_dirent *entry)
{
	if (mountp == NULL || path == NULL || entry == NULL) {
		return -EINVAL;
	}

	return 0;
}

static int temp_statvfs(struct fs_mount_t *mountp,
			 const char *path, struct fs_statvfs *stat)
{
	if (mountp == NULL || path == NULL || stat == NULL) {
		return -EINVAL;
	}

	memset(stat, 0, sizeof(struct fs_statvfs));
	stat->f_bsize = 512;
	return 0;
}

static int temp_mount(struct fs_mount_t *mountp)
{
	if (mountp == NULL) {
		return -EINVAL;
	}

	size_t len = strlen(mountp->mnt_point);

	if (mountp->mnt_point[len - 1] != ':') {
		return -EINVAL;
	}
	mp[mountp->type] = mountp;
	return 0;
}

static int temp_unmount(struct fs_mount_t *mountp)
{
	if (mountp == NULL) {
		return -EINVAL;
	}

	if (mp[mountp->type] == NULL) {
		return -EINVAL;
	}
	mp[mountp->type] = NULL;
	return 0;
}

/* File system interface */
struct fs_file_system_t temp_fs = {
	.open = temp_open,
	.close = temp_close,
	.read = temp_read,
	.write = temp_write,
	.lseek = temp_seek,
	.tell = temp_tell,
	.truncate = temp_truncate,
	.sync = temp_sync,
	.opendir = temp_opendir,
	.readdir = temp_readdir,
	.closedir = temp_closedir,
	.mount = temp_mount,
	.unmount = temp_unmount,
	.unlink = temp_unlink,
	.rename = temp_rename,
	.mkdir = temp_mkdir,
	.stat = temp_stat,
	.statvfs = temp_statvfs,
};
```

## src/test_fs.h
```c
/*
 * Copyright (c) 2020 Intel Corporation.
 *
 * SPDX-License-Identifier: Apache-2.0
 */

#ifndef __TEST_FS_H__
#define __TEST_FS_H__

#include <zephyr.h>
#include <ztest.h>
#include <fs/fs.h>
#include <fs/fs_sys.h>

#define TEST_FS_MNTP	"/NAND:"
#define TEST_FILE	TEST_FS_MNTP"/testfile.txt"
#define TEST_FILE_RN	TEST_FS_MNTP"/testfile_renamed.txt"
#define TEST_FILE_EX	TEST_FS_MNTP"/testfile_exist.txt"
#define TEST_DIR	TEST_FS_MNTP"/testdir"
#define TEST_DIR_FILE	TEST_FS_MNTP"/testdir/testfile.txt"

/* kenel only reserve two slots for specific file system.
 * By disable that two file systems, test cases can make
 * use of that slots to register a file systems for test
 */
#define TEST_FS_1 FS_FATFS
#define TEST_FS_2 FS_LITTLEFS

extern struct fs_file_system_t temp_fs;

struct test_fs_data {
	int reserve;
};

void mock_opendir_result(int ret);

void test_opendir_closedir(void);
void test_fs_dir_t_init(void);
void test_fs_file_t_init(void);
void test_fs_register(void);
void test_mount(void);
void test_file_statvfs(void);
void test_mkdir(void);
void test_opendir(void);
void test_closedir(void);
void test_lsdir(void);
void test_file_open(void);
void test_file_write(void);
void test_file_read(void);
void test_file_seek(void);
void test_file_truncate(void);
void test_file_close(void);
void test_file_sync(void);
void test_file_rename(void);
void test_file_stat(void);
void test_file_unlink(void);
void test_unmount(void);
void test_mount_flags(void);
#endif
```

## src/test_fs_mount_flags.c
```c
/*
 * Copyright (c) 2020 Nordic Semiconductor ASA
 *
 * SPDX-License-Identifier: Apache-2.0
 */

#include <ztest.h>
#include "test_fs.h"

static struct test_fs_data test_data;

static struct fs_mount_t mp = {
		.type = TEST_FS_1,
		.mnt_point = TEST_FS_MNTP,
		.fs_data = &test_data,
};

void test_mount_flags(void)
{
	int ret = 0;
	struct fs_file_t fs;

	fs_file_t_init(&fs);

	/* Format volume and add some files/dirs to check read-only flag */
	mp.flags = 0;
	TC_PRINT("Mount to prepare tests\n");
	ret = fs_mount(&mp);
	zassert_equal(ret, 0, "Expected success (%d)", ret);
	TC_PRINT("Create some file\n");
	ret = fs_open(&fs, TEST_FS_MNTP"/some", FS_O_CREATE);
	zassert_equal(ret, 0, "Expected success fs_open(FS_O_CREATE) (%d)",
		      ret);
	ret = fs_close(&fs);
	zassert_equal(ret, 0, "Expected fs_close success (%d)", ret);
	TC_PRINT("Create other directory\n");
	ret = fs_mkdir(TEST_FS_MNTP"/other");
	zassert_equal(ret, 0, "Expected fs_mkdir success (%d)", ret);
	ret = fs_unmount(&mp);
	zassert_equal(ret, 0, "Expected fs_umount success (%d)", ret);

	/* Check fs operation on volume mounted with FS_MOUNT_FLAG_READ_ONLY */
	mp.flags = FS_MOUNT_FLAG_READ_ONLY;
	TC_PRINT("Mount as read-only\n");
	ret = fs_mount(&mp);
	zassert_equal(ret, 0, "Expected fs_mount success (%d)", ret);

	/* Attempt creating new file */
	ret = fs_open(&fs, TEST_FS_MNTP"/nosome", FS_O_CREATE);
	zassert_equal(ret, -EROFS, "Expected EROFS got %d", ret);
	ret = fs_mkdir(TEST_FS_MNTP"/another");
	zassert_equal(ret, -EROFS, "Expected EROFS got %d", ret);
	ret = fs_rename(TEST_FS_MNTP"/some", TEST_FS_MNTP"/nosome");
	zassert_equal(ret, -EROFS, "Expected EROFS got %d", ret);
	ret = fs_unlink(TEST_FS_MNTP"/some");
	zassert_equal(ret, -EROFS, "Expected EROFS got %d", ret);
	ret = fs_open(&fs, TEST_FS_MNTP"/other", FS_O_CREATE);
	zassert_equal(ret, -EROFS, "Expected EROFS got %d", ret);
	ret = fs_open(&fs, TEST_FS_MNTP"/some", FS_O_RDWR);
	zassert_equal(ret, -EROFS, "Expected EROFS got %d", ret);
	ret = fs_open(&fs, TEST_FS_MNTP"/some", FS_O_READ);
	zassert_equal(ret, 0, "Expected fs_open(FS_O_READ) success (%d)", ret);
	ret = fs_close(&fs);
	zassert_equal(ret, 0, "Expected fs_close success (%d)", ret);
	ret = fs_unmount(&mp);
	zassert_equal(ret, 0, "Expected fs_unmount success (%d)", ret);
}
```

## src/test_multi_fs.c
```c
/*
 * Copyright (c) 2020 Intel Corporation.
 *
 * SPDX-License-Identifier: Apache-2.0
 */

#include "test_fs.h"
/* amount of file system */
#define NUM_FS 2
#define TEST_FS_NAND1 "/NAND:"
#define TEST_FS_NAND2 "/MMCBLOCK:"

static struct test_fs_data test_data;

static struct fs_mount_t test_fs_mnt_1 = {
		.type = TEST_FS_1,
		.mnt_point = TEST_FS_NAND1,
		.fs_data = &test_data,
};

static struct fs_mount_t test_fs_mnt_2 = {
		.type = TEST_FS_2,
		.mnt_point = TEST_FS_NAND2,
		.fs_data = &test_data,
};

static int test_fs_init(void)
{
	if (fs_register(TEST_FS_1, &temp_fs)) {
		return -EINVAL;
	}

	/* Attempt to re-register a file system */
	if (fs_register(TEST_FS_1, &temp_fs) != -EALREADY) {
		return -EINVAL;
	}

	if (fs_mount(&test_fs_mnt_1)) {
		return -EINVAL;
	}

	if (fs_register(TEST_FS_2, &temp_fs)) {
		return -EINVAL;
	}

	if (fs_mount(&test_fs_mnt_2)) {
		return -EINVAL;
	}

	return 0;
}

static int test_fs_readmount(void)
{
	int ret;
	int mnt_nbr = 0;
	const char *mnt_name;

	do {
		ret = fs_readmount(&mnt_nbr, &mnt_name);
		if (ret < 0) {
			break;
		}


	} while (true);

	if (mnt_nbr == NUM_FS) {
		return 0;
	}

	return TC_FAIL;
}

static int test_fs_deinit(void)
{
	/* NULL parameter */
	if (fs_unregister(TEST_FS_1, NULL) == 0) {
		return -EINVAL;
	}

	if (fs_unregister(TEST_FS_1, &temp_fs)) {
		return -EINVAL;
	}

	if (fs_unmount(&test_fs_mnt_1)) {
		return -EINVAL;
	}

	if (fs_unregister(TEST_FS_2, &temp_fs)) {
		return -EINVAL;
	}

	if (fs_unmount(&test_fs_mnt_2)) {
		return -EINVAL;
	}
	return 0;
}

static int test_fs_external(void)
{
	/* There is no way to statically determine whether a file
	 * system is unsupported, but  */
	if (fs_register(FS_TYPE_EXTERNAL_BASE, &temp_fs) != -ENOSPC) {
		return TC_FAIL;
	}

	if (fs_unregister(FS_TYPE_EXTERNAL_BASE, &temp_fs) != -EINVAL) {
		return TC_FAIL;
	}

	return 0;
}

/**
 * @brief Multi file systems register and unregister
 *
 * @details
 *  Register and unregister two file systems to test the system support
 *  multiple file system simultaneously
 *
 *@addtogroup filesystem_api
 *@{
 */

void test_fs_register(void)
{
	zassert_true(test_fs_init() == 0, "Failed to register filesystems");
	zassert_true(test_fs_readmount() == 0, "Failed to readmount");
	zassert_true(test_fs_external() == 0, "Supported other file system");
	zassert_true(test_fs_deinit() == 0, "Failed to unregister filesystems");
}

/**
 * @}
 */
```
