## CMakeLists.txt
```
# SPDX-License-Identifier: Apache-2.0

cmake_minimum_required(VERSION 3.13.1)
find_package(Zephyr REQUIRED HINTS $ENV{ZEPHYR_BASE})
project(fs_fcb)

FILE(GLOB app_sources src/*.c)
target_sources(app PRIVATE ${app_sources})
target_include_directories(app PRIVATE ${ZEPHYR_BASE}/subsys/fs/fcb)
```

## prj.conf
```kconfig
CONFIG_ZTEST=y
CONFIG_STDOUT_CONSOLE=y
CONFIG_FLASH=y
CONFIG_FLASH_PAGE_LAYOUT=y
CONFIG_FLASH_MAP=y
CONFIG_ARM_MPU=n
CONFIG_FCB=y
CONFIG_SOC_FLASH_NRF_EMULATE_ONE_BYTE_WRITE_ACCESS=y
```

## prj_native_posix.conf
```kconfig
CONFIG_ZTEST=y
CONFIG_STDOUT_CONSOLE=y
CONFIG_FLASH=y
CONFIG_FLASH_PAGE_LAYOUT=y
CONFIG_FLASH_MAP=y
CONFIG_FCB=y
```

## prj_qemu_x86.conf
```kconfig
CONFIG_ZTEST=y
CONFIG_STDOUT_CONSOLE=y
CONFIG_FLASH=y
CONFIG_FLASH_PAGE_LAYOUT=y
CONFIG_FLASH_MAP=y
CONFIG_FCB=y
CONFIG_FLASH_SIMULATOR_UNALIGNED_READ=y
```

## boards/native_posix_ev_0x00.overlay
```dts
/*
 * Copyright (c) 2020 Nordic Semiconductor ASA
 *
 * SPDX-License-Identifier: Apache-2.0
 */

&flashcontroller0 {
	erase-value = < 0x00 >;
};

&flash0 {
	write-block-size = <1>;
};
```

## boards/qemu_x86.overlay
```dts
/*
 * Copyright (c) Nordic Semiconductor ASA
 *
 *SPDX-License-Identifier: Apache-2.0
 */

&flash_sim0 {
	write-block-size = <1>;
};
```

## boards/qemu_x86_ev_0x00.overlay
```dts
/*
 * Copyright (c) 2020 Nordic Semiconductor ASA
 *
 * SPDX-License-Identifier: Apache-2.0
 */

&sim_flash {
	erase-value = < 0x00 >;
};

&flash_sim0 {
	write-block-size = <1>;
};
```

## src/main.c
```c
/*
 * Copyright (c) 2017-2020 Nordic Semiconductor ASA
 * Copyright (c) 2015 Runtime Inc
 *
 * SPDX-License-Identifier: Apache-2.0
 */

#include <stdio.h>
#include <string.h>

#include "fcb_test.h"
#include <storage/flash_map.h>
#include <drivers/flash.h>
#include <device.h>

struct fcb test_fcb;
uint8_t fcb_test_erase_value;

/* Sectors for FCB are defined far from application code
 * area. This test suite is the non bootable application so 1. image slot is
 * suitable for it.
 */
struct flash_sector test_fcb_sector[] = {
	[0] = {
		.fs_off = 0,
		.fs_size = 0x4000, /* 16K */
	},
	[1] = {
		.fs_off = 0x4000,
		.fs_size = 0x4000
	},
	[2] = {
		.fs_off = 0x8000,
		.fs_size = 0x4000
	},
	[3] = {
		.fs_off = 0xc000,
		.fs_size = 0x4000
	}
};


void test_fcb_wipe(void)
{
	int i;
	int rc;
	const struct flash_area *fap;

	rc = flash_area_open(TEST_FCB_FLASH_AREA_ID, &fap);
	zassert_true(rc == 0, "flash area open call failure");

	for (i = 0; i < ARRAY_SIZE(test_fcb_sector); i++) {
		rc = flash_area_erase(fap, test_fcb_sector[i].fs_off,
				      test_fcb_sector[i].fs_size);
		zassert_true(rc == 0, "erase call failure");
	}
}

int fcb_test_empty_walk_cb(struct fcb_entry_ctx *entry_ctx, void *arg)
{
	zassert_unreachable("fcb_test_empty_walk_cb");
	return 0;
}

uint8_t fcb_test_append_data(int msg_len, int off)
{
	return (msg_len ^ off);
}

int fcb_test_data_walk_cb(struct fcb_entry_ctx *entry_ctx, void *arg)
{
	uint16_t len;
	uint8_t test_data[128];
	int rc;
	int i;
	int *var_cnt = (int *)arg;

	len = entry_ctx->loc.fe_data_len;

	zassert_true(len == *var_cnt, "");

	rc = flash_area_read(entry_ctx->fap,
			     FCB_ENTRY_FA_DATA_OFF(entry_ctx->loc),
			     test_data, len);
	zassert_true(rc == 0, "read call failure");

	for (i = 0; i < len; i++) {
		zassert_true(test_data[i] == fcb_test_append_data(len, i),
		"fcb_test_append_data redout misrepresentation");
	}
	(*var_cnt)++;
	return 0;
}

int fcb_test_cnt_elems_cb(struct fcb_entry_ctx *entry_ctx, void *arg)
{
	struct append_arg *aa = (struct append_arg *)arg;
	int idx;

	idx = entry_ctx->loc.fe_sector - &test_fcb_sector[0];
	aa->elem_cnts[idx]++;
	return 0;
}

void fcb_tc_pretest(int sectors)
{
	struct fcb *fcb;
	int rc = 0;

	test_fcb_wipe();
	fcb = &test_fcb;
	(void)memset(fcb, 0, sizeof(*fcb));
	fcb->f_erase_value = fcb_test_erase_value;
	fcb->f_sector_cnt = sectors;
	fcb->f_sectors = test_fcb_sector; /* XXX */

	rc = 0;
	rc = fcb_init(TEST_FCB_FLASH_AREA_ID, fcb);
	if (rc != 0) {
		printf("%s rc == %xm, %d\n", __func__, rc, rc);
		zassert_true(rc == 0, "fbc initialization failure");
	}
}

void fcb_pretest_2_sectors(void)
{
	fcb_tc_pretest(2);
}

void fcb_pretest_4_sectors(void)
{
	fcb_tc_pretest(4);
}

void teardown_nothing(void)
{
}

/*
 * This actually is not a test; the function gets erase value from flash
 * parameters, of the flash device that is used by tests, and stores it in
 * global fcb_test_erase_value.
 */
void test_get_flash_erase_value(void)
{
	const struct flash_area *fa;
	const struct flash_parameters *fp;
	const struct device *dev;
	int rc = 0;

	rc = flash_area_open(TEST_FCB_FLASH_AREA_ID, &fa);
	zassert_equal(rc, 0, "Failed top open flash area");

	dev = device_get_binding(fa->fa_dev_name);
	flash_area_close(fa);

	zassert_true(dev != NULL, "Failed to obtain device");

	fp = flash_get_parameters(dev);
	zassert_true(fp != NULL, "Failed to get flash device parameters");

	fcb_test_erase_value = fp->erase_value;
}

void test_fcb_len(void);
void test_fcb_init(void);
void test_fcb_empty_walk(void);
void test_fcb_append(void);
void test_fcb_append_too_big(void);
void test_fcb_append_fill(void);
void test_fcb_reset(void);
void test_fcb_rotate(void);
void test_fcb_multi_scratch(void);
void test_fcb_last_of_n(void);

void test_main(void)
{
	ztest_test_suite(test_fcb,
			 ztest_unit_test(test_get_flash_erase_value),
			 ztest_unit_test_setup_teardown(test_fcb_len,
							fcb_pretest_2_sectors,
							teardown_nothing),
			 ztest_unit_test(test_fcb_init),
			 ztest_unit_test_setup_teardown(test_fcb_empty_walk,
							fcb_pretest_2_sectors,
							teardown_nothing),
			 ztest_unit_test_setup_teardown(test_fcb_append,
							fcb_pretest_2_sectors,
							teardown_nothing),
			 ztest_unit_test_setup_teardown(test_fcb_append_too_big,
							fcb_pretest_2_sectors,
							teardown_nothing),
			 ztest_unit_test_setup_teardown(test_fcb_append_fill,
							fcb_pretest_2_sectors,
							teardown_nothing),
			 ztest_unit_test_setup_teardown(test_fcb_rotate,
							fcb_pretest_2_sectors,
							teardown_nothing),
			 ztest_unit_test_setup_teardown(test_fcb_multi_scratch,
							fcb_pretest_4_sectors,
							teardown_nothing),
			 ztest_unit_test_setup_teardown(test_fcb_last_of_n,
							fcb_pretest_4_sectors,
							teardown_nothing),
			 /* Finally, run one that leaves behind a
			  * flash.bin file without any random content */
			 ztest_unit_test_setup_teardown(test_fcb_reset,
							fcb_pretest_2_sectors,
							teardown_nothing)
			 );

	ztest_run_test_suite(test_fcb);
}
```

## src/fcb_test.h
```c
/*
 * Copyright (c) 2017-2020 Nordic Semiconductor ASA
 * Copyright (c) 2015 Runtime Inc
 *
 * SPDX-License-Identifier: Apache-2.0
 */

#ifndef _FCB_TEST_H
#define _FCB_TEST_H

#include <stdio.h>
#include <string.h>
#include <ztest.h>

#include <fs/fcb.h>
#include "fcb_priv.h"
#include <errno.h>

#ifdef __cplusplus
extern "C" {
#endif

#define TEST_FCB_FLASH_AREA_ID FLASH_AREA_ID(image_1)

extern struct fcb test_fcb;

extern struct flash_sector test_fcb_sector[];

extern uint8_t fcb_test_erase_value;

struct append_arg {
	int *elem_cnts;
};

void test_fcb_wipe(void);
int fcb_test_empty_walk_cb(struct fcb_entry_ctx *entry_ctx, void *arg);
uint8_t fcb_test_append_data(int msg_len, int off);
int fcb_test_data_walk_cb(struct fcb_entry_ctx *entry_ctx, void *arg);
int fcb_test_cnt_elems_cb(struct fcb_entry_ctx *entry_ctx, void *arg);

#ifdef __cplusplus
}
#endif
#endif /* _FCB_TEST_H */
```

## src/fcb_test_append.c
```c
/*
 * Copyright (c) 2017 Nordic Semiconductor ASA
 * Copyright (c) 2015 Runtime Inc
 *
 * SPDX-License-Identifier: Apache-2.0
 */

#include "fcb_test.h"

void test_fcb_append(void)
{
	int rc;
	struct fcb *fcb;
	struct fcb_entry loc;
	uint8_t test_data[128];
	int i;
	int j;
	int var_cnt;

	fcb = &test_fcb;

	for (i = 0; i < sizeof(test_data); i++) {
		for (j = 0; j < i; j++) {
			test_data[j] = fcb_test_append_data(i, j);
		}
		rc = fcb_append(fcb, i, &loc);
		zassert_true(rc == 0, "fcb_append call failure");
		rc = flash_area_write(fcb->fap, FCB_ENTRY_FA_DATA_OFF(loc),
				      test_data, i);
		zassert_true(rc == 0, "flash_area_write call failure");
		rc = fcb_append_finish(fcb, &loc);
		zassert_true(rc == 0, "fcb_append_finish call failure");
	}

	var_cnt = 0;
	rc = fcb_walk(fcb, 0, fcb_test_data_walk_cb, &var_cnt);
	zassert_true(rc == 0, "fcb_walk call failure");
	zassert_true(var_cnt == sizeof(test_data),
		     "fetched data size not match to wrote data size");
}
```

## src/fcb_test_append_fill.c
```c
/*
 * Copyright (c) 2017 Nordic Semiconductor ASA
 * Copyright (c) 2015 Runtime Inc
 *
 * SPDX-License-Identifier: Apache-2.0
 */

#include "fcb_test.h"

void test_fcb_append_fill(void)
{
	struct fcb *fcb;
	int rc;
	int i;
	struct fcb_entry loc;
	uint8_t test_data[128];
	int elem_cnts[2] = {0, 0};
	int aa_together_cnts[2];
	struct append_arg aa_together = {
		.elem_cnts = aa_together_cnts
	};
	int aa_separate_cnts[2];
	struct append_arg aa_separate = {
		.elem_cnts = aa_separate_cnts
	};

	fcb = &test_fcb;

	for (i = 0; i < sizeof(test_data); i++) {
		test_data[i] = fcb_test_append_data(sizeof(test_data), i);
	}

	while (1) {
		rc = fcb_append(fcb, sizeof(test_data), &loc);
		if (rc == -ENOSPC) {
			break;
		}
		if (loc.fe_sector == &test_fcb_sector[0]) {
			elem_cnts[0]++;
		} else if (loc.fe_sector == &test_fcb_sector[1]) {
			elem_cnts[1]++;
		} else {
			zassert_true(0,
				     "unexpected flash area of appended loc");
		}

		rc = flash_area_write(fcb->fap, FCB_ENTRY_FA_DATA_OFF(loc),
				      test_data, sizeof(test_data));
		zassert_true(rc == 0, "flash_area_write call failure");

		rc = fcb_append_finish(fcb, &loc);
		zassert_true(rc == 0, "fcb_append_finish call failure");
	}
	zassert_true(elem_cnts[0] > 0,
		     "appendend count should be greater than zero");
	zassert_true(elem_cnts[0] == elem_cnts[1],
		     "appendend counts should equal to each other");

	(void)memset(&aa_together_cnts, 0, sizeof(aa_together_cnts));
	rc = fcb_walk(fcb, NULL, fcb_test_cnt_elems_cb, &aa_together);
	zassert_true(rc == 0, "fcb_walk call failure");
	zassert_true(aa_together.elem_cnts[0] == elem_cnts[0],
		     "fcb_walk: elements count read different than expected");
	zassert_true(aa_together.elem_cnts[1] == elem_cnts[1],
		     "fcb_walk: elements count read different than expected");

	(void)memset(&aa_separate_cnts, 0, sizeof(aa_separate_cnts));
	rc = fcb_walk(fcb, &test_fcb_sector[0], fcb_test_cnt_elems_cb,
	  &aa_separate);
	zassert_true(rc == 0, "fcb_walk call failure");
	rc = fcb_walk(fcb, &test_fcb_sector[1], fcb_test_cnt_elems_cb,
	  &aa_separate);
	zassert_true(rc == 0, "fcb_walk call failure");
	zassert_true(aa_separate.elem_cnts[0] == elem_cnts[0],
		     "fcb_walk: elements count read different than expected");
	zassert_true(aa_separate.elem_cnts[1] == elem_cnts[1],
		     "fcb_walk: elements count read different than expected");
}
```

## src/fcb_test_append_too_big.c
```c
/*
 * Copyright (c) 2017 Nordic Semiconductor ASA
 * Copyright (c) 2015 Runtime Inc
 *
 * SPDX-License-Identifier: Apache-2.0
 */

#include "fcb_test.h"

void (test_fcb_append_too_big(void))
{
		struct fcb *fcb;
		int rc;
		int len;
		struct fcb_entry elem_loc;

		fcb = &test_fcb;

		/*
		 * Max element which fits inside sector is
		 * sector size - (disk header + crc + 1-2 bytes of length).
		 */
		len = fcb->f_active.fe_sector->fs_size;

		rc = fcb_append(fcb, len, &elem_loc);
		zassert_true(rc != 0,
			     "fcb_append call should fail for too big entry");

		len--;
		rc = fcb_append(fcb, len, &elem_loc);
		zassert_true(rc != 0,
			     "fcb_append call should fail for too big entry");

		len -= sizeof(struct fcb_disk_area);
		rc = fcb_append(fcb, len, &elem_loc);
		zassert_true(rc != 0,
			     "fcb_append call should fail for too big entry");

		len = fcb->f_active.fe_sector->fs_size -
			(sizeof(struct fcb_disk_area) + 1 + 2);
		rc = fcb_append(fcb, len, &elem_loc);
		zassert_true(rc == 0, "fcb_append call failure");

		rc = fcb_append_finish(fcb, &elem_loc);
		zassert_true(rc == 0, "fcb_append call failure");

		rc = fcb_elem_info(fcb, &elem_loc);
		zassert_true(rc == 0, "fcb_elem_info call failure");
		zassert_true(elem_loc.fe_data_len == len,
		"entry length fetched should match length of appended entry");
}
```

## src/fcb_test_empty_walk.c
```c
/*
 * Copyright (c) 2017 Nordic Semiconductor ASA
 * Copyright (c) 2015 Runtime Inc
 *
 * SPDX-License-Identifier: Apache-2.0
 */

#include "fcb_test.h"

void test_fcb_empty_walk(void)
{
	int rc;
	struct fcb *fcb;

	fcb = &test_fcb;

	rc = fcb_walk(fcb, 0, fcb_test_empty_walk_cb, NULL);
	zassert_true(rc == 0, "fcb_walk call failure");
}
```

## src/fcb_test_init.c
```c
/*
 * Copyright (c) 2017 - 2020 Nordic Semiconductor ASA
 * Copyright (c) 2015 Runtime Inc
 *
 * SPDX-License-Identifier: Apache-2.0
 */

#include "fcb_test.h"

void test_fcb_init(void)
{
	int rc;
	struct fcb *fcb;

	fcb = &test_fcb;
	(void)memset(fcb, 0, sizeof(*fcb));
	fcb->f_erase_value = fcb_test_erase_value;

	rc = fcb_init(TEST_FCB_FLASH_AREA_ID, fcb);
	zassert_true(rc == -EINVAL, "fcb_init call should fail");

	fcb->f_sectors = test_fcb_sector;

	rc = fcb_init(TEST_FCB_FLASH_AREA_ID, fcb);
	zassert_true(rc == -EINVAL, "fcb_init call should fail");

	fcb->f_sector_cnt = 2U;
	fcb->f_magic = 0x12345678;
	rc = fcb_init(TEST_FCB_FLASH_AREA_ID, fcb);
	zassert_true(rc == -ENOMSG, "fcb_init call should fail");

	fcb->f_magic = 0U;
	rc = fcb_init(TEST_FCB_FLASH_AREA_ID, fcb);
	zassert_true(rc == 0,  "fcb_init call failure");
}
```

## src/fcb_test_last_of_n.c
```c
/*
 * Copyright (c) 2017 Nordic Semiconductor ASA
 * Copyright (c) 2015 Runtime Inc
 *
 * SPDX-License-Identifier: Apache-2.0
 */

#include "fcb_test.h"

void test_fcb_last_of_n(void)
{
	const uint8_t ENTRIES = 5U;
	struct fcb *fcb;
	int rc;
	struct fcb_entry loc;
	struct fcb_entry areas[ENTRIES];
	uint8_t test_data[128] = {0};
	uint8_t i;

	fcb = &test_fcb;
	fcb->f_scratch_cnt = 1U;

	/* No fcbs available */
	rc = fcb_offset_last_n(fcb, 1, &loc);
	zassert_true(rc != 0, "No fcbs available");

	/*
	 * Add some fcbs.
	 */
	for (i = 0U; i < ENTRIES; i++) {
		rc = fcb_append(fcb, sizeof(test_data), &loc);
		if (rc == -ENOSPC) {
			break;
		}

		rc = flash_area_write(fcb->fap, FCB_ENTRY_FA_DATA_OFF(loc),
				      test_data, sizeof(test_data));
		zassert_true(rc == 0, "flash_area_write call failure");

		rc = fcb_append_finish(fcb, &loc);
		zassert_true(rc == 0, "fcb_append_finish call failure");

		areas[i] = loc;
	}

	/* last entry */
	rc = fcb_offset_last_n(fcb, 1, &loc);
	zassert_true(rc == 0, "fcb_offset_last_n call failure");
	zassert_true(areas[4].fe_sector == loc.fe_sector &&
		     areas[4].fe_data_off == loc.fe_data_off &&
		     areas[4].fe_data_len == loc.fe_data_len,
		     "fcb_offset_last_n: fetched wrong n-th location");

	/* somewhere in the middle */
	rc = fcb_offset_last_n(fcb, 3, &loc);
	zassert_true(rc == 0, "fcb_offset_last_n call failure");
	zassert_true(areas[2].fe_sector == loc.fe_sector &&
		     areas[2].fe_data_off == loc.fe_data_off &&
		     areas[2].fe_data_len == loc.fe_data_len,
		     "fcb_offset_last_n: fetched wrong n-th location");

	/* first entry */
	rc = fcb_offset_last_n(fcb, 5, &loc);
	zassert_true(rc == 0, "fcb_offset_last_n call failure");
	zassert_true(areas[0].fe_sector == loc.fe_sector &&
		     areas[0].fe_data_off == loc.fe_data_off &&
		     areas[0].fe_data_len == loc.fe_data_len,
		     "fcb_offset_last_n: fetched wrong n-th location");

	/* after last valid entry, returns the first one like for 5 */
	rc = fcb_offset_last_n(fcb, 6, &loc);
	zassert_true(rc == 0, "fcb_offset_last_n call failure");
	zassert_true(areas[0].fe_sector == loc.fe_sector &&
		     areas[0].fe_data_off == loc.fe_data_off &&
		     areas[0].fe_data_len == loc.fe_data_len,
		     "fcb_offset_last_n: fetched wrong n-th location");
}
```

## src/fcb_test_len.c
```c
/*
 * Copyright (c) 2017-2020 Nordic Semiconductor ASA
 * Copyright (c) 2015 Runtime Inc
 *
 * SPDX-License-Identifier: Apache-2.0
 */

#include "fcb_test.h"

void test_fcb_len(void)
{
	uint8_t buf[3];
	uint16_t len;
	uint16_t len2;
	int rc;
	int rc2;
	struct fcb fcb = { .f_erase_value = fcb_test_erase_value };

	for (len = 0U; len < FCB_MAX_LEN; len++) {
		rc = fcb_put_len(&fcb, buf, len);
		zassert_true(rc == 1 || rc == 2, "fcb_pull_len call failure");

		rc2 = fcb_get_len(&fcb, buf, &len2);
		zassert_true(rc2 == rc, "fcb_get_len call failure");

		zassert_true(len == len2, "fcb_get_len call failure");
	}
}
```

## src/fcb_test_multiple_scratch.c
```c
/*
 * Copyright (c) 2017 Nordic Semiconductor ASA
 * Copyright (c) 2015 Runtime Inc
 *
 * SPDX-License-Identifier: Apache-2.0
 */

#include "fcb_test.h"

void test_fcb_multi_scratch(void)
{
	struct fcb *fcb;
	int rc;
	struct fcb_entry loc;
	uint8_t test_data[128] = {0};
	int elem_cnts[4];
	int idx;
	int cnts[4];
	struct append_arg aa_arg = {
		.elem_cnts = cnts
	};

	fcb = &test_fcb;
	fcb->f_scratch_cnt = 1U;

	/*
	 * Now fill up everything. We should be able to get 3 of the sectors
	 * full.
	 */
	(void)memset(elem_cnts, 0, sizeof(elem_cnts));
	while (1) {
		rc = fcb_append(fcb, sizeof(test_data), &loc);
		if (rc == -ENOSPC) {
			break;
		}
		idx = loc.fe_sector - &test_fcb_sector[0];
		elem_cnts[idx]++;

		rc = flash_area_write(fcb->fap, FCB_ENTRY_FA_DATA_OFF(loc),
				      test_data, sizeof(test_data));
		zassert_true(rc == 0, "flash_area_write call failure");

		rc = fcb_append_finish(fcb, &loc);
		zassert_true(rc == 0, "fcb_append_finish call failure");
	}

	zassert_true(elem_cnts[0] > 0, "unexpected entry number was appended");
	zassert_true(elem_cnts[0] == elem_cnts[1] &&
		     elem_cnts[0] == elem_cnts[2],
		     "unexpected entry number was appended");
	zassert_true(elem_cnts[3] == 0, "unexpected entry number was appended");

	/*
	 * Ask to use scratch block, then fill it up.
	 */
	rc = fcb_append_to_scratch(fcb);
	zassert_true(rc == 0, "fcb_append_to_scratch call failure");

	while (1) {
		rc = fcb_append(fcb, sizeof(test_data), &loc);
		if (rc == -ENOSPC) {
			break;
		}
		idx = loc.fe_sector - &test_fcb_sector[0];
		elem_cnts[idx]++;

		rc = flash_area_write(fcb->fap, FCB_ENTRY_FA_DATA_OFF(loc),
				      test_data, sizeof(test_data));
		zassert_true(rc == 0, "flash_area_write call failure");

		rc = fcb_append_finish(fcb, &loc);
		zassert_true(rc == 0, "fcb_append_finish call failure");
	}
	zassert_true(elem_cnts[3] == elem_cnts[0],
		     "unexpected entry number was appended");

	/*
	 * Rotate
	 */
	rc = fcb_rotate(fcb);
	zassert_true(rc == 0, "fcb_rotate call failure");

	(void)memset(&cnts, 0, sizeof(cnts));
	rc = fcb_walk(fcb, NULL, fcb_test_cnt_elems_cb, &aa_arg);
	zassert_true(rc == 0, "fcb_walk call failure");

	zassert_true(cnts[0] == 0, "unexpected entry count");
	zassert_true(cnts[1] > 0, "unexpected entry count");
	zassert_true(cnts[1] == cnts[2] && cnts[1] == cnts[3],
		     "unexpected entry count");

	rc = fcb_append_to_scratch(fcb);
	zassert_true(rc == 0, "fcb_append_to_scratch call failure");
	rc = fcb_append_to_scratch(fcb);
	zassert_true(rc != 0, "fcb_append_to_scratch call should fail");
}
```

## src/fcb_test_reset.c
```c
/*
 * Copyright (c) 2017 Nordic Semiconductor ASA
 * Copyright (c) 2015 Runtime Inc
 *
 * SPDX-License-Identifier: Apache-2.0
 */

#include "fcb_test.h"

void test_fcb_reset(void)
{
	struct fcb *fcb;
	int rc;
	int i;
	struct fcb_entry loc;
	uint8_t test_data[128];
	int var_cnt;

	fcb = &test_fcb;

	var_cnt = 0;
	rc = fcb_walk(fcb, 0, fcb_test_data_walk_cb, &var_cnt);
	zassert_true(rc == 0, "fcb_walk call failure");
	zassert_true(var_cnt == 0,
		     "fcb_walk: elements count read different than expected");

	rc = fcb_append(fcb, 32, &loc);
	zassert_true(rc == 0, "fcb_append call failure");

	/*
	 * No ready ones yet. CRC should not match.
	 */
	var_cnt = 0;
	rc = fcb_walk(fcb, 0, fcb_test_data_walk_cb, &var_cnt);
	zassert_true(rc == 0, "fcb_walk call failure");
	zassert_true(var_cnt == 0,
		     "fcb_walk: elements count read different than expected");

	for (i = 0; i < sizeof(test_data); i++) {
		test_data[i] = fcb_test_append_data(32, i);
	}
	rc = flash_area_write(fcb->fap, FCB_ENTRY_FA_DATA_OFF(loc), test_data,
			      32);
	zassert_true(rc == 0, "flash_area_write call failure");

	rc = fcb_append_finish(fcb, &loc);
	zassert_true(rc == 0, "fcb_append_finish call failure");

	/*
	 * one entry
	 */
	var_cnt = 32;
	rc = fcb_walk(fcb, 0, fcb_test_data_walk_cb, &var_cnt);
	zassert_true(rc == 0, "fcb_walk call failure");
	zassert_true(var_cnt == 33,
		     "fcb_walk: elements count read different than expected");

	/*
	 * Pretend reset
	 */
	(void)memset(fcb, 0, sizeof(*fcb));
	fcb->f_sector_cnt = 2U;
	fcb->f_sectors = test_fcb_sector;

	rc = fcb_init(TEST_FCB_FLASH_AREA_ID, fcb);
	zassert_true(rc == 0, "fcb_init call failure");

	var_cnt = 32;
	rc = fcb_walk(fcb, 0, fcb_test_data_walk_cb, &var_cnt);
	zassert_true(rc == 0, "fcb_walk call failure");
	zassert_true(var_cnt == 33,
		     "fcb_walk: elements count read different than expected");

	rc = fcb_append(fcb, 33, &loc);
	zassert_true(rc == 0, "fcb_append call failure");

	for (i = 0; i < sizeof(test_data); i++) {
		test_data[i] = fcb_test_append_data(33, i);
	}
	rc = flash_area_write(fcb->fap, FCB_ENTRY_FA_DATA_OFF(loc), test_data,
			      33);
	zassert_true(rc == 0, "flash_area_write call failure");

	rc = fcb_append_finish(fcb, &loc);
	zassert_true(rc == 0, "fcb_append_finish call failure");

	var_cnt = 32;
	rc = fcb_walk(fcb, 0, fcb_test_data_walk_cb, &var_cnt);
	zassert_true(rc == 0, "fcb_walk call failure");
	zassert_true(var_cnt == 34,
		     "fcb_walk: elements count read different than expected");

	/*
	 * Add partial one, make sure that we survive reset then.
	 */
	rc = fcb_append(fcb, 34, &loc);
	zassert_true(rc == 0, "fcb_append call failure");

	(void)memset(fcb, 0, sizeof(*fcb));
	fcb->f_sector_cnt = 2U;
	fcb->f_sectors = test_fcb_sector;

	rc = fcb_init(TEST_FCB_FLASH_AREA_ID, fcb);
	zassert_true(rc == 0, "fcb_init call failure");

	/*
	 * Walk should skip that.
	 */
	var_cnt = 32;
	rc = fcb_walk(fcb, 0, fcb_test_data_walk_cb, &var_cnt);
	zassert_true(rc == 0, "fcb_walk call failure");
	zassert_true(var_cnt == 34,
		     "fcb_walk: elements count read different than expected");

	/* Add a 3rd one, should go behind corrupt entry */
	rc = fcb_append(fcb, 34, &loc);
	zassert_true(rc == 0, "fcb_append call failure");

	for (i = 0; i < sizeof(test_data); i++) {
		test_data[i] = fcb_test_append_data(34, i);
	}
	rc = flash_area_write(fcb->fap, FCB_ENTRY_FA_DATA_OFF(loc), test_data,
			      34);
	zassert_true(rc == 0, "flash_area_write call failure");

	rc = fcb_append_finish(fcb, &loc);
	zassert_true(rc == 0, "fcb_append_finish call failure");

	/*
	 * Walk should skip corrupt entry, but report the next one.
	 */
	var_cnt = 32;
	rc = fcb_walk(fcb, 0, fcb_test_data_walk_cb, &var_cnt);
	zassert_true(rc == 0, "fcb_walk call failure");
	zassert_true(var_cnt == 35,
		     "fcb_walk: elements count read different than expected");
}
```

## src/fcb_test_rotate.c
```c
/*
 * Copyright (c) 2017 Nordic Semiconductor ASA
 * Copyright (c) 2015 Runtime Inc
 *
 * SPDX-License-Identifier: Apache-2.0
 */

#include "fcb_test.h"

void test_fcb_rotate(void)
{
	struct fcb *fcb;
	int rc;
	int old_id;
	struct fcb_entry loc;
	uint8_t test_data[128] = {0};
	int elem_cnts[2] = {0, 0};
	int cnts[2];
	struct append_arg aa_arg = {
		.elem_cnts = cnts
	};

	fcb = &test_fcb;

	old_id = fcb->f_active_id;
	rc = fcb_rotate(fcb);
	zassert_true(rc == 0, "fcb_rotate call failure");
	zassert_true(fcb->f_active_id == old_id + 1,
		     "flash location id should increased");

	/*
	 * Now fill up the
	 */
	while (1) {
		rc = fcb_append(fcb, sizeof(test_data), &loc);
		if (rc == -ENOSPC) {
			break;
		}
		if (loc.fe_sector == &test_fcb_sector[0]) {
			elem_cnts[0]++;
		} else if (loc.fe_sector == &test_fcb_sector[1]) {
			elem_cnts[1]++;
		} else {
			zassert_true(0,
				     "unexpected flash area of appended loc");
		}

		rc = flash_area_write(fcb->fap, FCB_ENTRY_FA_DATA_OFF(loc),
				      test_data, sizeof(test_data));
		zassert_true(rc == 0, "flash_area_write call failure");

		rc = fcb_append_finish(fcb, &loc);
		zassert_true(rc == 0, "fcb_append_finish call failure");
	}
	zassert_true(elem_cnts[0] > 0 && elem_cnts[0] == elem_cnts[1],
		     "unexpected entry number was appended");

	old_id = fcb->f_active_id;
	rc = fcb_rotate(fcb);
	zassert_true(rc == 0, "fcb_rotate call failure");
	zassert_true(fcb->f_active_id == old_id,
		     "flash location should be kept");

	(void)memset(cnts, 0, sizeof(cnts));
	rc = fcb_walk(fcb, NULL, fcb_test_cnt_elems_cb, &aa_arg);
	zassert_true(rc == 0, "fcb_walk call failure");
	zassert_true(aa_arg.elem_cnts[0] == elem_cnts[0] ||
		     aa_arg.elem_cnts[1] == elem_cnts[1],
		     "fcb_walk: entry count got different than expected");
	zassert_true(aa_arg.elem_cnts[0] == 0 || aa_arg.elem_cnts[1] == 0,
		     "fcb_walk: entry count got different than expected");

	/*
	 * One sector is full. The other one should have one entry in it.
	 */
	rc = fcb_append(fcb, sizeof(test_data), &loc);
	zassert_true(rc == 0, "fcb_append call failure");

	rc = flash_area_write(fcb->fap, FCB_ENTRY_FA_DATA_OFF(loc), test_data,
			      sizeof(test_data));
	zassert_true(rc == 0, "flash_area_write call failure");

	rc = fcb_append_finish(fcb, &loc);
	zassert_true(rc == 0, "fcb_append_finish call failure");

	old_id = fcb->f_active_id;
	rc = fcb_rotate(fcb);
	zassert_true(rc == 0, "fcb_rotate call failure");
	zassert_true(fcb->f_active_id == old_id,
		     "flash location should be kept");

	(void)memset(cnts, 0, sizeof(cnts));
	rc = fcb_walk(fcb, NULL, fcb_test_cnt_elems_cb, &aa_arg);
	zassert_true(rc == 0, "fcb_walk call failure");
	zassert_true(aa_arg.elem_cnts[0] == 1 || aa_arg.elem_cnts[1] == 1,
		     "fcb_walk: entry count got different than expected");
	zassert_true(aa_arg.elem_cnts[0] == 0 || aa_arg.elem_cnts[1] == 0,
		     "fcb_walk: entry count got different than expected");
}
```
